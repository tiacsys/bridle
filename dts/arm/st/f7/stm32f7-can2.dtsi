/*
 * Copyright (c) 2021 TiaC Systems
 * Copyright (c) 2021 Li-Pro.Net
 * SPDX-License-Identifier: Apache-2.0
 */

/ {
	soc {
		// missed in st/f7/stm32f767.dtsi
		can2: can@40006800 {
			compatible = "st,stm32-can";
			#address-cells = <1>;
			#size-cells = <0>;
			reg = <0x40006800 0x400>;
			interrupts = <63 0>, <64 0>, <65 0>, <66 0>;
			interrupt-names = "TX", "RX0", "RX1", "SCE";
			clocks = <&rcc STM32_CLOCK_BUS_APB1 0x04000000>;
			master-can-reg = <0x40006400>;
			status = "disabled";
			label = "CAN_2";
		};
	};
};
