/*
 * Copyright (c) 2021 TiaC Systems
 * Copyright (c) 2021 Li-Pro.Net
 * SPDX-License-Identifier: Apache-2.0
 */

#include <mem.h>
#include <st/f7/stm32f777.dtsi>

/ {
	soc {
		flash-controller@40023c00 {

			/* 2 Mbytes Flash memory
			 * - single bank organization
			 * - 256 bits read width
			 *
			 * sec	   AXIM		   ICTM		 size
			 * ===	==========	==========	=======
			 *  0	0x08000000	0x00200000	  32 KB
			 *  1	0x08008000	0x00208000	  32 KB
			 *  2	0x08010000	0x00210000	  32 KB
			 *  3	0x08018000	0x00218000	  32 KB
			 * ---	----------	----------	-------
			 *  4	0x08020000	0x00220000	 128 KB
			 * ---	----------	----------	-------
			 *  5	0x08040000	0x00240000	 256 KB
			 *  6	0x08080000	0x00280000	 256 KB
			 *  7	0x080C0000	0x002C0000	 256 KB
			 *  8	0x08100000	0x00300000	 256 KB
			 *  9	0x08140000	0x00340000	 256 KB
			 * 10	0x08180000	0x00380000	 256 KB
			 * 11	0x081C0000	0x003C0000	 256 KB
			 * ---	----------	----------	-------
			 *					2048 KB
			 * ===	==========	==========	=======
			 */

			flash0: flash@8000000 {
				reg = <0x08000000 DT_SIZE_K(2048)>;
			};
		};
	};
};
