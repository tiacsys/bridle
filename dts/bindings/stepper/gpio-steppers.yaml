## dts/bindings/stepper/gpio-steppers.yaml
```yaml
# SPDX-FileCopyrightText: Copyright (c) 2024 Carl Zeiss Meditec AG
# SPDX-FileCopyrightText: Copyright (c) 2024 TiaC Systems
# SPDX-License-Identifier: Apache-2.0

description: |
  This allows you to define a group of stepper motors. Each stepper
  motor in the group is controlled by a set of GPIOs. Each stepper
  motor is defined in a child node of the gpio-steppers node.

  Here is an example which defines three stepper motors
  in the node /steppers:

  / {
  	steppers {
  		compatible = "vnd,model", "gpio-steppers";
  		motor_0 {
  			compatible = "vnd,model", "gpio-stepper-motor";
  			gpios = <&gpioa 9 GPIO_ACTIVE_HIGH>, /* a */
  				<&gpioc 7 GPIO_ACTIVE_HIGH>, /* c */
  				<&gpiob 0 GPIO_ACTIVE_HIGH>, /* b */
  				<&gpioa 7 GPIO_ACTIVE_HIGH>; /* d */
  			fs-per-turn = <200>;   /* 1.8° per step (360° / 1.8°) */
  			fs-max-speed = <1000>; /* 300 RPM (60 * 1000 / 200) */
  			friendly-name = "NEMA 17, 2A, 1.8°"
  		};
  		motor_1 {
  			compatible = "vnd,model", "gpio-stepper-motor";
  			gpios = <&gpioe 5 GPIO_ACTIVE_LOW>, /* a */
  				<&gpiob 2 GPIO_ACTIVE_LOW>, /* c */
  				<&gpioa 1 GPIO_ACTIVE_LOW>, /* b */
  				<&gpioe 0 GPIO_ACTIVE_LOW>; /* d */
  			fs-per-turn = <200>;   /* 1.8° per step (360° / 1.8°) */
  			fs-max-speed = <500>; /* 150 RPM (60 * 500 / 200) */
  			friendly-name = "NEMA 17, 1A, 1.8°"
  		};
  		motor_2 {
  			compatible = "vnd,model", "gpio-stepper-motor";
  			gpios = <&gpiob 8 (GPIO_PULL_UP | GPIO_ACTIVE_LOW)>, /* a */
  				<&gpioe 3 (GPIO_PULL_UP | GPIO_ACTIVE_LOW)>, /* c */
  				<&gpioc 6 (GPIO_PULL_UP | GPIO_ACTIVE_LOW)>, /* b */
  				<&gpiof 2 (GPIO_PULL_UP | GPIO_ACTIVE_LOW)>; /* d */
  			fs-per-turn = <400>;   /* 0.9° per step (360° / 0.9°) */
  			fs-max-speed = <1000>; /* 150 RPM (60 * 1000 / 400) */
  			friendly-name = "NEMA 17, 4A, 0.9°"
  		};
  	};
  };

  Above:

  - motor_0 are pin 9 on gpioa, pin 7 on gpioc, pin 0 on gpiob, and
    pin 7 on gpioa. The GPIOs are on when the pins are high, and off
    when the pins are low.
  - motor_1 are pin 5 on gpioe, pin 2 on gpiob, pin 1 on gpioa, and
    pin 0 on gpioe. The GPIOs are on when the pins are low, and off
    when the pins are high.
  - motor_2 are pin 8 on gpiob, pin 3 on gpioe, pin 6 on gpioc, and
    pin 2 on gpiof. The GPIOs are on when the pins are low, and the
    pin's internal pull-up resistor should be enabled.

  The array of each gpio pin set, where the stepper driver inputs
  must be connected, follows a fixed order of assignment:

           bipolar            uni-polar     gpios = a, c, b, d;
    a o--.              a o--.
        | |  .-.            | |  .-.        a: A1/A+
        | | ( M )       x o-+ | ( M )       b: A2/A-
        | |  `-´            | |  `-´        c: B1/B+
    b o--´ .-----.      b o--´ .-----.      d: B2/B-
           |-----|             |--+--|
           o     o             o  o  o
           c     d             c  x  d

compatible: "gpio-steppers"

child-binding:
  compatible: "gpio-stepper-motor"
  description: GPIO driven stepper motor child node
  properties:
    gpios:
      type: phandle-array
      required: true

  include: stepper-motor.yaml
```

## dts/bindings/stepper/stepper-motor.yaml
```yaml
# SPDX-FileCopyrightText: Copyright (c) 2024 Carl Zeiss Meditec AG
# SPDX-FileCopyrightText: Copyright (c) 2024 TiaC Systems
# SPDX-License-Identifier: Apache-2.0

description: |
  Stepper Motor Driver Device

include: base.yaml

properties:

  nmotors:
    required: true
    type: int
    description: |
      Number of stepper motors this driver can drive.

  fs-max-speed:
    required: true
    type: int
    description: |
      Maximum rotational speed in simplest full-step mode (steps/s).
      Must be in range [1 ... 4294967295].

  friendly-name:
    type: string
    description: |
      Human readable string describing the stepper motor driver. It can be used
      to distinguish multiple instances of the same model (e.g., X vs. Y axis)
      to a host operating system.

  "#address-cells":
    required: true
    const: 1

  "#size-cells":
    required: true
    const: 0

  "#stepper-motor-cells":
    type: int
    required: true

child-binding:
  description: |
    Stepper motor driver child node, corresponds to a single stepper motor
    driven by this driver.

  properties:

    reg:
      type: array
      required: true
      description: Motor output identifier.

    fs-per-turn:
      required: true
      type: int
      description: |
        Number of full-steps for one full turn. This depends on the minimal
        step angle, e.g. a stepper motor with a 1.8° step angle will have
        200 full-steps for every full revolution of the motor (360° / 1.8°).
        Must be in range [1 ... 4294967295].

    friendly-name:
      type: string
      description: |
        Human readable string describing the stepper motor. It can be used to
        distinguish multiple instances of the same model (e.g., X vs. Y axis)
        to a host operating system.

    microstep-res:
      type: int
      default: 1
      description: |
        Microstep resolution to be set while initializing the device driver.
        Here is the concordance list (see dt-bindings/stepper/stepper.h)
          1     STEPPER_USTEP_RES_1
          2     STEPPER_USTEP_RES_2
          4     STEPPER_USTEP_RES_4
          8     STEPPER_USTEP_RES_8
          16    STEPPER_USTEP_RES_16
          32    STEPPER_USTEP_RES_32
          64    STEPPER_USTEP_RES_64
          128   STEPPER_USTEP_RES_128
          256   STEPPER_USTEP_RES_256
      enum:
        - 1
        - 2
        - 4
        - 8
        - 16
        - 32
        - 64
        - 128
        - 256
```

## dts/bindings/tiac-magpie-pin-header.yaml
```yaml
# Copyright (c) 2021 TiaC Systems
# Copyright (c) 2021 Li-Pro.Net
# SPDX-License-Identifier: Apache-2.0

description: |
    GPIO pins exposed on TiaC MAGPIE headers.

    The TiaC Magpie layout provides five headers, each two rows with
    seven pins per row.

    This binding provides a nexus mapping for 12 pins for each header,
    left side pins are the odd pins numbered 0, 2, 4, 6, 8, 10, the right
    side pins are the even pins numbered 1, 3, 5, 7, 9, 11. The bottom pins
    on each side are used for ground, they are not mapped in the nexus.

             (GPIOx/1)  TMPHx/1  1 --o  o-- 2  TMPHx/2  (GPIOx/2)
             (GPIOx/3)  TMPHx/3  3 --o  o-- 4  TMPHx/4  (GPIOx/4)
             (GPIOx/5)  TMPHx/5  5 --o  o-- 6  TMPHx/6  (GPIOx/6)
             (GPIOx/7)  TMPHx/7  7 --o  o-- 8  TMPHx/8  (GPIOx/8)
             (GPIOx/9)  TMPHx/9  9 --o  o-- 10 TMPHx/10 (GPIOx/10)
            (GPIOx/12) TMPHx/11 11 --o  o-- 12 TMPHx/12 (GPIOx/12)
                 (GND)          13 --o  o-- 14          (GND)

    Board's silkscreen may vary depending your board, but coherent with the
    description above as it's according to the standard's specification.
    Not every TiaC board provides all five headers.

compatible: "tiac-magpie-pin-header"

include: [gpio-nexus.yaml, base.yaml]
```

## lib/commands/Kconfig
```kconfig
# Copyright (c) 2019-2021 Li-Pro.Net
# SPDX-License-Identifier: Apache-2.0

menuconfig LPNB_COMMANDS
	bool "LPNB Shell Commands"
	depends on SHELL
	default n

if LPNB_COMMANDS

config LPNB_CMD_HELLO
	bool "Simple hello from shell"
	default y if LPNB_COMMANDS
	default n
	help
	  Enable to have the command 'hello' that prints the simple message:
	  "Hello from shell." on the console.

endif # LPNB_COMMANDS
```

## lib/gui/lvgl/Kconfig
```kconfig
# Copyright (c) 2024 TiaC Systems
# SPDX-License-Identifier: Apache-2.0

if LVGL

comment "LVGL configuration (fixes and enxtensions)"

choice LV_FONT_DEFAULT
	config LV_FONT_DEFAULT_MONTSERRAT_10
		bool "Montserrat 10"
		select LV_FONT_MONTSERRAT_10
endchoice

endif
```

## lib/motion/Kconfig
```kconfig
# Copyright (c) 2024 TiaC Systems
# SPDX-License-Identifier: Apache-2.0

config MOTION
	bool "Motion Control library"
	depends on STEPPER_ACTION_STREAM
	help
	  Enable Motion Control library.

module = MOTION
module-str = motion
source "subsys/logging/Kconfig.template.log_config"
```

## modules/Kconfig
```kconfig
# Copyright (c) 2024 TiaC Systems
# SPDX-License-Identifier: Apache-2.0

menu "Unavailable Modules"

comment "Unavailable modules, please install those via the project manifest."

# List of comments to display when Zephyr modules are not available, please
# use the following syntax:
# ---------------------------------------------------
# comment "<module_name> module not available."
#	depends on !ZEPHYR_<MODULE_NAME_UPPER>_MODULE
#
# Remember to add the following code inside the `<module>/Kconfig file:
# ---------------------------------------------------
# config ZEPHYR_<MODULE_NAME_UPPER>_MODULE
# 	bool

comment "u-blox ubxlib module not available."
	depends on !ZEPHYR_UBXLIB_MODULE

endmenu
```

## modules/hal_trinamic/Kconfig
```kconfig
# Copyright (c) 2023 TiaC Systems
#
# SPDX-License-Identifier: Apache-2.0

config HAS_TMCAPI
	bool

config HAS_TMCHELPERS
	bool
	depends on HAS_TMCAPI

config HAS_TMCRAMP
	bool
	depends on HAS_TMCAPI

if HAS_TMCAPI

config USE_TCMAPI_MAX22216
	bool

config USE_TCMAPI_TMC2041
	bool

config USE_TCMAPI_TMC2130
	bool

config USE_TCMAPI_TMC2160
	bool

config USE_TCMAPI_TMC2208
	bool

config USE_TCMAPI_TMC2209
	bool

config USE_TCMAPI_TMC2224
	bool

config USE_TCMAPI_TMC2225
	bool

config USE_TCMAPI_TMC2226
	bool

config USE_TCMAPI_TMC2240
	bool

config USE_TCMAPI_TMC2300
	bool

config USE_TCMAPI_TMC2590
	bool

config USE_TCMAPI_TMC262
	bool

config USE_TCMAPI_TMC2660
	bool

config USE_TCMAPI_TMC389
	bool

config USE_TCMAPI_TMC4210
	bool

config USE_TCMAPI_TMC424
	bool

config USE_TCMAPI_TMC429
	bool

config USE_TCMAPI_TMC4330
	bool

config USE_TCMAPI_TMC4331
	bool

config USE_TCMAPI_TMC4361
	bool

config USE_TCMAPI_TMC4361A
	bool

config USE_TCMAPI_TMC43XX
	bool

config USE_TCMAPI_TMC457
	bool

config USE_TCMAPI_TMC4670
	bool

config USE_TCMAPI_TMC4671
	bool

config USE_TCMAPI_TMC5031
	bool

config USE_TCMAPI_TMC5041
	bool

config USE_TCMAPI_TMC5062
	bool

config USE_TCMAPI_TMC5072
	bool

config USE_TCMAPI_TMC5130
	bool

config USE_TCMAPI_TMC5160
	bool

config USE_TCMAPI_TMC5240
	bool

config USE_TCMAPI_TMC5271
	bool

config USE_TCMAPI_TMC5272
	bool

config USE_TCMAPI_TMC6100
	bool

config USE_TCMAPI_TMC6200
	bool

config USE_TCMAPI_TMC7300
	bool

config USE_TCMAPI_TMC8461
	bool

config USE_TCMAPI_TMC8462
	bool

config USE_TCMAPI_TMC846X
	bool

endif # HAS_TMCAPI
```

## modules/qpc/Kconfig
```kconfig
# Copyright (c) 2022 TiaC Systems
# SPDX-License-Identifier: Apache-2.0

config ZEPHYR_QPC_MODULE
	bool

config QPC
	bool "Enable qpc state machine framework"
	help
	  This option enables the qpc state machine framework

if QPC
	comment "You have configured QPC"
	config QPC_NO_QASSERT
		bool "Disable QPC assertions"
		default y 
		help
		  This option disables the QPC assertions by introducing -DN_QASSERT as a global
		  compile time flag
endif # QPC
```

## modules/ubxlib/Kconfig
```kconfig
# Copyright (c) 2021 Andreas Anderberg
# Copyright (c) 2022-2023 Rob Meades
# Copyright (c) 2023 Sarah Renkhoff
# Copyright (c) 2024 TiaC Systems
# SPDX-License-Identifier: Apache-2.0

config ZEPHYR_UBXLIB_MODULE
	bool

config UBXLIB
	bool "u-blox ubxlib support"
	default n
	help
	  Enable ubxlib for use with u-blox modules

if UBXLIB

config UBXLIB_CELL
	bool "Cellular support"
	default n
	help
	  This will enable cell API.

config UBXLIB_GNSS
	bool "GNSS support"
	default n
	help
	  This will enable GNSS API.

config UBXLIB_GEODESIC
	bool "Enable geodesic library for geofence support"
	default n
	help
	  This will enable geofence support.

menuconfig UBXLIB_SHORTRANGE
	bool "Short range support"
	default n
	help
	  This will enable BLE and Wifi API.

if UBXLIB_SHORTRANGE

config UBXLIB_OPEN_CPU_BLE
	bool "Enable ubxlib OpenCPU BLE components"
	default n
	depends on BT
	depends on BT_PERIPHERAL
	depends on BT_CENTRAL
	select BT_GATT_DYNAMIC_DB
	select BT_GATT_CLIENT
	help
	  This will enable BLE SPS

menuconfig UBXLIB_EDM_STREAM_DEBUG
	bool "Enable logging of EDM stream events"
	default n

if UBXLIB_EDM_STREAM_DEBUG

config UBXLIB_EDM_STREAM_DEBUG_COLOR
	bool "Enable ANSI color coding for EDM debug"
	default y

config UBXLIB_EDM_STREAM_DEBUG_DUMP_DATA
	bool "Dump EDM data"
	default n

endif # UBXLIB_EDM_STREAM_DEBUG

endif # UBXLIB_SHORTRANGE

config UBXLIB_LOGGING
	bool "Enable ubxlib logging"
	default n
	help
	  The self contained ubxlib logging is only usefull for
	  development and a simple tool for dumping datagram
	  content and internal state changes.

	  Note that the ubxlib logging is a complete standalone
	  implementation based on simple printf() wrapper and
	  has nothing to do with the Zephyr logging system!

config UBXLIB_TEST
	bool "Compile the ubxlib tests"
	select TEST
	select IRQ_OFFLOAD
	select CPLUSPLUS
	default n
	help
	  The self contained ubxlib tests are only usefull for
	  development and depends on some special OS features,
	  such like C++ support for the Unity test framework and
	  the IRQ Offload to be able to test semaphore from ISR.

	  Currently this option is featureless. The ubxlib tests
	  are not enabled for Zephyr.

endif # UBXLIB
```

## samples/dts_test/boards/qemu_cortex_m3.conf
```kconfig
# Copyright (c) 2021-2023 TiaC Systems
# SPDX-License-Identifier: Apache-2.0

# disable unsupported components or components with issues
CONFIG_FLASH=n
CONFIG_FLASH_SHELL=n
```

## samples/dts_test/sample.yaml
```yaml
sample:
  description: Check that I2C in the DTS is correct
  name: dts
tests:
  sample.basic.dts.i2c:
    tags:
      - i2c
      - devicetree
    integration_platforms:
      - nucleo_f401re
      - mimxrt1060_evkb
      - qemu_cortex_m3
    extra_args:
      - CONF_FILE="prj.conf"
    harness: pytest
    harness_config:
      pytest_root:
        - "pytest/test_i2c.py"
    platform_allow:
      - nucleo_f401re
      - mimxrt1060_evkb
    timeout: 300
```
