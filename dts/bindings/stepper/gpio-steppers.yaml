## samples/dts_test_cmake/sample.yaml
```yaml
sample:
  description: Check that I2C in the DTS is correct
  name: dts
common:
  build_only: true
  build_on_all: true
tests:
  grove.base.v2:
    depends_on: arduino_gpio
    filter: dt_nodelabel_enabled("grove_laced_if_v2") and
            dt_nodelabel_enabled("grove_d0_header") and
            dt_nodelabel_enabled("grove_d2_header") and
            dt_nodelabel_enabled("grove_d3_header") and
            dt_nodelabel_enabled("grove_d4_header") and
            dt_nodelabel_enabled("grove_d5_header") and
            dt_nodelabel_enabled("grove_d6_header") and
            dt_nodelabel_enabled("grove_d7_header") and
            dt_nodelabel_enabled("grove_d8_header") and
            dt_nodelabel_enabled("grove_a0_header") and
            dt_nodelabel_enabled("grove_a1_header") and
            dt_nodelabel_enabled("grove_a2_header") and
            dt_nodelabel_enabled("grove_a3_header") and
            dt_nodelabel_enabled("grove_uart_header") and
            dt_nodelabel_enabled("grove_i2c_header")
    platform_allow:
      nucleo_f303re
      nucleo_f401re
    extra_args: SHIELD=seeed_grove_base_v2
  grove.base.v2.arduino:
    # May be skipped if the board has at least one of the Ardunio standard
    # interfaces UART, I2c or SPI disabled at the time.
    depends_on: arduino_gpio
    filter: dt_nodelabel_enabled("grove_laced_if_v2") and
            dt_nodelabel_enabled("arduino_header") and
            dt_nodelabel_enabled("grove_gpios") and
            dt_nodelabel_enabled("arduino_serial") and
            dt_nodelabel_enabled("grove_serial") and
            dt_nodelabel_enabled("arduino_i2c") and
            dt_nodelabel_enabled("grove_i2c") and
            dt_nodelabel_enabled("arduino_spi") and
            dt_nodelabel_enabled("grove_spi")
    platform_allow:
      nucleo_f303re
      nucleo_f401re
    extra_args: SHIELD=seeed_grove_base_v2
  grove_pwms.base.v2:
    depends_on: arduino_gpio
    filter: dt_nodelabel_enabled("grove_laced_if_v2") and
            dt_nodelabel_enabled("grove_pwms")
    platform_allow:
      nucleo_f303re
      nucleo_f401re
    extra_args: SHIELD=seeed_grove_base_v2
```

## samples/helloshell/boards/magpie_f777ni.conf
```kconfig
# Copyright (c) 2021-2025 TiaC Systems
# SPDX-License-Identifier: Apache-2.0

# disable components with conflicts: On STM32 either the RTC
# or the COUNTER API can be used, but never both on same time.
# zephyr-keep-sorted-start
CONFIG_RTC=n
CONFIG_RTC_SHELL=n
# zephyr-keep-sorted-stop

# enable Ethernet and MDIO and related shell commands
# zephyr-keep-sorted-start
CONFIG_DNS_RESOLVER=y
CONFIG_MDIO_SHELL=y
CONFIG_NETWORKING=y
CONFIG_NET_ARP=y
CONFIG_NET_DHCPV4=y
CONFIG_NET_DHCPV6=y
CONFIG_NET_IPV4=y
CONFIG_NET_IPV6=y
CONFIG_NET_MGMT=y
CONFIG_NET_MGMT_EVENT=y
CONFIG_NET_SHELL=y
CONFIG_NET_TCP=y
CONFIG_NET_UDP=y
# zephyr-keep-sorted-stop
```

## samples/helloshell/boards/mimxrt1010_evk.conf
```kconfig
# Copyright (c) 2024-2025 TiaC Systems
# SPDX-License-Identifier: Apache-2.0

# disable unsupported components or components with issues
# zephyr-keep-sorted-start
CONFIG_FLASH=n
CONFIG_FLASH_SHELL=n
# zephyr-keep-sorted-stop
```

## samples/helloshell/boards/mimxrt1010_evk_bbe.conf
```kconfig
# Copyright (c) 2024-2026 TiaC Systems
# SPDX-License-Identifier: Apache-2.0

# increases the RTC initialization priority
# as the board has enabled the SNVS counter_rtc
CONFIG_RTC_INIT_PRIORITY=70

# disable unsupported components or components with issues
# zephyr-keep-sorted-start
CONFIG_FLASH=n
CONFIG_FLASH_SHELL=n
# zephyr-keep-sorted-stop
```

## samples/helloshell/boards/mimxrt1060_evk_mimxrt1062_qspi_bbe.conf
```kconfig
# Copyright (c) 2024-2025 TiaC Systems
# SPDX-License-Identifier: Apache-2.0

# increases the RTC initialization priority
# as the board has enabled the SNVS counter_rtc
CONFIG_RTC_INIT_PRIORITY=70
```

## samples/helloshell/boards/mimxrt1060_evkb.conf
```kconfig
# Copyright (c) 2024 TiaC Systems
# SPDX-License-Identifier: Apache-2.0
#
# NOTES for further utilization and realization
#
# In this configuration artefact the following Kconfig symbols
# were set explicitly to the current upstream defaults to realize
# a reasonably comprehensible condition:
#
# CONFIG_POLL
# CONFIG_CAN_INIT_PRIORITY
# CONFIG_CAN_MAX_FILTER
#
#
# Possible mode flags on CAN Shell command (capabilities):
# ========================================================
#
# fd			: CAN_MODE_FD
# listen-only		: CAN_MODE_LISTENONLY
# loopback		: CAN_MODE_LOOPBACK
# normal		: CAN_MODE_NORMAL
# one-shot		: CAN_MODE_ONE_SHOT	(not on FLEXCAN)
# triple-sampling	: CAN_MODE_3_SAMPLES
#
#
# Used CAN Shell commands for CAN setup and probes:
# =================================================
#
# can show can@401d8000
#
# can bitrate can@401d8000 500000 800 1
# can dbitrate can@401d8000 5000000 750 1
# can mode can@401d8000 normal
#
# can start can@401d8000
#
# CAN 11-bit and 29-bit ID number 5 receiving:
# --------------------------------------------
# can filter add can@401d8000 5
# can filter add can@401d8000 -e 5
#
# CAN 11-bit and 29-bit ID:
# -------------------------
# can send can@401d8000 0 11 22 33 44
# can send can@401d8000 -e 0 11 22 33 44
#
# can stop can@401d8000
#
#
# Used CAN Shell commands for CAN FD setup and probes:
# ====================================================
#
# can show can@401d8000
#
# can bitrate can@401d8000 500000 800 1
# can dbitrate can@401d8000 5000000 750 1
# can mode can@401d8000 fd
#
# can start can@401d8000
#
# CAN 11-bit and 29-bit ID number 5 receiving:
# --------------------------------------------
# can filter add can@401d8000 5
# can filter add can@401d8000 -e 5
#
# CAN 11-bit and 29-bit ID:
# -------------------------
# can send can@401d8000 0 11 22 33 44
# can send can@401d8000 -e 0 11 22 33 44
#
# CAN FD 11-bit and 29-bit ID w/o and w/ BRS:
# -------------------------------------------
# can send can@401d8000 -f 0 11 22 33 44
# can send can@401d8000 -f -b 0 11 22 33 44
# can send can@401d8000 -e -f 0 11 22 33 44
# can send can@401d8000 -e -f -b 0 11 22 33 44
#
# can stop can@401d8000
#
#
# Linux setup and commands for CAN and CAN FD Socket:
# ===================================================
#
# sudo ip link set can0 up type can \
#      bitrate 500000 sample-point 0.800 \
#      dbitrate 5000000 dsample-point 0.750 \
#      restart-ms 1000 berr-reporting on fd on
# sudo ifconfig can0 txqueuelen 65536
# ip -details -statistics link show can0
#
# sudo ip link set can1 up type can \
#      bitrate 500000 sample-point 0.800 \
#      dbitrate 5000000 dsample-point 0.750 \
#      restart-ms 1000 berr-reporting on fd on
# sudo ifconfig can1 txqueuelen 65536
# ip -details -statistics link show can1
#
# candump -cc -ta -a -dex can0
#
# cansend can1 005#11.22.33.44
# cansend can1 00000005#11.22.33.44
#
# cansend can1 005##311223344
# cansend can1 00000005##311223344
#

# enable Async I/O Framework explicitly
CONFIG_POLL=y

# enable CAN support with CAN FD capability
CONFIG_CAN=y
CONFIG_CAN_FD_MODE=y
CONFIG_CAN_INIT_PRIORITY=80
CONFIG_CAN_MAX_FILTER=5

# enable Shell with CAN commands
CONFIG_SHELL=y
CONFIG_CAN_SHELL=y
CONFIG_DEVICE_SHELL=y

# enable Statistics for CAN with Shell commands
CONFIG_STATS=y
CONFIG_STATS_NAMES=y
CONFIG_STATS_SHELL=y
CONFIG_CAN_STATS=y
```

## samples/helloshell/boards/mimxrt1170_evk_mimxrt1176_cm4.conf
```kconfig
# Copyright (c) 2024-2025 TiaC Systems
# SPDX-License-Identifier: Apache-2.0

# disable features to reduce image size
# zephyr-keep-sorted-start
CONFIG_EEPROM=n
CONFIG_EEPROM_SHELL=n
CONFIG_REGULATOR=n
CONFIG_REGULATOR_SHELL=n
CONFIG_RTC=n
CONFIG_RTC_SHELL=n
CONFIG_SENSOR=n
CONFIG_SENSOR_INFO=n
CONFIG_SENSOR_SHELL=n
# zephyr-keep-sorted-stop
```

## samples/helloshell/boards/native_sim.conf
```kconfig
# Copyright (c) 2021-2023 TiaC Systems
# SPDX-License-Identifier: Apache-2.0

# disable unsupported components or components with issues:
# ...zephyr/include/zephyr/shell/shell.h:803:22: error:
#                        field ‘getopt’ has incomplete type
CONFIG_SHELL_GETOPT=n
```

## samples/helloshell/boards/picoboy_color_plus_rp2350a_m33.conf
```kconfig
# Copyright (c) 2025 TiaC Systems
# SPDX-License-Identifier: Apache-2.0

# disable unsupported components or components with issues
CONFIG_FLASH=n
CONFIG_FLASH_SHELL=n
```

## samples/helloshell/boards/qemu_cortex_m0.conf
```kconfig
# Copyright (c) 2021-2023 TiaC Systems
# SPDX-License-Identifier: Apache-2.0

# disable components to avoid RAM overflow on BSS allocation
CONFIG_FLASH=n
CONFIG_FLASH_SHELL=n
CONFIG_SENSOR_INFO=n
```

## samples/helloshell/boards/qemu_cortex_m0_nrf51822.conf
```kconfig
# Copyright (c) 2021-2025 TiaC Systems
# SPDX-License-Identifier: Apache-2.0

# disable components to avoid RAM overflow on BSS allocation
# zephyr-keep-sorted-start
CONFIG_FLASH=n
CONFIG_FLASH_SHELL=n
CONFIG_SENSOR_SHELL=n
CONFIG_SHELL_MINIMAL=y
# zephyr-keep-sorted-stop
```

## samples/helloshell/boards/qemu_cortex_m3.conf
```kconfig
# Copyright (c) 2021-2023 TiaC Systems
# Copyright (c) 2019-2021 Li-Pro.Net
# SPDX-License-Identifier: Apache-2.0

# disable unsupported components
CONFIG_ADC=n
CONFIG_ADC_SHELL=n
CONFIG_DAC=n
CONFIG_DAC_SHELL=n
```
