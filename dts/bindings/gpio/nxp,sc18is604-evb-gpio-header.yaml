## dts/bindings/mfd/nxp,sc18is604.yaml
```yaml
# Copyright (c) 2024 TiaC Systems
# SPDX-License-Identifier: Apache-2.0

description: |
  NXP SC18IS604 SPI to I2C/GPIO bridge.

  The SC18IS604 acts as both an external I2C and GPIO controller. These
  controllers have to be added to the Device Tree as children, while the
  device itself has to be a child of an SPI controller.

  An example configuration:

  #include <freq.h>
  #include <zephyr/dt-bindings/i2c/i2c.h>
  #include <zephyr/dt-bindings/gpio/gpio.h>

  &spi0 {
    status = "okay";
    pinctrl-0 = <&spi0_default>;
    pinctrl-names = "default";
    cs-gpios = <&gpio0 16 (GPIO_ACTIVE_LOW | GPIO_PULL_UP)>;

    sc18is604: sc18is604 {
      compatible = "nxp,sc18is604";
      status = "okay";
      reg = <0>;
      spi-max-frequency = <DT_FREQ_K(1200)>;
      reset-gpios = <&gpio0 14 (GPIO_ACTIVE_LOW | GPIO_PULL_UP)>;
      interrupt-gpios = <&gpio0 15 (GPIO_ACTIVE_LOW | GPIO_PULL_UP)>;

      i2c_ext: sc18is604-i2c {
        compatible = "nxp,sc18is604-i2c";
        status = "okay";
        #address-cells = <1>;
        #size-cells = <0>;
        clock-frequency = <I2C_BITRATE_STANDARD>;
      };

      gpio_ext: sc18is604-gpio {
        compatible = "nxp,sc18is604-gpio";
        status = "okay";
        gpio-controller;
        #gpio-cells = <2>;
        ngpios = <5>;
      };
    };
  };

compatible: "nxp,sc18is604"

include: [spi-device.yaml]

properties:

  reset-gpios:
    type: phandle-array
    description: |
      Optional GPIO pin for chip reset.
      Example usage:
      reset-gpios = <&gpio0 14 GPIO_ACTIVE_LOW>;

  interrupt-gpios:
    required: true
    type: phandle-array
    description: |
      GPIO pin for interrupt request (mandatory for I2C controller).
      Example usage:
      interrupt-gpios = <&gpio0 15 GPIO_ACTIVE_LOW>;

bus: nxp,sc18is604
```

## dts/bindings/mfd/sipo-mux-gp-spi.yaml
```yaml
# Copyright (c) 2023 TiaC Systems
# SPDX-License-Identifier: Apache-2.0

description: |
  Generic latched SIPO/MUX GP matrix controller, SPI binding

  Driver bindings for controlling a latched SIPO/MUX General
  Purpose (GP) matrix with a SPI master.

  The SPI driver should be usable as long as a Zephyr SPI API
  driver is available for your board. Hardware specific tuning
  is required using these properties:

    - spi-max-frequency

compatible: "sipo-mux-gp-spi"

include: [spi-device.yaml, sipo-mux-gp.yaml]
```

## dts/bindings/mfd/sipo-mux-gp.yaml
```yaml
# Copyright (c) 2023 TiaC Systems
# SPDX-License-Identifier: Apache-2.0

description: |
  Generic latched SIPO/MUX GP matrix controller

  General Purpose (GP) matrix controller, implemented in software,
  using a latched serial-in-parallel-out shift register (SIPO) for
  the data (columns) and a multiplexing (MUX) X:1-of-2^X decoder
  for the addresses (rows).

                                           shift-width
                         ,----------------------´`----------------------,

                                data-width
                         ,----------´`----------,

                          0  1  2  3  4  5  6  7
                 +-----+  |  |  |  |  |  |  |  |
             A0 -+     +--<--<--<--<--<--<--<--<--0
             A1 -+ MUX |  |  |  |  |  |  |  |  |
                 |     +--<--<--<--<--<--<--<--<--1
                 | DEC |  |  |  |  |  |  |  |  |
                 |     +--<--<--<--<--<--<--<--<--2
                 | DRV |  |  |  |  |  |  |  |  |
                 |     +--<--<--<--<--<--<--<--<--3
                 +-----+  |  |  |  |  |  |  |  |
                        +-+--+--+--+--+--+--+--+--+--+--+--+--+--+--+--+--+
            SDI --------+ D0 D1 D2 D3 D4 D5 D6 D7 D8 D9 Da Db Dc Dd De Df +- SDO
            CLK --------+                                                 |
      (nCS)  LE --------+ SIPO shift register (DRV)                       |
            /OE --------+                                                 |
                        +-------------------------------------------------+

    - example for the MUX/DEC LED driver: Sunmoon SM5166P
    - example for the SIPO/SR LED driver: Sunmoon SM16106, SM16206, SM16306

properties:
  shift-width:
    type: int
    required: true
    enum:
      - 8
      - 16
      - 24
      - 32
    description: |
      Width of columns bits totally shifted out by the SIPO shift register.
      This value must be equal or greater then the data width.

  data-width:
    type: int
    required: true
    enum:
      - 8
      - 16
      - 24
      - 32
    description: |
      Width of columns data bits shifted out by the SIPO shift register and
      usable on hardware in reality.

  addr-gpios:
    type: phandle-array
    required: true
    description: |
      GPIO phandle and specifier for the pins connected to the rows
      address MUX decoder pins. At least one pin should be given for
      a single or two rows. Pins of multiples of two should be given
      for more rows.

  oe-gpios:
    type: phandle-array
    required: true
    description: |
      GPIO phandle and specifier for the pin connected to the columns
      data SIPO shift register's output enable pin. Exactly one pin
      should be given.

  refresh-time-us:
    type: int
    default: 1000
    description: |
      How often to iterate over the addresses and refresh the data
      signal lines.
```

## dts/bindings/pinctrl/wch,ch32x035-afio.yaml
```yaml
# Copyright (c) 2025 TiaC Systems
# Copyright (c) 2024 Michael Hope
# SPDX-License-Identifier: Apache-2.0

description: |
  WCH CH32X035 Alternate Function Input Output (AFIO) Controller

  Based on pincfg-node.yaml binding.

compatible: "wch,ch32x035-afio"

include: base.yaml

properties:
  reg:
    required: true

  "#address-cells":
    required: true
    const: 1

  "#size-cells":
    required: true
    const: 1

child-binding:
  description: |
    Each child node defines the configuration for a particular state.

  child-binding:
    description: |
      The grandchild nodes group pins that share the same pin configuration.

    include:
      - name: pincfg-node.yaml
        property-allowlist:
          - bias-high-impedance
          - bias-pull-up
          - bias-pull-down
          - drive-push-pull
          - drive-open-drain
          - output-high
          - output-low

    properties:
      slew-rate:
        type: string
        default: "max-speed-10mhz"
        enum:
          - "max-speed-10mhz"

      pinmux:
        required: true
        type: array
        description: |
          An array of pins sharing the same group properties. The pins should
          be defined using pre-defined macros.
```

## dts/bindings/pwm/pwm-nexus.yaml
```yaml
# Copyright (c) 2023 TiaC Systems
# SPDX-License-Identifier: Apache-2.0

# Common fields for PWM nexus nodes

properties:
  pwm-map:
    type: compound
    required: true

  pwm-map-mask:
    type: compound
    required: false

  pwm-map-pass-thru:
    type: compound
    required: false

  "#pwm-cells":
    type: int
    required: true
    description: Number of items to expect in a PWM specifier
```

## dts/bindings/rtc/maxim,ds3231-rtc.yaml
```yaml
# Copyright (c) 2024 TiaC Systems
# SPDX-License-Identifier: Apache-2.0

description: Maxim DS3231 RTC

compatible: "maxim,ds3231-rtc"

include: [rtc-device.yaml]
```

## dts/bindings/sensor/maxim,ds3231-temp.yaml
```yaml
# Copyright (c) 2024 TiaC Systems
# SPDX-License-Identifier: Apache-2.0

description: Digital Temperature Sensor inside Maxim DS3231 RTC

compatible: "maxim,ds3231-temp"

include: [sensor-device.yaml]
```

## dts/bindings/sensor/sensortek,stk8ba58.yaml
```yaml
# Copyright (c) 2025 TiaC Systems
# SPDX-License-Identifier: Apache-2.0

description: |
    Sensortek Technology STK8BA58 3-axis accelerometer

    When setting the odr and power-mode properties in a .dts or .dtsi file
    you may include stk8ba58.h and use the macros defined there.

    Example:
    #include <zephyr/dt-bindings/sensor/stk8ba58.h>

    stk8ba58: stk8ba58@18 {
      ...

      power-mode = <STK8BA58_DT_LOW_POWER_25ms>;
      odr = <STK8BA58_DT_ODR_250Hz>;
    };

compatible: "sensortek,stk8ba58"

include: [sensor-device.yaml, i2c-device.yaml]

properties:
  irq-gpios:
    type: phandle-array
    description: |
      INT1 pin

      This pin defaults to active high when produced by the sensor.
      The property value should ensure the flags properly describe
      the signal that is presented to the driver.

  range:
    type: int
    default: 2
    description: |
      Range in g. Default is power-up configuration, 2g (0.98 mg/LSB).

      - 8 # 8g (3.91 mg/LSB)
      - 4 # 4g (1.95 mg/LSB)
      - 2 # 2g (0.98 mg/LSB)

    enum: [8, 4, 2]

  power-mode:
    type: int
    default: 0
    description: |
      Specify the sensor power mode, the sleep duration.
      Default is power-normal mode.

      - 0 # STK8BA58_DT_POWER_NORMAL
      - 1 # STK8BA58_DT_LOW_POWER_0ms5
      - 2 # STK8BA58_DT_LOW_POWER_1ms
      - 3 # STK8BA58_DT_LOW_POWER_2ms
      - 4 # STK8BA58_DT_LOW_POWER_4ms
      - 5 # STK8BA58_DT_LOW_POWER_6ms
      - 6 # STK8BA58_DT_LOW_POWER_10ms
      - 7 # STK8BA58_DT_LOW_POWER_25ms
      - 8 # STK8BA58_DT_LOW_POWER_50ms
      - 9 # STK8BA58_DT_LOW_POWER_100ms
      - 10 # STK8BA58_DT_LOW_POWER_500ms
      - 11 # STK8BA58_DT_LOW_POWER_1000ms

    enum: [0, 1, 2, 3, 4, 5, 6, 7, 8, 9, 10, 11]

  odr:
    type: int
    default: 8
    description: |
      Specify the default output data rate expressed in samples
      per second (Hz). It is twice of the bandwidth (filtered).
      Off means unfiltered with maximum sample rate of 2000 Hz.
      Default is power-up configuration, filtered 2000 Hz.

      - 0 # STK8BA58_DT_ODR_OFF
      - 1 # STK8BA58_DT_ODR_15Hz63
      - 2 # STK8BA58_DT_ODR_31Hz25
      - 3 # STK8BA58_DT_ODR_62Hz5
      - 4 # STK8BA58_DT_ODR_125Hz
      - 5 # STK8BA58_DT_ODR_250Hz
      - 6 # STK8BA58_DT_ODR_500Hz
      - 7 # STK8BA58_DT_ODR_1000Hz
      - 8 # STK8BA58_DT_ODR_2000Hz

      NOTE: In low-power mode with sleep durations the ODR becomes
      non-linear. Here is an example for bandwidth of 1000 Hz.

      Duration  Actually ODR
      ========  ============
        0.5 ms      295 Hz
          1 ms      255 Hz
          2 ms      202 Hz
          4 ms      140 Hz
          6 ms      110 Hz
         10 ms       75 Hz
         25 ms       34 Hz
         50 ms       18 Hz
        100 ms       10 Hz
        500 ms        2 Hz
       1000 ms        1 Hz

    enum: [0, 1, 2, 3, 4, 5, 6, 7, 8]
```

## dts/bindings/serial/nxp,sc16is75x.yaml
```yaml
# Copyright (c) 2024 TiaC Systems
# SPDX-License-Identifier: Apache-2.0

description: UART controller part of an NXP SC16IS75x chip

compatible: "nxp,sc16is75x-uart"

include: [uart-controller.yaml]

on-bus: nxp,sc16is75x
```

## dts/bindings/serial/wch,ch32-uart.yaml
```yaml
# Copyright (c) 2025 TiaC Systems
# Copyright (c) 2024 Matthew Tran
# SPDX-License-Identifier: Apache-2.0

description: WCH CH32 Universal Asynchronous Receiver Transmitter (UART)

compatible: "wch,ch32-uart"

include: [uart-controller.yaml, pinctrl-device.yaml]

properties:
  reg:
    required: true

  clocks:
    required: true

  irq:
    type: array
    required: true

  pinctrl-0:
    required: true
```

## dts/bindings/stepper/drv84xx.yaml
```yaml
# SPDX-FileCopyrightText: Copyright (c) 2024 TiaC Systems
# SPDX-License-Identifier: Apache-2.0

description: |
  DRV84xx stepper motor driver.

compatible: "drv84xx"

properties:
  
  dir-gpios:
    required: true
    type: phandle-array
    description: Direction pin.

  step-gpios:
    required: true
    type: phandle-array
    description: Step pin.

  fault-gpios:
    type: phandle-array
    description: Fault pin.

  en-gpios:
    type: phandle-array
    description: Enable pin.

  sleep-gpios:
    type: phandle-array
    description: Sleep pin (active low).

  m0-gpios:
    type: phandle-array
    description: Microstep configuration pin 0.

  m1-gpios:
    type: phandle-array
    description: Microstep configuration pin 1.
  
  pwms:
    type: phandle-array
    description: Step pin, configured as pwm.
  

include: stepper-motor.yaml
```

## dts/bindings/stepper/dummy-steppers.yaml
```yaml
# SPDX-FileCopyrightText: Copyright (c) 2024 TiaC Systems
# SPDX-License-Identifier: Apache-2.0

description: "Dummy Stepper"

compatible: "dummy-steppers"

include: stepper-motor.yaml
```

## dts/bindings/stepper/gpio-stepper.yaml
```yaml
# SPDX-FileCopyrightText: Copyright (c) 2024 Carl Zeiss Meditec AG
# SPDX-FileCopyrightText: Copyright (c) 2024 TiaC Systems
# SPDX-License-Identifier: Apache-2.0

description: GPIO driven stepper motor

compatible: "gpio-stepper"

include: stepper-motor.yaml

properties:
  gpios:
    type: phandle-array
    required: true
    description: |
      The gpio pin array on which the stepper driver inputs are
      to be connected.

      Here is an example which defines one stepper motor:

      / {
              gpio_stepper {
                      compatible = "gpio-stepper";
                      status = "okay";
                      gpios = <&gpioa 9 GPIO_ACTIVE_HIGH>,
                              <&gpioc 7 GPIO_ACTIVE_HIGH>,
                              <&gpiob 0 GPIO_ACTIVE_HIGH>,
                              <&gpioa 7 GPIO_ACTIVE_HIGH>;
              };
      };
```
