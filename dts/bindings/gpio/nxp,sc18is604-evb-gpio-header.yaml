## dts/bindings/gpio/nxp,sc18is604-evb-gpio-header.yaml
```yaml
# Copyright (c) 2024 TiaC Systems
# SPDX-License-Identifier: Apache-2.0

description: |
    GPIO pins exposed on an NXP SC18IS604-EVB.

    The SC18IS604-EVB features four separate headers, one of which is a
    jumper array. The GPIO interface described by this binding comprises
    the pins exposed on header JP2, on pins 1 through 5 (pin 6 is wired
    to GND).

          .------------------------------------------------.
          | .-.         ___                                |
        - | |o| SCL   –|   |–     __                       |
        - | |o| GND   –|   |–   =|  |=              _____  |
        - | |o| VCC   –|   |–   =|__|=             |  _  | |
        - | |o| SDA   –|___|–     U5               | |_| | |
          | `-´         U4        (PWM)            |_____| |
          | JP4         (EEPROM)  _  _  _  _        SW1    |
          | (I2C)                |_||_||_||_|      (RESET) |
          |              PWM-LED: 0  1  2  3               |
          |            .---.                               |
          |            |o o| RESET_B <–––––––––––––––––––––| -
          |            |o-o| INT_B                     .-. |
          | .-.        |o-o| IO3      _____      INT_B |o| | -
        - | |o| GND    |o-o| VCC     |     |       GND |o| | -
        4 | |o| IO4    `---´         | 604 |      SCLK |o| | -
        3 | |o| IO3     JP5          |_____|      MOSI |o| | -
        2 | |o| IO2     (array)       U6          MISO |o| | -
        1 | |o| IO1                   (bridge)    CS_B |o| | -
        0 | |o| IO0               _  _  _  _  _    VCC |o| | -
          | `-´                  |_||_||_||_||_|       `-´ |
          | JP2 (GPIO)  GPIO-LED: 4  3  2  1  0  (HIF) JP1 |
          `------------------------------------------------´

compatible: "nxp,sc18is604-evb-gpio-header"

include: [base.yaml, gpio-nexus.yaml]
```

## dts/bindings/gpio/nxp,sc18is604-evb-hif-header.yaml
```yaml
# Copyright (c) 2024 TiaC Systems
# SPDX-License-Identifier: Apache-2.0

description: |
    Host interface exposed on NXP SC18IS604-EVB board headers.

    The SC18IS604-EVB features four separate headers, one of which is
    a jumper array. The host interface (HIF) described by this binding
    comprises the header JP1 (pins 1 through 7), as well as pin 7 of the
    jumper array JP5, which exposes the SC18IS604's reset pin.

          .------------------------------------------------.
          | .-.         ___                                |
        - | |o| SCL   –|   |–     __                       |
        - | |o| GND   –|   |–   =|  |=              _____  |
        - | |o| VCC   –|   |–   =|__|=             |  _  | |
        - | |o| SDA   –|___|–     U5               | |_| | |
          | `-´         U4        (PWM)            |_____| |
          | JP4         (EEPROM)  _  _  _  _        SW1    |
          | (I2C)                |_||_||_||_|      (RESET) |
          |              PWM-LED: 0  1  2  3               |
          |            .---.                               |
          |            |o o| RESET_B <–––––––––––––––––––––| 0
          |            |o-o| INT_B                     .-. |
          | .-.        |o-o| IO3      _____      INT_B |o| | 1
        - | |o| GND    |o-o| VCC     |     |       GND |o| | -
        - | |o| IO4    `---´         | 604 |      SCLK |o| | 2
        - | |o| IO3     JP5          |_____|      MOSI |o| | 3
        - | |o| IO2     (array)       U6          MISO |o| | 4
        - | |o| IO1                   (bridge)    CS_B |o| | 5
        - | |o| IO0               _  _  _  _  _    VCC |o| | -
          | `-´                  |_||_||_||_||_|       `-´ |
          | JP2 (GPIO)  GPIO-LED: 4  3  2  1  0  (HIF) JP1 |
          `------------------------------------------------´

compatible: "nxp,sc18is604-evb-hif-header"

include: [base.yaml, gpio-nexus.yaml]
```

## dts/bindings/gpio/seeed,grove-connector.yaml
```yaml
# Copyright (c) 2023 TiaC Systems
# SPDX-License-Identifier: Apache-2.0

description: |
    GPIO pins exposed on Seeed Studio Grove connector.

    The Grove layout provides an 4-pin 2mm proprietary connector, along on
    one edge of the board. Informations and pin assignment can be found at:

    - https://wiki.seeedstudio.com/Grove_System
    - https://wiki.sipeed.com/soft/maixpy/en/modules/grove
    - https://lesporteslogiques.net/wiki/materiel/systeme_grove#brochage
    - https://learn.adafruit.com/introducing-adafruit-stemma-qt/seeed-studio-grove

    This binding provides a nexus mapping for 2 pins where parent
    pins 0 through 1 correspond as depicted below (with cable color):

        4-pin      analog  digital  UART   I2C                  (SPI)

        (yellow) 0 An      Dn       RX     SCL                0 (SCK)
         (white) 1 An+1    Dn+1     TX     SDA                1 (MISO)
           (red) - VCC     VCC      VCC    VCC  (3V3 or 5V0)  2 (MOSI)
         (black) - GND     GND      GND    GND                3 (SS)

compatible: "seeed,grove-connector"

include: [gpio-nexus.yaml, base.yaml]
```

## dts/bindings/gpio/sipo-mux-gpio.yaml
```yaml
# Copyright (c) 2023 TiaC Systems
# SPDX-License-Identifier: Apache-2.0

description: Generic latched SIPO/MUX GPIO Controller

compatible: "sipo-mux-gpio"

include: [gpio-controller.yaml, base.yaml]

gpio-cells:
  - pin
  - flags

properties:
  offset:
    type: int
    default: 0
    description: |
      This property indicates the number of alway in-use slots of available
      slots for GPIOs in the underlying SIPO/MUX GP Controller instance
      by any GPIO previous declared nodes of this same class. The typical
      example is something like this: the first node has register 32 GPIOs
      with "ngpios = <32>;" and "offset = <0>;", the second node then have
      to register their 32 GPIOs with "ngpios = <32>;" and "offset = <32>;"
      and the third node with "ngpios = <32>;" and "offset = <64>;" and so on.
```

## dts/bindings/gpio/st,mems-dil24-socket.yaml
```yaml
# Copyright (c) 2023 TiaC Systems
# SPDX-License-Identifier: Apache-2.0

description: |
    GPIO pins exposed on STMicroelectronics MEMS (DIL24) socket.

    The ST Micro Electronic Mechanical Systems (MEMS) layout provides
    one standard DIL24 socket for additional MEMS adapters and other
    sensors with I2C or SPI connectivity.

    Proceeding counter-clockwise:
    * The first two pins for common power supply. No pins on this header
      are exposed by this binding.
    * A 10-pin row with analog inputs follows.
    * A 11-pin row with digital in-/outputs along opposite side.

    This binding provides a nexus mapping for 21 pins where parent
    pins 0 through 9 correspond to A0 through A9, and parent pins 10
    through 20 correspond to D0 through D10, as depicted below:

                     .---._.---.
    (3V3)     VDD  - o *       o 20  D10 <-> (INT5_Pin24 / SCx/SCL  / GP)
    (3V3)  VDD_IO  - o         o 19  D9  <-> (SA0/DEN    / GPIO3    / HP)
    (CSx)  <-- A0  0 o         o 18  D8  <-> (SA0/DRDY   / SPI_MISO / SDO)
    (SCx)  <-- A1  1 o         o 17  D7  <-> (I2C_SDA    / SPI_MOSI / SDI)
    (SDx)  <-- A2  2 o         o 16  D6  <-> (I2C_SCL    / SPI_CK   / SDC)
    (SDOx) <-- A3  3 o         o 15  D5  <-> (CS1_Pin19  / SPI_CS   / SCS)
    (N/C)  <-- A4  4 o         o 14  D4  <-> (CS2_Pin18  / CSx      / PD)
    (N/C)  <-- A5  5 o         o 13  D3  <-> (INT4_Pin17 / SDx/SDA  / FS)
    (N/C)  <-- A6  6 o         o 12  D2  <-> (INT3_Pin16 / SDOx     / ST)
    (N/C)  <-- A7  7 o         o 11  D1  <-> (INT2       / GPIO2)
    (N/C)  <-- A8  8 o         o 10  D0  <-> (INT1       / GPIO1)
    (N/C)  <-- A9  9 o         o -   GND
                     `---------´

    Additional information about the pinout can be found in the
    following ST User Manuals:
    * UM1820: X-NUCLEO-IKS01A1 shield
    * UM2121: X-NUCLEO-IKS01A2 shield
    * UM2559: X-NUCLEO-IKS01A3 shield
    * UM2633: X-NUCLEO-IKS02A1 shield
    * DB1134: STEVAL-MKI015V1 adapter board (LIS344ALH)
    * DB1014: STEVAL-MKI089V1 adapter board (LIS331DLH)
    * DB1288: STEVAL-MKI105V1 adapter board (LIS3DH)
    * DB1401: STEVAL-MKI106V1 adapter board (LSM303DLHC)
    * DB1602: STEVAL-MKI107V2 adapter board (L3GD20)
    * DB1475: STEVAL-MKI109V2 motherboard (STM32F103RE)
    * DB2985: STEVAL-MKI109V3 motherboard (STM32F401VE)
    * DB1272: STEVAL-MKI110V1 adapter board (AIS328DQ)
    * DB1624: STEVAL-MKI122V1 adapter board (LSM330DLC)
    * DB1625: STEVAL-MKI123V1 adapter board (LSM330D)
    * DB1935: STEVAL-MKI125V1 adapter board (A3G4250D)
    * DB1903: STEVAL-MKI133V1 adapter board (LSM303D)
    * DB1902: STEVAL-MKI134V1 adapter board (LIS3DSH)
    * DB1991: STEVAL-MKI135V1 adapter board (LIS2DH)
    * DB1992: STEVAL-MKI137V1 adapter board (LIS3MDL)
    * DB2266: STEVAL-MKI141V2 adapter board (HTS221)
    * DB2130: STEVAL-MKI142V1 adapter board (LPS25H)
    * DB2509: STEVAL-MKI158V1 adapter board (AIS3624DQ)
    * DB2533: STEVAL-MKI159V1 adapter board (LSM9DS1)
    * DB2534: STEVAL-MKI160V1 adapter board (LSM6DS3)
    * DB2537: STEVAL-MKI164V1 adapter board (LIS2HH12)
    * DB3072: STEVAL-MKI173V1 adapter board (LSM303AH)
    * DB3067: STEVAL-MKI174V1 adapter board (LIS2DS12)
    * DB3059: STEVAL-MKI175V1 adapter board (LIS2DE12)
    * DB3060: STEVAL-MKI176V1 adapter board (LSM6DS3H)
    * DB3056: STEVAL-MKI177V1 adapter board (LPS35HW)
    * DB3073: STEVAL-MKI178V1 adapter board (LSM6DSL)
    * DB3511: STEVAL-MKI178V2 adapter board (LSM6DSL)
    * DB3352: STEVAL-MKI181V1 adapter board (LIS2MDL)
    * DB3353: STEVAL-MKI182V1 adapter board (ISM330DLC)
    * DB3610: STEVAL-MKI182V2 adapter board (ISM330DLC)
    * DB3463: STEVAL-MKI183V1 adapter board (LPS33HW)
    * DB3481: STEVAL-MKI184V1 adapter board (ISM303DAC)
    * DB3484: STEVAL-MKI185V1 adapter board (IIS2MDC)
    * DB3616: STEVAL-MKI189V1 adapter board (LSM6DSM)
    * DB3686: STEVAL-MKI192V1 adapter board (LPS22HH)
    * DB3687: STEVAL-MKI193V1 adapter board (ASM330LHH)
    * DB3689: STEVAL-MKI194V1 adapter board (LSM6DSR)
    * DB3693: STEVAL-MKI195V1 adapter board (LSM6DSRX)
    * DB3714: STEVAL-MKI196V1 adapter board (LSM6DSO)
    * DB3721: STEVAL-MKI197V1 adapter board (LSM6DSOX)
    * DB3859: STEVAL-MKI205V1 adapter board (LPS33W)
    * DB4011: STEVAL-MKI207V1 adapter board (ISM330DHCX)
    * DB4044: STEVAL-MKI213V1 adapter board (LPS27HHW)
    * DB4223: STEVAL-MKI214V1 adapter board (LPS33K)
    * DB4222: STEVAL-MKI215V1 adapter board (LSM6DSO32)
    * DB4336: STEVAL-MKI217V1 adapter board (LSM6DSOX and LIS2MDL)
    * DB4406: STEVAL-MKI219V1 adapter board (LPS22CH)
    * DB4371: STEVAL-MKI220V1 adapter board (LPS27HHTW)
    * DB4648: STEVAL-MKI224V1 adapter board (LPS22DF)
    * DB4686: STEVAL-MKI225A adapter board (LPS28DFW)

compatible: "st,mems-dil24-socket"

include: [gpio-nexus.yaml, base.yaml]
```

## dts/bindings/gpio/waveshare,rp2040mini-header.yaml
```yaml
# Copyright (c) 2023 TiaC Systems
# SPDX-License-Identifier: Apache-2.0

description: |
    GPIO pins exposed on Waveshare RP2040 Mini headers.

    The RP2040 Mini layout provides a wraparound header on all freely
    accessible edges of the board and can be divided into three sections,
    two headers on the longer opposite sides and one header opposite the
    USB-C socket.

    Proceeding clockwise:
    * A 9-pin header. 9 pins on this header are exposed by this binding.
    * A 5-pin header. 5 pins on this header are exposed by this binding.
    * A 9-pin header. 6 pins on this header are exposed by this binding.

    This binding provides a nexus mapping for 20 pins where parent pins 17
    through 20 correspond to ADC0 through ADC3, and parent pins 0 through 19
    correspond as depicted below:

                  .---------.
          .-------|         |-------.
          |       |  USB-C  |       |
          |       `---------´       |
          |                         |
        - 5V                      GP0 0
        - GND                     GP1 1
        - 3V3                     GP2 2
       19 ADC3/GP29               GP3 3
       18 ADC2/GP28               GP4 4
       17 ADC1/GP27               GP5 5
       16 ADC0/GP26               GP6 6
       15 GP15                    GP7 7
       14 GP14                    GP8 8
          |                         |
          `-GP13-GP12-GP11-GP10-GP9-´
             13   12   11   10   9

compatible: "waveshare,rp2040mini-header"

include: [gpio-nexus.yaml, base.yaml]
```

## dts/bindings/gpio/waveshare,rp2040mini-pcbpads.yaml
```yaml
# Copyright (c) 2023 TiaC Systems
# SPDX-License-Identifier: Apache-2.0

description: |
    GPIO pins exposed on Waveshare RP2040 Mini solder pads.

    The RP2040 Mini layout provides a line of ten solder pads on the
    bottom side of the board.

    This binding provides a nexus mapping for 9 pads where parent pins 0
    through 8 correspond as depicted below:

                  .---------.
          --------|         |--------
          |       |  USB-C  |       |
          |       `---------´       |
          |                         |
          ]                 - GND   [
          ]                 8 GP25  [
          ]                 7 GP24  [
          ]                 6 GP23  [
          ]                 5 GP22  [
          ]                 4 GP21  [
          ]                 3 GP20  [
          ]                 2 GP19  [
          ]                 1 GP18  [
          |                 0 GP17  |
          `-------------------------´

compatible: "waveshare,rp2040mini-pcbpads"

include: [gpio-nexus.yaml, base.yaml]
```

## dts/bindings/gpio/wch,ch32-gpio.yaml
```yaml
# Copyright (c) 2025 TiaC Systems
# Copyright (c) 2024 Matthew Tran
# SPDX-License-Identifier: Apache-2.0

description: CH32 GPIO node

compatible: "wch,ch32-gpio"

include: [gpio-controller.yaml, base.yaml]

properties:
  clk:
    type: array
    required: true

  "#gpio-cells":
    const: 2

gpio-cells:
  - pin
  - flags
```

## dts/bindings/i2c/nxp,sc18is604-i2c.yaml
```yaml
# Copyright (c) 2024 TiaC Systems
# SPDX-License-Identifier: Apache-2.0

description: I2C controller part of an SC18IM604 bridge

compatible: "nxp,sc18is604-i2c"

include: [i2c-controller.yaml]

on-bus: nxp,sc18is604
```

## dts/bindings/mfd/nxp,sc16is75x-common.yaml
```yaml
# Copyright (c) 2024 TiaC Systems
# SPDX-License-Identifier: Apache-2.0

description: NXP SC16IS75x UART/GPIO chip common properties

include: base.yaml

properties:

  reset-gpios:
    required: true
    type: phandle-array
    description: Reset pin.

  interrupt-gpios:
    type: phandle-array
    description: Interrupt pin.

  clock:
    required: true
    type: phandle

  "#address-cells":
    required: true
    const: 1

  "#size-cells":
    required: true
    const: 0

bus: nxp,sc16is75x
```

## dts/bindings/mfd/nxp,sc16is75x-i2c.yaml
```yaml
# Copyright (c) 2024 TiaC Systems
# SPDX-License-Identifier: Apache-2.0

description: NXP SC16IS75x UART/GPIO chip via I2C bus

compatible: "nxp,sc16is75x"

include: ["i2c-device.yaml", "nxp,sc16is75x-common.yaml"]
```

## dts/bindings/mfd/nxp,sc16is75x-spi.yaml
```yaml
# Copyright (c) 2024 TiaC Systems
# SPDX-License-Identifier: Apache-2.0

description: NXP SC16IS75x UART/GPIO chip via SPI bus

compatible: "nxp,sc16is75x"

include: ["spi-device.yaml", "nxp,sc16is75x-common.yaml"]
```
