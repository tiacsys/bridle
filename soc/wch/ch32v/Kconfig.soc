## tests/shields/x_grove_testbed/dts_bindings/testcase.yaml
```yaml
##############################################################################
###
### ATTENTION:
###
### This test suite will be controlled by the standard integration platforms
### and must be invoked with the corresponding quarantine list. Otherwise,
### many board-shield constellations will terminate with an error.
###
###     west twister -G --quarantine-list bridle/tests/quarantine.yaml … … …
###
##############################################################################
common:
  tags:
    - base
    - shields
    - grove
  sysbuild: false
  build_only: true
  build_on_all: true
  filter: dt_compat_enabled("seeed,grove-laced-if") and
          dt_compat_enabled("seeed,grove-connector")
  # platform_exclude:
  #
  # AVOID `platform_exclude` statement here in the `common` section!
  #   USE the `tests/quarantine.yaml`file instead.
  #
  integration_platforms:
    - arduino_zero
    - cytron_maker_nano_rp2040
    - cytron_maker_pi_rp2040
    - mimxrt1010_evk
    - mimxrt1060_evk/mimxrt1062/hyperflash
    - mimxrt1060_evk@A/mimxrt1062/qspi
    - mimxrt1060_evk@B/mimxrt1062/qspi
    - mimxrt1060_evk@C/mimxrt1062/qspi
    - nucleo_f303re
    - nucleo_f401re
    - nucleo_f413zh
    - nucleo_f746zg
    - nucleo_f767zi
    - rpi_pico
    - rpi_pico/rp2040/w
    - seeeduino_cm0
    - seeeduino_lotus
    - seeeduino_xiao
    - xiao_samd21
    - waveshare_rp2040_one
    - waveshare_rp2040_zero
    - waveshare_rp2040_matrix
    - waveshare_rp2040_tiny
    - waveshare_rp2040_eth
    - waveshare_rp2040_lcd_0_96
    - waveshare_rp2040_plus
    - waveshare_rp2040_plus@16mb
tests:
  grove.base.v2.x_grove_testbed.gpio.b4l6:
    depends_on: arduino_gpio
    filter: dt_nodelabel_enabled("grove_d4_header") and
            dt_label_with_parent_compat_enabled("grove_btn_d4", "gpio-keys") and
            dt_nodelabel_enabled("grove_d6_header") and
            dt_label_with_parent_compat_enabled("grove_led_d6", "gpio-leds")
    extra_args:
      SHIELD=seeed_grove_base_v2;grove_btn_d4;grove_led_d6;x_grove_testbed
    platform_allow:
      - mimxrt1010_evk
      - mimxrt1060_evk/mimxrt1062/hyperflash
      - mimxrt1060_evk@A/mimxrt1062/qspi
      - mimxrt1060_evk@B/mimxrt1062/qspi
      - mimxrt1060_evk@C/mimxrt1062/qspi
  grove.base.v2.x_grove_testbed.pwm.b4l6:
    depends_on: arduino_gpio
    filter: dt_nodelabel_enabled("grove_d4_header") and
            dt_label_with_parent_compat_enabled("grove_btn_d4", "gpio-keys") and
            dt_nodelabel_enabled("grove_d6_header") and
            dt_label_with_parent_compat_enabled("grove_pwm_led_d6", "pwm-leds") and
            dt_label_with_parent_compat_enabled("grove_led_d6", "gpio-leds")
    extra_args:
      SHIELD=seeed_grove_base_v2;grove_btn_d4;grove_led_d6;grove_pwm_led_d6;x_grove_testbed
    platform_allow:
      - nucleo_f303re
      - nucleo_f401re
      - nucleo_f413zh
      - nucleo_f767zi
  grove.base.v2.x_grove_testbed.pwm.b7l6:
    depends_on: arduino_gpio
    filter: dt_nodelabel_enabled("grove_d6_header") and
            dt_label_with_parent_compat_enabled("grove_pwm_led_d6", "pwm-leds") and
            dt_label_with_parent_compat_enabled("grove_led_d6", "gpio-leds") and
            dt_nodelabel_enabled("grove_d7_header") and
            dt_label_with_parent_compat_enabled("grove_btn_d7", "gpio-keys")
    extra_args:
      SHIELD=seeed_grove_base_v2;grove_btn_d7;grove_led_d6;grove_pwm_led_d6;x_grove_testbed
    platform_allow:
      - arduino_zero
      - seeeduino_cm0
      - seeeduino_lotus
  grove.xiao.v1.x_grove_testbed.pwm.b0l1:
    depends_on: xiao_gpio
    filter: dt_nodelabel_enabled("grove_d1_header") and
            dt_label_with_parent_compat_enabled("grove_pwm_led_d1", "pwm-leds") and
            dt_label_with_parent_compat_enabled("grove_led_d1", "gpio-leds") and
            dt_nodelabel_enabled("grove_d0_header") and
            dt_label_with_parent_compat_enabled("grove_btn_d0", "gpio-keys")
    extra_args:
      SHIELD=seeed_grove_xiao_v1;grove_btn_d0;grove_led_d1;grove_pwm_led_d1;x_grove_testbed
    platform_allow:
      - seeeduino_xiao
      - xiao_samd21
  grove.rpipico.v1.x_grove_testbed.pwm.b16l18:
    depends_on: pico_gpio
    filter: dt_nodelabel_enabled("grove_d18_header") and
            dt_label_with_parent_compat_enabled("grove_pwm_led_d18", "pwm-leds") and
            dt_label_with_parent_compat_enabled("grove_led_d18", "gpio-leds") and
            dt_nodelabel_enabled("grove_d16_header") and
            dt_label_with_parent_compat_enabled("grove_btn_d16", "gpio-keys")
    extra_args:
      SHIELD=seeed_grove_rpipico_v1;grove_btn_d16;grove_led_d18;grove_pwm_led_d18;x_grove_testbed
    platform_allow:
      - rpi_pico
      - rpi_pico/rp2040/w
      - waveshare_rp2040_lcd_0_96
      - waveshare_rp2040_plus
      - waveshare_rp2040_plus@16mb
  grove.connectors.x_grove_testbed.pwm.b0l15:
    depends_on:
      - grove_gpio
      - grove_pwm
    filter: dt_nodelabel_enabled("grove_d15_header") and
            dt_label_with_parent_compat_enabled("grove_pwm_led_d15", "pwm-leds") and
            dt_label_with_parent_compat_enabled("grove_led_d15", "gpio-leds") and
            dt_nodelabel_enabled("grove_d0_header") and
            dt_label_with_parent_compat_enabled("grove_btn_d0", "gpio-keys")
    extra_args:
      SHIELD=grove_btn_d0;grove_led_d15;grove_pwm_led_d15;x_grove_testbed
    platform_allow:
      - cytron_maker_nano_rp2040
  grove.connectors.x_grove_testbed.pwm.b3l5:
    depends_on:
      - grove_gpio
      - grove_pwm
    filter: dt_nodelabel_enabled("grove_d5_header") and
            dt_label_with_parent_compat_enabled("grove_pwm_led_d5", "pwm-leds") and
            dt_label_with_parent_compat_enabled("grove_led_d5", "gpio-leds") and
            dt_nodelabel_enabled("grove_d3_header") and
            dt_label_with_parent_compat_enabled("grove_btn_d3", "gpio-keys")
    extra_args:
      SHIELD=grove_btn_d3;grove_led_d5;grove_pwm_led_d5;x_grove_testbed
    platform_allow:
      - cytron_maker_pi_rp2040
  grove.connectors.x_grove_testbed.pwm.b7l6:
    depends_on:
      - grove_gpio
      - grove_pwm
    filter: dt_nodelabel_enabled("grove_d6_header") and
            dt_label_with_parent_compat_enabled("grove_pwm_led_d6", "pwm-leds") and
            dt_label_with_parent_compat_enabled("grove_led_d6", "gpio-leds") and
            dt_nodelabel_enabled("grove_d7_header") and
            dt_label_with_parent_compat_enabled("grove_btn_d7", "gpio-keys")
    extra_args:
      SHIELD=grove_btn_d7;grove_led_d6;grove_pwm_led_d6;x_grove_testbed
    platform_allow:
      - seeeduino_lotus
```

## tests/snippets/usb-console/build_all/boards/magpie_f777ni.conf
```kconfig
# Copyright (c) 2025 TiaC Systems
# SPDX-License-Identifier: Apache-2.0

CONFIG_TEST_CHOSEN_ZEPHYR_SHELL_UART=y

# STMicroelectronics @ TiaC Magpie F777NI
CONFIG_TEST_EXPECTED_CDC_ACM_SERIAL_VID=0x0483
CONFIG_TEST_EXPECTED_CDC_ACM_SERIAL_PID=0x5740
CONFIG_TEST_EXPECTED_CDC_ACM_SERIAL_MANUFACTURER_STRING="STMicroelectronics"
CONFIG_TEST_EXPECTED_CDC_ACM_SERIAL_PRODUCT_STRING="TiaC Magpie F777NI (CDC ACM)"
CONFIG_TEST_EXPECTED_CDC_ACM_SERIAL_SELF_POWERED=y
CONFIG_TEST_EXPECTED_CDC_ACM_SERIAL_MAX_POWER=0
```

## tests/snippets/usb-console/build_all/boards/mimxrt1010_evk.conf
```kconfig
# Copyright (c) 2025 TiaC Systems
# SPDX-License-Identifier: Apache-2.0

CONFIG_TEST_CHOSEN_ZEPHYR_SHELL_UART=y

# NXP @ MIMXRT1010-EVK (MIMXRT1011DAE5A)
CONFIG_TEST_EXPECTED_CDC_ACM_SERIAL_VID=0x1fc9
CONFIG_TEST_EXPECTED_CDC_ACM_SERIAL_PID=0x1011
CONFIG_TEST_EXPECTED_CDC_ACM_SERIAL_MANUFACTURER_STRING="NXP"
CONFIG_TEST_EXPECTED_CDC_ACM_SERIAL_PRODUCT_STRING="MIMXRT1010-EVK (CDC ACM)"
CONFIG_TEST_EXPECTED_CDC_ACM_SERIAL_SELF_POWERED=y
CONFIG_TEST_EXPECTED_CDC_ACM_SERIAL_MAX_POWER=0
```

## tests/snippets/usb-console/build_all/boards/mimxrt1060_evk_mimxrt1062_qspi.conf
```kconfig
# Copyright (c) 2025 TiaC Systems
# SPDX-License-Identifier: Apache-2.0

CONFIG_TEST_CHOSEN_ZEPHYR_SHELL_UART=y

# NXP @ MIMXRT1060-EVK (MIMXRT1062DVL6A)
CONFIG_TEST_EXPECTED_USB_DEVICE_VID=0x1fc9
CONFIG_TEST_EXPECTED_USB_DEVICE_PID=0x1062
CONFIG_TEST_EXPECTED_USB_DEVICE_MANUFACTURER="NXP"
CONFIG_TEST_EXPECTED_USB_DEVICE_PRODUCT="MIMXRT1060-EVK (CDC ACM)"
```

## tests/snippets/usb-console/build_all/boards/mini_usb_rp2040.conf
```kconfig
# Copyright (c) 2025 TiaC Systems
# SPDX-License-Identifier: Apache-2.0

CONFIG_TEST_CHOSEN_ZEPHYR_SHELL_UART=y

# Nologo @ Mini USB RP2040
CONFIG_TEST_EXPECTED_USB_DEVICE_VID=0x2E8A
CONFIG_TEST_EXPECTED_USB_DEVICE_PID=0x000A
CONFIG_TEST_EXPECTED_USB_DEVICE_MANUFACTURER="Nologo (Raspberry Pi)"
CONFIG_TEST_EXPECTED_USB_DEVICE_PRODUCT="Mini USB RP2040 (CDC ACM)"
```

## tests/snippets/usb-console/build_all/boards/mini_usb_rp2350_rp2350a_m33.conf
```kconfig
# Copyright (c) 2025 TiaC Systems
# SPDX-License-Identifier: Apache-2.0

CONFIG_TEST_CHOSEN_ZEPHYR_SHELL_UART=y

# Nologo @ Mini USB RP2350
CONFIG_TEST_EXPECTED_CDC_ACM_SERIAL_VID=0x2E8A
CONFIG_TEST_EXPECTED_CDC_ACM_SERIAL_PID=0x000A
CONFIG_TEST_EXPECTED_CDC_ACM_SERIAL_MANUFACTURER_STRING="Nologo (Raspberry Pi)"
CONFIG_TEST_EXPECTED_CDC_ACM_SERIAL_PRODUCT_STRING="Mini USB RP2350 (CDC ACM)"
CONFIG_TEST_EXPECTED_CDC_ACM_SERIAL_SELF_POWERED=n
CONFIG_TEST_EXPECTED_CDC_ACM_SERIAL_MAX_POWER=125
```

## tests/snippets/usb-console/build_all/boards/nucleo_f767zi.conf
```kconfig
# Copyright (c) 2025 TiaC Systems
# SPDX-License-Identifier: Apache-2.0

CONFIG_TEST_CHOSEN_ZEPHYR_SHELL_UART=y

# STMicroelectronics @ STM32F767ZI-NUCLEO (STM32F767ZI)
CONFIG_TEST_EXPECTED_CDC_ACM_SERIAL_VID=0x0483
CONFIG_TEST_EXPECTED_CDC_ACM_SERIAL_PID=0x5740
CONFIG_TEST_EXPECTED_CDC_ACM_SERIAL_MANUFACTURER_STRING="STMicroelectronics"
CONFIG_TEST_EXPECTED_CDC_ACM_SERIAL_PRODUCT_STRING="STM32F767ZI-NUCLEO (CDC ACM)"
CONFIG_TEST_EXPECTED_CDC_ACM_SERIAL_SELF_POWERED=y
CONFIG_TEST_EXPECTED_CDC_ACM_SERIAL_MAX_POWER=0
```

## tests/snippets/usb-console/build_all/boards/nucleo_l496zg_bbe.conf
```kconfig
# Copyright (c) 2026 TiaC Systems
# SPDX-License-Identifier: Apache-2.0

CONFIG_TEST_CHOSEN_ZEPHYR_SHELL_UART=y

# STMicroelectronics @ STM32L496ZG-NUCLEO (STM32L496ZG)
CONFIG_TEST_EXPECTED_CDC_ACM_SERIAL_VID=0x0483
CONFIG_TEST_EXPECTED_CDC_ACM_SERIAL_PID=0x5740
CONFIG_TEST_EXPECTED_CDC_ACM_SERIAL_MANUFACTURER_STRING="STMicroelectronics"
CONFIG_TEST_EXPECTED_CDC_ACM_SERIAL_PRODUCT_STRING="STM32L496ZG-NUCLEO (CDC ACM)"
CONFIG_TEST_EXPECTED_CDC_ACM_SERIAL_SELF_POWERED=y
CONFIG_TEST_EXPECTED_CDC_ACM_SERIAL_MAX_POWER=0
```

## tests/snippets/usb-console/build_all/boards/picoboy.conf
```kconfig
# Copyright (c) 2025 TiaC Systems
# SPDX-License-Identifier: Apache-2.0

CONFIG_TEST_CHOSEN_ZEPHYR_SHELL_UART=y

# JSED @ PicoBoy
CONFIG_TEST_EXPECTED_CDC_ACM_SERIAL_VID=0x2E8A
CONFIG_TEST_EXPECTED_CDC_ACM_SERIAL_PID=0x000A
CONFIG_TEST_EXPECTED_CDC_ACM_SERIAL_MANUFACTURER_STRING="JSED (Raspberry Pi)"
CONFIG_TEST_EXPECTED_CDC_ACM_SERIAL_PRODUCT_STRING="PicoBoy (CDC ACM)"
CONFIG_TEST_EXPECTED_CDC_ACM_SERIAL_SELF_POWERED=n
CONFIG_TEST_EXPECTED_CDC_ACM_SERIAL_MAX_POWER=125
```
