## soc/wch/ch32v/Kconfig.soc
```kconfig
# WinChipHead CH32V MCU line

# Copyright (c) 2025 TiaC Systems
# SPDX-License-Identifier: Apache-2.0

rsource "*/Kconfig.soc"
```

## soc/wch/ch32v/qingke-v4c/Kconfig.defconfig
```kconfig
# WinChipHead QingKe RISC-V4C MCU line

# Copyright (c) 2025 TiaC Systems
# SPDX-License-Identifier: Apache-2.0

# Kconfig symbols common to QingKe RISC-V4C series

if SOC_SERIES_QINGKE_V4C

rsource "Kconfig.defconfig.*"

endif # SOC_SERIES_QINGKE_V4C
```

## soc/wch/ch32v/qingke-v4c/Kconfig.defconfig.ch32x035
```kconfig
# WinChipHead CH32X035 MCU configuration options

# Copyright (c) 2025 TiaC Systems
# SPDX-License-Identifier: Apache-2.0

if SOC_CH32X035

config VECTOR_TABLE_SIZE
	default 55

config NUM_IRQS
	default 128

endif # SOC_CH32X035
```

## soc/wch/ch32v/qingke-v4c/Kconfig.soc.ch32x035
```kconfig
# WinChipHead CH32X035 MCU line

# Copyright (c) 2025 TiaC Systems
# SPDX-License-Identifier: Apache-2.0

config SOC_CH32X035
	bool
	select SOC_SERIES_QINGKE_V4C

config SOC
	default "ch32x035" if SOC_CH32X035
```

## subsys/shell/modules/Kconfig.commands
```kconfig
# Copyright (c) 2021 TiaC Systems
# Copyright (c) 2019-2021 Li-Pro.Net
# SPDX-License-Identifier: Apache-2.0

menuconfig BRIDLE_COMMANDS
	bool "Bridle Shell Commands"
	depends on SHELL
	default n

if BRIDLE_COMMANDS

config BRIDLE_CMD_HELLO
	bool "Simple hello from shell"
	default y if BRIDLE_COMMANDS
	default n
	help
	  Enable to have the command 'hello' that prints the simple message:
	  "Hello from shell." on the console.

endif # BRIDLE_COMMANDS
```

## subsys/stepper_action_stream/Kconfig
```kconfig
# Copyright (c) 2024 TiaC Systems
# SPDX-License-Identifier: Apache-2.0

config STEPPER_ACTION_STREAM
	bool "Stepper action streaming"
	depends on DYNAMIC_THREAD
	depends on HEAP_MEM_POOL_SIZE > 0
	help
	  Enable stepper action streaming functionality.

if STEPPER_ACTION_STREAM

config STEPPER_ACTION_STREAM_THREAD_STACK_SIZE
	int "Stepper action stream thread stack size"
	default 2048
	help
	  Stack size for each action stream handling thread.

config STEPPER_ACTION_STREAM_THREAD_PRIO
	int "Stepper action stream thread priority"
	default -1
	help
	  Thread priority for action handling threads.

endif # STEPPER_ACTION_STREAM
```

## tests/bridle/common/testcase.yaml
```yaml
common:
  tags:
    - base
    - bridle
    - kernel
    - userspace
    - xip
  min_flash: 32
  min_ram: 16
  timeout: 120
  sysbuild: false
  platform_exclude:
    - qemu_riscv32_xip
  integration_platforms:
    - native_sim
    - native_sim/native/64
    - qemu_x86
    - qemu_x86/atom/nokpti
    - qemu_x86/atom/nommu
    - qemu_x86/atom/nopae
    - qemu_x86/atom/virt
    - qemu_x86/atom/xip
    - qemu_x86_lakemont
    - qemu_x86_tiny
    - qemu_x86_64
    - qemu_x86_64/atom/nokpti
    - qemu_cortex_r5
    - qemu_cortex_m0
    - qemu_cortex_m3
    - qemu_cortex_a9
    - qemu_cortex_a53
    - qemu_cortex_a53/qemu_cortex_a53/smp
    - qemu_cortex_a53/qemu_cortex_a53/xip
    - qemu_kvm_arm64
    - qemu_arc/qemu_arc_em
    - qemu_arc/qemu_arc_hs
    - qemu_arc/qemu_arc_hs/xip
    - qemu_arc/qemu_arc_hs5x
    - qemu_arc/qemu_arc_hs6x
    - qemu_malta
    - qemu_malta/qemu_malta/be
    - qemu_riscv32e
    - qemu_riscv32
    - qemu_riscv32/qemu_virt_riscv32/smp
    # Qemu issue (-ENOTBLK): - qemu_riscv32_xip
    - qemu_riscv64
    - qemu_riscv64/qemu_virt_riscv64/smp
    - qemu_xtensa/dc233c
    - qemu_xtensa/dc233c/mmu
    - qemu_leon3
tests:
  bridle.common:
    build_on_all: true
```

## tests/drivers/gpio/sc18is604/testcase.yaml
```yaml
tests:
  drivers.gpio.sc18is604:
    tags:
      - drivers
      - gpio
      - sc18is604
    platform_allow:
      - native_sim
    integration_platforms:
      - native_sim
```

## tests/drivers/i2c/i2c_target_api/Kconfig
```kconfig
# Copyright (c) 2022-2023 TiaC Systems
# SPDX-License-Identifier: Apache-2.0

mainmenu "I2C Target API Test"

source "Kconfig.zephyr"

source "${ZEPHYR_BASE}/tests/drivers/i2c/i2c_target_api/common/Kconfig"
```

## tests/drivers/i2c/i2c_target_api/testcase.yaml
```yaml
common:
  depends_on: i2c
  tags: drivers i2c
  harness: ztest
  harness_config:
    fixture: i2c_bus_short

tests:
  drivers.i2c.target_api.tiac_magpie:
    platform_allow: tiac_magpie
  drivers.i2c.target_api.dual_role.tiac_magpie:
    platform_allow: tiac_magpie
    extra_configs:
      - CONFIG_APP_DUAL_ROLE_I2C=y
```

## tests/drivers/i2c/sc18is604/testcase.yaml
```yaml
tests:
  drivers.i2c.sc18is604:
    tags:
      - drivers
      - i2c
      - sc18is604
    platform_allow:
      - native_sim
    integration_platforms:
      - native_sim
```

## tests/drivers/watchdog/wdt_basic_api/testcase.yaml
```yaml
common:
    depends_on: watchdog
    tags: drivers watchdog
tests:
  drivers.watchdog.tiac_magpie:
    filter: not (dt_compat_enabled("st,stm32-window-watchdog") or dt_compat_enabled("st,stm32-watchdog"))
    platform_exclude: tiac_magpie
  drivers.watchdog.stm32wwdg.tiac_magpie:
    filter: dt_compat_enabled("st,stm32-window-watchdog") or dt_compat_enabled("st,stm32-watchdog")
    extra_args: DTC_OVERLAY_FILE="boards/tiac_magpie.overlay;boards/stm32_wwdg.overlay"
    platform_allow: tiac_magpie
  drivers.watchdog.stm32iwdg.tiac_magpie:
    filter: dt_compat_enabled("st,stm32-window-watchdog") or dt_compat_enabled("st,stm32-watchdog")
    extra_args: DTC_OVERLAY_FILE="boards/stm32_iwdg.overlay"
    platform_allow: tiac_magpie
```

## tests/shields/grove/dts_bindings/testcase.yaml
```yaml
common:
  tags: base shields grove
  build_only: true
  build_on_all: true
  filter: dt_compat_enabled("seeed,grove-laced-if") and
          dt_compat_enabled("seeed,grove-connector")
  platform_exclude:
    cy8ckit_062_ble_m0 cy8ckit_062_ble_m0@0.0.0 cy8ckit_062_ble_m0@1.0.0
    cy8ckit_062_ble_m4 cy8ckit_062_ble_m4@0.0.0
    da1469x_dk_pro
    frdm_kw41z
    hifive1 hifive1_revb
    lpcxpresso55s16
    nrf9160dk_nrf9160_ns
    pan1781_evb pan1782_evb
    rv32m1_vega_ri5cy rv32m1_vega_zero_riscy
    stm32h735g_disco stm32mp157c_dk2
tests:
  grove.base.v2:
    depends_on: arduino_gpio
    filter: dt_nodelabel_enabled("grove_laced_if_v2") and
            dt_nodelabel_enabled("grove_d0_header") and
            dt_nodelabel_enabled("grove_d2_header") and
            dt_nodelabel_enabled("grove_d3_header") and
            dt_nodelabel_enabled("grove_d4_header") and
            dt_nodelabel_enabled("grove_d5_header") and
            dt_nodelabel_enabled("grove_d6_header") and
            dt_nodelabel_enabled("grove_d7_header") and
            dt_nodelabel_enabled("grove_d8_header") and
            dt_nodelabel_enabled("grove_a0_header") and
            dt_nodelabel_enabled("grove_a1_header") and
            dt_nodelabel_enabled("grove_a2_header") and
            dt_nodelabel_enabled("grove_a3_header") and
            dt_nodelabel_enabled("grove_uart_header") and
            dt_nodelabel_enabled("grove_i2c_header")
    extra_args: SHIELD=seeed_grove_base_v2
  grove.base.v1:
    depends_on: arduino_gpio
    filter: dt_nodelabel_enabled("grove_laced_if_v1") and
            dt_nodelabel_enabled("grove_d0_header") and
            dt_nodelabel_enabled("grove_d1_header") and
            dt_nodelabel_enabled("grove_d2_header") and
            dt_nodelabel_enabled("grove_d3_header") and
            dt_nodelabel_enabled("grove_d4_header") and
            dt_nodelabel_enabled("grove_d5_header") and
            dt_nodelabel_enabled("grove_d6_header") and
            dt_nodelabel_enabled("grove_d7_header") and
            dt_nodelabel_enabled("grove_d8_header") and
            dt_nodelabel_enabled("grove_d9_header") and
            dt_nodelabel_enabled("grove_d10_header") and
            dt_nodelabel_enabled("grove_d11_header") and
            dt_nodelabel_enabled("grove_d12_header") and
            dt_nodelabel_enabled("grove_d13_header") and
            dt_nodelabel_enabled("grove_a0_header") and
            dt_nodelabel_enabled("grove_a1_header") and
            dt_nodelabel_enabled("grove_a2_header") and
            dt_nodelabel_enabled("grove_a3_header") and
            dt_nodelabel_enabled("grove_a4_header") and
            dt_nodelabel_enabled("grove_uart_header") and
            dt_nodelabel_enabled("grove_i2c_header") and
            dt_nodelabel_enabled("grove_spi_header")
    extra_args: SHIELD=seeed_grove_base_v1
  grove.rpipico.v1:
    filter: dt_nodelabel_enabled("grove_laced_if_v1") and
            dt_nodelabel_enabled("grove_d1_header") and
            dt_nodelabel_enabled("grove_d5_header") and
            dt_nodelabel_enabled("grove_d7_header") and
            dt_nodelabel_enabled("grove_d9_header") and
            dt_nodelabel_enabled("grove_d16_header") and
            dt_nodelabel_enabled("grove_d18_header") and
            dt_nodelabel_enabled("grove_d20_header") and
            dt_nodelabel_enabled("grove_a0_header") and
            dt_nodelabel_enabled("grove_a1_header") and
            dt_nodelabel_enabled("grove_a2_header") and
            dt_nodelabel_enabled("grove_uart0_header") and
            dt_nodelabel_enabled("grove_uart1_header") and
            dt_nodelabel_enabled("grove_i2c0_header") and
            dt_nodelabel_enabled("grove_i2c1_header") and
            dt_nodelabel_enabled("generic_spi_header")
    platform_allow:
      rpi_pico
    extra_args: SHIELD=seeed_grove_rpipico_v1
  grove.base.v2.arduino:
    # May be skipped if the board has at least one of the Ardunio standard
    # interfaces UART, I2c or SPI disabled at the time.
    depends_on: arduino_gpio
    filter: dt_nodelabel_enabled("grove_laced_if_v2") and
            dt_nodelabel_enabled("arduino_header") and
            dt_nodelabel_enabled("grove_gpios") and
            dt_nodelabel_enabled("arduino_serial") and
            dt_nodelabel_enabled("grove_serial") and
            dt_nodelabel_enabled("arduino_i2c") and
            dt_nodelabel_enabled("grove_i2c") and
            dt_nodelabel_enabled("arduino_spi") and
            dt_nodelabel_enabled("grove_spi")
    platform_allow:
      nucleo_f303re
      nucleo_f401re
      nucleo_f413zh
      nucleo_f767zi
      mimxrt1010_evk
      mimxrt1060_evk mimxrt1060_evkb
    extra_args: SHIELD=seeed_grove_base_v2
  grove.base.v1.arduino:
    # May be skipped if the board has at least one of the Ardunio standard
    # interfaces UART, I2c or SPI disabled at the time.
    depends_on: arduino_gpio
    filter: dt_nodelabel_enabled("grove_laced_if_v1") and
            dt_nodelabel_enabled("arduino_header") and
            dt_nodelabel_enabled("grove_gpios") and
            dt_nodelabel_enabled("arduino_serial") and
            dt_nodelabel_enabled("grove_serial") and
            dt_nodelabel_enabled("arduino_i2c") and
            dt_nodelabel_enabled("grove_i2c") and
            dt_nodelabel_enabled("arduino_spi") and
            dt_nodelabel_enabled("grove_spi")
    platform_allow:
      nucleo_f303re
      nucleo_f401re
      nucleo_f413zh
      nucleo_f767zi
      mimxrt1010_evk
      mimxrt1060_evk mimxrt1060_evkb
    extra_args: SHIELD=seeed_grove_base_v1
  grove.rpipico.v1.rpipico:
    # May be skipped if the board has at least one of the Ardunio standard
    # interfaces UART, I2c or SPI disabled at the time.
    filter: dt_nodelabel_enabled("grove_laced_if_v1") and
            dt_nodelabel_enabled("rpipico_header") and
            dt_nodelabel_enabled("grove_gpios") and
            dt_nodelabel_enabled("rpipico_serial") and
            dt_nodelabel_enabled("grove_serial") and
            dt_nodelabel_enabled("rpipico_i2c") and
            dt_nodelabel_enabled("grove_i2c") and
            dt_nodelabel_enabled("rpipico_spi") and
            dt_nodelabel_enabled("grove_spi")
    platform_allow:
      rpi_pico
    extra_args: SHIELD=seeed_grove_rpipico_v1
  grove_pwms.base.v2:
    depends_on: arduino_gpio
    filter: dt_nodelabel_enabled("grove_laced_if_v2") and
            dt_nodelabel_enabled("grove_pwms")
    platform_allow:
      nucleo_f303re
      nucleo_f401re
      nucleo_f413zh
      nucleo_f767zi
      mimxrt1010_evk
      mimxrt1060_evk mimxrt1060_evkb
    extra_args: SHIELD=seeed_grove_base_v2
  grove_pwms.base.v1:
    depends_on: arduino_gpio
    filter: dt_nodelabel_enabled("grove_laced_if_v1") and
            dt_nodelabel_enabled("grove_pwms")
    platform_allow:
      nucleo_f303re
      nucleo_f401re
      nucleo_f413zh
      nucleo_f767zi
      mimxrt1010_evk
      mimxrt1060_evk mimxrt1060_evkb
    extra_args: SHIELD=seeed_grove_base_v1
  grove_pwms.rpipico.v1:
    filter: dt_nodelabel_enabled("grove_laced_if_v1") and
            dt_nodelabel_enabled("grove_pwms")
    platform_allow:
      rpi_pico
    extra_args: SHIELD=seeed_grove_rpipico_v1
```
