## drivers/stepper/Kconfig.dummy
```kconfig
# SPDX-FileCopyrightText: Copyright (c) 2024 TiaC Systems
# SPDX-License-Identifier: Apache-2.0

# FIXME: https://github.com/zephyrproject-rtos/zephyr/pull/68774#discussion_r1689296474
#        Add to build_all driver tests.
config STEPPER_DUMMY
	bool "DUMMY stepper motor driver"
	default y
	depends on DT_HAS_DUMMY_STEPPERS_ENABLED
	help
	  Enable dummy driver for GPIO controlled stepper motor.
```

## drivers/stepper/Kconfig.gpio
```kconfig
# SPDX-FileCopyrightText: Copyright (c) 2024 Carl Zeiss Meditec AG
# SPDX-FileCopyrightText: Copyright (c) 2024 TiaC Systems
# SPDX-License-Identifier: Apache-2.0

# FIXME: https://github.com/zephyrproject-rtos/zephyr/pull/68774#discussion_r1689296474
#        Add to build_all driver tests.
config STEPPER_GPIO
	bool "GPIO stepper motor driver"
	default y
	depends on GPIO && DT_HAS_GPIO_STEPPERS_ENABLED
	help
	  Enable driver for GPIO controlled stepper motor.
```

## dts/bindings/actuator/pwm-servos.yaml
```yaml
# Copyright (c) 2023 TiaC Systems
# SPDX-License-Identifier: Apache-2.0

description: PWM servo motors parent node

compatible: "pwm-servos"

child-binding:
  description: PWM servo motor child node
  properties:
    pwms:
      required: true
      type: phandle-array
      description: |
        Reference to a PWM instance.

        The period field is NOT YET used by any function of any API.

    label:
      type: string
      description: |
        Human readable string describing the servo. It can be used by an
        application to identify this servo or to retrieve its number/index
        (i.e. child node number) on the parent device.
```

## dts/bindings/actuator/trinamic,tmc.yaml
```yaml
# Copyright (c) 2023 TiaC Systems
# Copyright (c) 2022 Stefano Cottafavi
#
# SPDX-License-Identifier: Apache-2.0

properties:
  pwms:
    type: phandle-array
    description: |
      Step pin

  dir-gpios:
    type: phandle-array
    description: |
      Dir pin

  en-gpios:
    type: phandle-array
    description: |
      Enable pin

  diag0-pin:
    type: phandles
    description: |
      Diagnostic pin 0
  diag1-pin:
    type: phandles
    description: |
      Diagnostic pin 1

  r-sens:
    type: int
    description: |
      Sensing resistor [mohm]
    default: 110
  current-run:
    type: int
    description: |
      Operating current [mA]
    default: 1000
  current-hold:
    type: int
    description: |
      Holding current [mA]
    default: 200

  rotation-distance:
    type: int
    description: |
      Linear displacement per motor turn [mm]
    default: 1000
```

## dts/bindings/actuator/trinamic,tmc2130-spi.yaml
```yaml
# Copyright (c) 2023 TiaC Systems
# Copyright (c) 2022 Stefano Cottafavi
#
# SPDX-License-Identifier: Apache-2.0

description: TMC2130 stepper driver (SPI)

compatible: "trinamic,tmc2130"

include: ["spi-device.yaml", "trinamic,tmc.yaml"]
```

## dts/bindings/actuator/trinamic,tmc2209-uart.yaml
```yaml
# Copyright (c) 2023 TiaC Systems
# Copyright (c) 2022 Stefano Cottafavi
#
# SPDX-License-Identifier: Apache-2.0

description: TMC2209 stepper driver (UART)

compatible: "trinamic,tmc2209"

include: ["uart-device.yaml", "trinamic,tmc.yaml"]

properties:
  slaveaddr:
    type: int
    description: |
      Address of this TMC instance
    default: 0
```

## dts/bindings/actuator/trinamic,tmc5160-spi.yaml
```yaml
# Copyright (c) 2023 TiaC Systems
# Copyright (c) 2022 Stefano Cottafavi
#
# SPDX-License-Identifier: Apache-2.0

description: TMC5160 stepper driver (SPI)

compatible: "trinamic,tmc5160"

include: ["spi-device.yaml", "trinamic,tmc.yaml"]
```

## dts/bindings/adc/wch,ch32-adc.yaml
```yaml
# Copyright (c) 2025 TiaC Systems
# Copyright (c) 2024 Matthew Tran
# SPDX-License-Identifier: Apache-2.0

description: CH32 ADC node

compatible: "wch,ch32-adc"

include: adc-controller.yaml

properties:
  reg:
    required: true

  clocks:
    required: true

  irq:
    type: array
    required: true

  dma:
    type: array
    required: true
    description: DMA channel to use

  prescaler:
    type: int
    required: true
    description: ADC clock prescaler, use macros
  
  vref-mv:
    type: int
    required: true

  "#io-channel-cells":
    const: 1

io-channel-cells:
  - input
```

## dts/bindings/audio/pwm-buzzer.yaml
```yaml
# Copyright (c) 2023 TiaC Systems
# SPDX-License-Identifier: Apache-2.0

description: PWM buzzers parent node

compatible: "pwm-buzzers"

child-binding:
  description: PWM buzzer child node
  properties:
    pwms:
      required: true
      type: phandle-array
      description: |
        Reference to a PWM instance.

        The period field is NOT YET used by any function of any API.

    label:
      type: string
      description: |
        Human readable string describing the buzzer. It can be used by an
        application to identify this buzzer or to retrieve its number/index
        (i.e. child node number) on the parent device.
```

## dts/bindings/clock/wch,ch32-hsi-clock.yaml
```yaml
# Copyright (c) 2025 TiaC Systems
# Copyright (c) 2024 Google LLC.
# SPDX-License-Identifier: Apache-2.0

description: WCH CH32 High Speed Internal (HSI) Clock

compatible: "wch,ch32-hsi-clock"

include: [fixed-clock.yaml]
```

## dts/bindings/clock/wch,ch32-rcc.yaml
```yaml
# Copyright (c) 2025 TiaC Systems
# Copyright (c) 2024 Michael Hope
# SPDX-License-Identifier: Apache-2.0

description: |
  WCH CH32 Reset and Clock Control (RCC)

  This node is in charge of system clock ('SYSCLK') source selection and controlling
  clocks for AHB (Advanced High Performance) and APB (Advanced Peripheral) bus domains.

  Configuring CH32 Reset and Clock controller node:

  System clock source should be selected amongst the clock nodes available in "clocks"
  node (typically 'clk_hse, clk_hsi', 'pll', ...).
  Core clock frequency should also be defined, using "clock-frequency" property.
  Note:
          Core clock frequency  = SYSCLK / AHB prescaler
  Last, peripheral bus clocks (typically PCLK1, PCLK2) should be configured using matching
  prescaler properties.
  Here is an example of correctly configured rcc node:
  &rcc {
           clocks = <&pll>;  /* Select 80MHz pll as SYSCLK source */
           ahb-prescaler = <2>;
           clock-frequency = <DT_FREQ_M(40)>; /* = SYSCLK / AHB prescaler */
           apb1-prescaler = <1>;
           apb2-prescaler = <1>;
  }

  Specifying a gated clock:

  To specify a gated clock, a peripheral should define a "clocks" property encoded
  in the following way:
  ... {
           ...
           clocks = <&rcc CH32xxxx_CLOCK_USART1>;
           ...
  }
  After the phandle referring to rcc node, the first index specifies the peripheral
  clock identifier. The gated clock is required when accessing to the peripheral
  controller is needed (generally for configuring the device).

compatible: "wch,ch32-rcc"

include: [clock-controller.yaml, base.yaml]

properties:
  reg:
    required: true

  "#clock-cells":
    const: 1

  clock-frequency:
    required: true
    type: int
    description: |
      default frequency in Hz for clock output

clock-cells:
  - id
```

## dts/bindings/clock/wch,ch32f20x-rcc.yaml
```yaml
# Copyright (c) 2025 TiaC Systems
# Copyright (c) 2024 Michael Hope
# SPDX-License-Identifier: Apache-2.0

description: |
  WCH CH32F20x Reset and Clock Control (RCC)

  Adds the CH32F20x AHB prescaler to the standard generic CH32 RCC.
  For more description confere wch,ch32-rcc.yaml

compatible: "wch,ch32f20x-rcc"

include: wch,ch32-rcc.yaml

properties:
  ahb-prescaler:
    type: int
    required: true
    enum:
      - 1
      - 2
      - 4
      - 8
      - 16
      - 64
      - 128
      - 256
      - 512
    description: |
        AHB prescaler. Defines actual core clock frequency (HCLK)
        based on system frequency input.
        The HCLK clocks CPU, AHB, memories and DMA.

  apb1-prescaler:
    type: int
    required: true
    enum:
      - 1
      - 2
      - 4
      - 8
      - 16

  apb2-prescaler:
    type: int
    required: true
    enum:
      - 1
      - 2
      - 4
      - 8
      - 16

  adc-prescaler:
    type: int
    default: 2
    enum:
      - 2
      - 4
      - 6
      - 8
```

## dts/bindings/clock/wch,ch32x035-rcc.yaml
```yaml
# Copyright (c) 2025 TiaC Systems
# Copyright (c) 2024 Michael Hope
# SPDX-License-Identifier: Apache-2.0

description: |
  WCH CH32X035 Reset and Clock Control (RCC)

  Adds the CH32X035 AHB prescaler to the standard generic CH32 RCC.
  For more description confere wch,ch32-rcc.yaml

compatible: "wch,ch32x035-rcc"

include: wch,ch32-rcc.yaml

properties:
  ahb-prescaler:
    type: int
    required: true
    enum:
      - 1
      - 2
      - 3
      - 4
      - 5
      - 6
      - 7
      - 8
      - 16
      - 32
      - 64
      - 128
      - 256
    description: |
        AHB prescaler. Defines actual core clock frequency (HCLK)
        based on system frequency input.
        The HCLK clocks CPU, AHB, memories and DMA.
```

## dts/bindings/display/led-panel.yaml
```yaml
# Copyright (c) 2023 TOKITA Hiroshi
# SPDX-License-Identifier: Apache-2.0

description: Dummy display controller

compatible: "led-panel"

include: display-controller.yaml

properties:
  led-strip:
    type: phandle

  module-width:
    type: int

  module-height:
    type: int
```

## dts/bindings/display/sipo-mux-display.yaml
```yaml
# Copyright (c) 2023 TiaC Systems
# SPDX-License-Identifier: Apache-2.0

description: Generic latched SIPO/MUX Display Controller

compatible: "sipo-mux-display"

include: display-controller.yaml

properties:
  offset:
    type: array
    default: [0, 0]
    description: |
      Optional offset for top and front pixel shifting. This property
      indicates the x offset for front pixel shifting as first element
      and the y offset for top pixel shifting as second element. More
      than two alements are not allowed.

      For example, setting "offset = <2 1>;" means in front of each row
      is a gap of two unused pixels and on top of each column is a gap
      of one unused pixel. In case of an underlying SIPO/MUX GP Controller
      with 16 x 32 usable bits the display width and height must be set
      consistent and appropriate to the offset to "width = <30>;" and
      "height = <15>;".

  inversion-on:
    type: boolean
    description: |
      Display inversion mode. Every bit is inverted on writing to the
      display frame memory.
```

## dts/bindings/gpio/adafruit,stemmaqt-connector.yaml
```yaml
# Copyright (c) 2023 TiaC Systems
# SPDX-License-Identifier: Apache-2.0

description: |
    GPIO pins exposed on Adafruit STEMMA QT connector.

    The STEMMA QT layout provides an 4-pin 1mm JST SH connector, along on
    one edge of the board. Pin assignment can be found at:

    - https://learn.adafruit.com/introducing-adafruit-stemma-qt/what-is-stemma-qt

    This binding provides a nexus mapping for 2 pins where parent
    pins 0 through 1 correspond as depicted below (with cable color):

        4-pin      I2C only

        (yellow) 0 SCL
          (blue) 1 SDA
           (red) - VCC  (3V3 or 5V0)
         (black) - GND

compatible: "adafruit,stemmaqt-connector"

include: [gpio-nexus.yaml, base.yaml]
```

## dts/bindings/gpio/cjmcu,75x-gpio-header.yaml
```yaml
# Copyright (c) 2024 TiaC Systems
# SPDX-License-Identifier: Apache-2.0

description: |
    GPIO pins exposed on CJMCU SC16IS75x breakout board headers.

    The SC16IS75x breakout board layout provides a wraparound header on
    two opposite edges of the board and can be divided into three sections.
    Firstly, up to the host controller the serial bus configuration,
    communication and chip control, secondly the UART interface to the
    outside, and thirdly the GPIO interface down to other I/O components.

    Proceeding clockwise on SC16IS750 breakout board:
    * A 11-pin header. 5 pins on this header are exposed by this binding.
    * A 11-pin header. 3 pins on this header are exposed by this binding.

    Proceeding clockwise on SC16IS752 breakout board:
    * A 2x8-pin header. 8 pins on this header are exposed by this binding.
    * A 10-pin header. 0 pins on this header are exposed by this binding.

    This binding provides a nexus mapping for 8 pins where parent pins 0
    through 7 correspond as depicted below:

               SC16IS750                            SC16IS752
       .-----------------------.         .-----------------------------.
     - |o I2C/nSPI        GND o| -       |           __                |
     - |o A0/CS     _  nRESET o| -       |        .-´  |-          --. |
     - |o A1/SI  _|| ||_   RX o| -     - |o VCC   |    |-     .---´   v|
     - |o NC/SO   ||_||    TX o| -     - |o GND   `-.__|-  GP7|TXA  o o| 7 -
     - |o SCL/SCK         CTS o| -     - |o nRESET         GP6|RXA  o o| 6 -
     - |o SDA/NC  _____   RTS o| -     - |o A0/CS     _    GP5|RTSA o o| 5 -
     - |o nIRQ   |     |  IO7 o| 7     - |o A1/SI  -||_||- GP4|CTSA o o| 4 -
     0 |o IO0    | 750 |  IO6 o| 6     - |o NC/SO     ___  GP3|TXB  o o| 3 -
     1 |o IO1    |_____|  IO5 o| 5     - |o nIRQ     |   | GP2|RXB  o o| 2 -
     2 |o IO2   ____      IO4 o| 4     - |o I2C/nSPI | 7 | GP1|RTSB o o| 1 -
     - |o VCC  |____|     IO3 o| 3     - |o SCL/SCLK | 5 | GP0|CTSB o o| 0 -
       `-----------------------´       - |o SDA/NC   | 2 | ---+    .^  |
                                         |           |___|     `--´    |
                                         |                             |
                                         `-----------------------------´

compatible: "cjmcu,75x-gpio-header"

include: [gpio-nexus.yaml, base.yaml]
```
