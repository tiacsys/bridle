## dts/bindings/gpio/cjmcu,75x-hif-header.yaml
```yaml
# Copyright (c) 2024 TiaC Systems
# SPDX-License-Identifier: Apache-2.0

description: |
    Host interface exposed on CJMCU SC16IS75x breakout board headers.

    The SC16IS75x breakout board layout provides a wraparound header on
    two opposite edges of the board and can be divided into three sections.
    Firstly, up to the host controller the serial bus configuration,
    communication and chip control, secondly the UART interface to the
    outside, and thirdly the GPIO interface down to other I/O components.

    Proceeding clockwise on SC16IS750 breakout board:
    * A 11-pin header. 1 pins on this header are exposed by this binding.
    * A 11-pin header. 7 pins on this header are exposed by this binding.

    Proceeding clockwise on SC16IS752 breakout board:
    * A 2x8-pin header. 0 pins on this header are exposed by this binding.
    * A 10-pin header. 8 pins on this header are exposed by this binding.

    This binding provides a nexus mapping for 8 pins where parent pins 0
    through 7 correspond as depicted below:

               SC16IS750                            SC16IS752
       .-----------------------.         .-----------------------------.
     2 |o I2C/nSPI        GND o| -       |           __                |
     6 |o A0/CS     _  nRESET o| 7       |        .-´  |-          --. |
     5 |o A1/SI  _|| ||_   RX o| -     - |o VCC   |    |-     .---´   v|
     4 |o NC/SO   ||_||    TX o| -     - |o GND   `-.__|-  GP7|TXA  o o| - -
     1 |o SCL/SCK         CTS o| -     7 |o nRESET         GP6|RXA  o o| - -
     0 |o SDA/NC  _____   RTS o| -     6 |o A0/CS     _    GP5|RTSA o o| - -
     3 |o nIRQ   |     |  IO7 o| -     5 |o A1/SI  -||_||- GP4|CTSA o o| - -
     - |o IO0    | 750 |  IO6 o| -     4 |o NC/SO     ___  GP3|TXB  o o| - -
     - |o IO1    |_____|  IO5 o| -     3 |o nIRQ     |   | GP2|RXB  o o| - -
     - |o IO2   ____      IO4 o| -     2 |o I2C/nSPI | 7 | GP1|RTSB o o| - -
     - |o VCC  |____|     IO3 o| -     1 |o SCL/SCLK | 5 | GP0|CTSB o o| - -
       `-----------------------´       0 |o SDA/NC   | 2 | ---+    .^  |
                                         |           |___|     `--´    |
                                         |                             |
                                         `-----------------------------´

compatible: "cjmcu,75x-hif-header"

include: [gpio-nexus.yaml, base.yaml]
```

## dts/bindings/gpio/dfrobot,gravity-connector.yaml
```yaml
# Copyright (c) 2023-2024 TiaC Systems
# SPDX-License-Identifier: Apache-2.0

description: |
    GPIO pins exposed on DFRobot Gravity connector.

    The Gravity layout provides either an 3-pin or 4-pin 2mm JST PH connector,
    along on one edge of the board. Information and pin assignment can be
    found at:

    - https://www.dfrobot.com/gravity
    - https://learn.adafruit.com/introducing-adafruit-stemma-qt/dfrobot-gravity

    This binding provides a nexus mapping for 2 pins where parent
    pins 0 through 1 correspond as depicted below (with cable color):

        4-pin      UART I2C

         (green) 1 TX   SDA
          (blue) 0 RX   SCL
         (black) - GND  GND
           (red) - VCC  VCC  (3V3 or 5V0)

        3-pin      analog or digital sensors

         (green) 0 A/D
           (red) - VCC  (3V3 or 5V0)
         (black) - GND

compatible: "dfrobot,gravity-connector"

include: [gpio-nexus.yaml, base.yaml]
```

## dts/bindings/gpio/digilent,pmod-header.yaml
```yaml
# Copyright (c) 2023 TiaC Systems
# SPDX-License-Identifier: Apache-2.0

description: |
    GPIO pins exposed on Digilent Pmod header.

    The Pmod layout provides standard 100mil spaced, 25mil square,
    pin-header style 6-pin (Spec A/C) or 12-pin (Spec B/D) connectors
    with currently 7 pin assignments to support different use cases
    for GPIO (Type 1), SPI, (Type 2), UART (Type 3), H-Bridge (Type 4),
    Dual H-Bridge (Type 5), I2C (Type 6), I2S (Type 7).

    The peripheral module board will have a male connector. This will
    typically be a right-angle connector, at the board edge, for direct
    connection to a host board. The host board will typically have a
    12-pin right-angle female connector at the board edge for direct
    connection of peripheral module boards.

    The power pins of the interface (VCC) provide power from the host to
    the peripheral. The complete interface requires that the host provide
    the ability to switch the voltage on the power pins between 5V and
    3.3V. A reduced functionality subset of the specification allows the
    host to provide only 3.3V at the power supply pins, with no ability
    to switch. On the 12-pin version of the interface, both power supply
    pins switch together and always supply the same voltage. These pins
    may be shorted together at either the host end or the peripheral side.

    Pin assignment and all specifications can be found at:
    https://digilent.com/reference/pmod/start

    This binding provides a nexus mapping for 8 pins where parent
    pins 0 through 7 correspond as depicted below depending on
    related "Spec" and "Type":

                                 (Spec B/D) 12-pin   6-pin (Spec A/C)
                                                | \ /
                                                |  |

    GPIO (Types 1/1A):                      IO5 4  0 IO1
                                      (PWM) IO6 5  1 IO2 (PWM)
                                            IO7 6  2 IO3
                                            IO8 7  3 IO4
                                            GND -  - GND
                                            VCC -  - VCC

    SPI (Types 2/2A):                 (INT) IO5 4  0 CS
                                    (RESET) IO6 5  1 MOSI
                                      (CS2) IO7 6  2 MISO
                                      (CS3) IO8 7  3 SCK
                                            GND -  - GND
                                            VCC -  - VCC

    UART (Types 3/3A):                (INT) IO5 4  0 CTS (IO1)
                                    (RESET) IO6 5  1 TXD
                                            IO7 6  2 RXD
                                            IO8 7  3 RTS (IO4)
                                            GND -  - GND
                                            VCC -  - VCC

    H-Bridge (Types 4):                            0 DIR
                                                   1 EN (PWM)
                                                   2 SA
                                                   3 SB
                                                   - GND
                                                   - VCC

    Dual H-Bridge (Types 5):                       0 DIR1
                                                   1 EN1
                                                   2 DIR2
                                                   3 EN2
                                                   - GND
                                                   - VCC

    Dual H-Bridge (Types 5A):              DIR2 4  0 DIR1
                                      (PWM) EN2 5  1 EN1 (PWM)
                                            S2A 6  2 S1A
                                            S2B 7  3 S1B
                                            GND -  - GND
                                            VCC -  - VCC

    I2C (Types 6/6A):                       IO5 4  0 N/C (IO1) (INT)
                                            IO6 5  1 N/C (IO2) (RESET)
                                            IO7 6  2 SCL
                                            IO8 7  3 SDA
                                            GND -  - GND
                                            VCC -  - VCC

    I2S (Types 7):                          IO5 4  0 LRCLK
                                            IO6 5  1 DAC Data
                                     (MCLK) IO7 6  2 ADC Data
                                            IO8 7  3 BCLK
                                            GND -  - GND
                                            VCC -  - VCC

compatible: "digilent,pmod-header"

include: [gpio-nexus.yaml, base.yaml]
```

## dts/bindings/gpio/generic-pin-header.yaml
```yaml
# Copyright (c) 2023 TiaC Systems
# SPDX-License-Identifier: Apache-2.0

description: |
    GPIO pins exposed on an ordinary male or female pin headers.

    This generic description has no reference to a concrete interface
    with firmly defined and assigned signals. Rather, it serves the general
    abstraction of arbitrary and freely definable male and female connectors,
    which do not follow any generally valid specifications. Examples of this
    are auxiliary or commissioning interfaces.

    The counting manner and direction does not matter here and must be
    specified by the respective system and must be adhered to for itself.
    Here are a few examples from practice, as they are often encountered:

        1 --o       1 --o  o-- N        1 --o  o-- N/2+1   1 --o  o-- 2
        2 --o       2 --o  o-- N-1      2 --o  o-- …       … --o  o-- …
        … --o       … --o  o-- …        … --o  o-- …     N/2 --o  o-- N/2+1
      N-1 --o       … --o  o-- …        … --o  o-- N-1     … --o  o-- …
        N --o     N/2 --o  o-- N/2+1  N/2 --o  o-- N     N-1 --o  o-- N

compatible: "generic-pin-header"

include: [gpio-nexus.yaml, base.yaml]
```

## dts/bindings/gpio/nologo,bluepill-header.yaml
```yaml
# Copyright (c) 2025 TiaC Systems
# SPDX-License-Identifier: Apache-2.0

description: |
    GPIO pins exposed on No Name Technology BluePill and BluePill+ headers.

    The BluePill and BluePill+ layout provides a wraparound header on the
    longer freely accessible edges of the board and can be divided into
    two sections, two headers on the longer opposite sides.

    Proceeding counter-clockwise:
    * A 20-pin header. 17 pins on this header are exposed by this binding.
    * A 20-pin header. 15 pins on this header are exposed by this binding.

    This binding provides a nexus mapping for 32 pins where parent pins 20
    through 29 correspond to ADC0 through ADC9, and parent pins 0 through 16
    and other pins above correspond as depicted below:

                  .---------.                       on  BluePill  BluePill+
          .-------|         |-------.           ======  ========  =========
        0 B12 NSS |   USB   |     (!) -         (!) ->  GND       5V
        1 B13 SCK `---------´     GND -
        2 B14 MISO                3V3 -
        3 B15 MOSI               NRST -
        4 A8  (MCO)    (RX#/SDA#) B11 31
        5 A9  UART TX  (TX#/SCL#) B10 30
        6 A10 UART RX        ADC9  B1 29
        7 A11 (USB DN)       ADC8  B0 28
        8 A12 (USB DP)       ADC7  A7 27
        9 A15 (JTDI)         ADC6  A6 26
       10 B3  (JTDO)         ADC5  A5 25
       11 B4  (JTRST)        ADC4  A4 24
       12 B5                 ADC3  A3 23
       13 B6  SCL            ADC2  A2 22
       14 B7  SDA            ADC1  A1 21
       15 B8  CAN RX  (WKUP) ADC0  A0 20
       16 B9  CAN TX  (OSC32 OUT) C15 19
        - 5V           (OSC32 IN) C14 18
        - GND                 (*) C13 17        (*) ->  LED       free
        - 3V3       o o o o      VBAT -
          `---------|-|-|-|---------´
                    | | | |

             3V3 ---´     `--- GND
    (JTMS) SWDIO -----´ `----- SWCLK (JTCK)

compatible: "nologo,bluepill-header"

include: [gpio-nexus.yaml, base.yaml]
```

## dts/bindings/gpio/nxp,pca9554-regrst.yaml
```yaml
# Copyright (c) 2021-2024 TiaC Systems
# SPDX-License-Identifier: Apache-2.0

description: PCA9554 specific I2C-based GPIO expander (w/regrst)

compatible: "nxp,pca9554-regrst"

include: [gpio-controller.yaml, i2c-device.yaml]

properties:
  rst-dflts:
    type: boolean
    description: Reset all registers to their default values.

  interrupt-gpios:
    type: phandle-array
    description: Interrupt GPIO pin (active-low open-drain)

  "#gpio-cells":
    const: 2

gpio-cells:
  - pin
  - flags
```

## dts/bindings/gpio/nxp,pca9554.yaml
```yaml
# Copyright (c) 2021-2023 TiaC Systems
# SPDX-License-Identifier: Apache-2.0

description: PCA9554 specific I2C-based GPIO expander

compatible: "nxp,pca9554"

include: [gpio-controller.yaml, i2c-device.yaml]

properties:
  label:
    required: false
    deprecated: true

  rst-dflts:
    type: boolean
    required: false
    description: Reset all registers to their default values.

  interrupt-gpios:
    type: phandle-array
    required: false
    description: Interrupt GPIO pin (active-low open-drain)

  "#gpio-cells":
    const: 2

gpio-cells:
  - pin
  - flags
```

## dts/bindings/gpio/nxp,sc16is75x-gpio.yaml
```yaml
# Copyright (c) 2024 TiaC Systems
# SPDX-License-Identifier: Apache-2.0

description: GPIO controller part of an NXP SC16IS75x chip

compatible: "nxp,sc16is75x-gpio"

include: [gpio-controller.yaml]

properties:
  "#gpio-cells":
    const: 2

  ngpios:
    required: true
    const: 8

gpio-cells:
  - pin
  - flags

on-bus: nxp,sc16is75x
```
