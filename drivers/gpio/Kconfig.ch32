## drivers/gpio/Kconfig.ch32
```kconfig
# Copyright (c) 2025 TiaC Systems
# Copyright (c) 2024 Matthew Tran
# SPDX-License-Identifier: Apache-2.0

menuconfig GPIO_CH32
	bool "WCH CH32 General Purpose Input Output (GPIO) driver"
	default y
	depends on DT_HAS_WCH_CH32_GPIO_ENABLED

config GPIO_CH32_INIT_PRIORITY
	int "Init priority"
	default KERNEL_INIT_PRIORITY_DEFAULT
	depends on GPIO_CH32
	help
	  Device driver initialization priority.
```

## drivers/gpio/Kconfig.pca9554
```kconfig
# PCA9554 GPIO configuration options

# Copyright (c) 2021-2023 TiaC Systems
# SPDX-License-Identifier: Apache-2.0

menuconfig GPIO_PCA9554
	bool "PCA9554 I2C-based GPIO chip"
	default y
	depends on DT_HAS_NXP_PCA9554_ENABLED
	depends on I2C
	help
	  Enable driver for PCA9554 I2C-based GPIO chip.

config GPIO_PCA9554_INIT_PRIORITY
	int "Init priority"
	default 70
	depends on GPIO_PCA9554
	help
	  Device driver initialization priority.

config GPIO_PCA9554_INTERRUPT
	bool "Interrupt enable"
	depends on GPIO_PCA9554
	help
	  Enable interrupt support in PCA9554 driver.
	  Note that the PCA9554 cannot reliably detect
	  short-pulse interrupts due to its design.
```

## drivers/gpio/Kconfig.pca9554_regrst
```kconfig
# PCA9554 GPIO configuration options

# Copyright (c) 2021-2024 TiaC Systems
# SPDX-License-Identifier: Apache-2.0

menuconfig GPIO_PCA9554_REGRST
	bool "PCA9554 I2C-based GPIO chip (w/regrst)"
	default y
	depends on DT_HAS_NXP_PCA9554_REGRST_ENABLED
	depends on I2C
	help
	  Enable driver for PCA9554 I2C-based GPIO chip
	  with the reset register to defaults feature.

config GPIO_PCA9554_REGRST_INIT_PRIORITY
	int "Init priority"
	default 70
	depends on GPIO_PCA9554_REGRST
	help
	  Device driver initialization priority.

config GPIO_PCA9554_REGRST_INTERRUPT
	bool "Interrupt enable"
	depends on GPIO_PCA9554_REGRST
	help
	  Enable interrupt support in PCA9554 driver.
	  Note that the PCA9554 cannot reliably detect
	  short-pulse interrupts due to its design.
```

## drivers/gpio/Kconfig.pca9555
```kconfig
# PCA9555 GPIO configuration options

# Copyright (c) 2021-2023 TiaC Systems
# SPDX-License-Identifier: Apache-2.0

menuconfig GPIO_PCA9555
	bool "PCA9555 I2C-based GPIO chip"
	default y
	depends on DT_HAS_NXP_PCA9555_ENABLED
	depends on I2C
	help
	  Enable driver for PCA9555 I2C-based GPIO chip.

config GPIO_PCA9555_INIT_PRIORITY
	int "Init priority"
	default 70
	depends on GPIO_PCA9555
	help
	  Device driver initialization priority.

config GPIO_PCA9555_INTERRUPT
	bool "Interrupt enable"
	depends on GPIO_PCA9555
	help
	  Enable interrupt support in PCA9555 driver.
	  Note that the PCA9555 cannot reliably detect
	  short-pulse interrupts due to its design.
```

## drivers/gpio/Kconfig.pca9555_regrst
```kconfig
# PCA9555 GPIO configuration options

# Copyright (c) 2021-2024 TiaC Systems
# SPDX-License-Identifier: Apache-2.0

menuconfig GPIO_PCA9555_REGRST
	bool "PCA9555 I2C-based GPIO chip (w/regrst)"
	default y
	depends on DT_HAS_NXP_PCA9555_REGRST_ENABLED
	depends on I2C
	help
	  Enable driver for PCA9555 I2C-based GPIO chip
	  with the reset register to defaults feature.

config GPIO_PCA9555_REGRST_INIT_PRIORITY
	int "Init priority"
	default 70
	depends on GPIO_PCA9555_REGRST
	help
	  Device driver initialization priority.

config GPIO_PCA9555_REGRST_INTERRUPT
	bool "Interrupt enable"
	depends on GPIO_PCA9555_REGRST
	help
	  Enable interrupt support in PCA9555 driver.
	  Note that the PCA9555 cannot reliably detect
	  short-pulse interrupts due to its design.
```

## drivers/gpio/Kconfig.sc16is75x
```kconfig
# Copyright (c) 2024 TiaC Systems
# SPDX-License-Identifier: Apache-2.0

menuconfig GPIO_SC16IS75X
	bool "NXP SC16IS75x GPIO driver"
	default y
	depends on DT_HAS_NXP_SC16IS75X_GPIO_ENABLED
	depends on MFD_SC16IS75X
	help
	  Enable driver for GPIO controller part of an SC16IS75x bridge.

if GPIO_SC16IS75X

config GPIO_SC16IS75X_INIT_PRIORITY
	int "Init priority"
	default 85
	help
	  Device driver initialization priority.

config GPIO_SC16IS75X_INTERRUPTS
	bool "Interrupt support"
	default y
	depends on MFD_SC16IS75X_INTERRUPTS
	help
	  Enable interrupt support on SC16IS75x GPIO controllers.

endif # GPIO_SC16IS75X
```

## drivers/gpio/Kconfig.sc18is604
```kconfig
# Copyright (c) 2024 TiaC Systems
# SPDX-License-Identifier: Apache-2.0

menuconfig GPIO_SC18IS604
	bool "GPIO controller part of an SC18IM604 bridge"
	default y
	depends on DT_HAS_NXP_SC18IS604_GPIO_ENABLED
	depends on MFD_SC18IS604
	help
	  Enable driver for GPIO controller part of an SC18IM604 bridge.

config GPIO_SC18IS604_INIT_PRIORITY
	int "Init priority"
	default 85
	depends on GPIO_SC18IS604
	help
	  Device driver initialization priority.
```

## drivers/gpio/Kconfig.sipomux
```kconfig
# Latched SIPO/MUX GPIO configuration options

# Copyright (c) 2023 TiaC Systems
# SPDX-License-Identifier: Apache-2.0

menuconfig GPIO_SIPOMUX
	bool "Generic latched SIPO/MUX GPIO controller"
	default y
	depends on DT_HAS_SIPO_MUX_GPIO_ENABLED
	select MFD
	help
	  Enable the generic latched SIPO/MUX GPIO driver.

config GPIO_SIPOMUX_INIT_PRIORITY
	int "Initialization priority"
	default 85
	depends on GPIO_SIPOMUX
	help
	  Initialization priority for the generic latched SIPO/MUX GPIO
	  driver. It must be greater than the MFD controller init priority.
```

## drivers/i2c/Kconfig.sc18is604
```kconfig
# Copyright (c) 2024 TiaC Systems
# SPDX-License-Identifier: Apache-2.0

menuconfig I2C_SC18IS604
	bool "I2C controller part of an SC18IM604 bridge"
	default y
	depends on DT_HAS_NXP_SC18IS604_I2C_ENABLED
	depends on MFD_SC18IS604
	select MFD_SC18IS604_ASYNC
	select POLL # dependency of MFD_SC18IS604_ASYNC
	help
	  Enable driver for I2C controller part of an SC18IM604 bridge.

config I2C_SC18IS604_INIT_PRIORITY
	int "Init priority"
	default 60
	depends on I2C_SC18IS604
	help
	  Device driver initialization priority.

config I2C_SC18IS604_WORKQUEUE_STACK_SIZE
	int
	default 512

if I2C_SC18IS604 && I2C_CALLBACK

config I2C_SC18IS604_CB
	bool
	default y

config HEAP_MEM_POOL_ADD_SIZE_I2C_SC18IS604
	int
	default 512 # Enough for 5 in-flight async transfers

endif # I2C_CALLBACK
```

## drivers/mfd/Kconfig.ds3231
```kconfig
# Maxim DS3231 MFD configuration options

# Copyright (c) 2024 TiaC Systems
# SPDX-License-Identifier: Apache-2.0

menuconfig MFD_DS3231
	bool "Maxim DS3231 MFD controller"
	default y if !DT_HAS_MAXIM_DS3231_ENABLED
	depends on DT_HAS_MAXIM_DS3231_MFD_ENABLED
	select I2C
	help
	  Enable the Maxim DS3231 multi-function device driver to got
	  access to the devices for RTC and Temperature Sensor drivers.

config MFD_DS3231_INIT_PRIORITY
	int "Initialization priority"
	default 55 if RTC_DS3231
	default MFD_INIT_PRIORITY
	depends on MFD_DS3231
	help
	  Multi-function device initialization priority for Maxim DS3231.
```

## drivers/mfd/Kconfig.sc16is75x
```kconfig
# Copyright (c) 2024 TiaC Systems
# SPDX-License-Identifier: Apache-2.0

menuconfig MFD_SC16IS75X
	bool "NXP SC16IS75x SPI/I2C to UART & GPIO bridge"
	default y
	depends on DT_HAS_NXP_SC16IS75X_ENABLED
	depends on MFD
	help
	  Enable the NXP SC16IS75x bridge multi-function device driver.

if MFD_SC16IS75X

# Workaround for not being able to have commas in macro arguments
DT_COMPAT_NXP_SC16IS75X := nxp,sc16is75x
DT_NXP_SC16IS75X_HAS_IRQ := $(dt_compat_any_has_prop,$(DT_COMPAT_NXP_SC16IS75X),interrupt-gpios)

config MFD_SC16IS75X_ASYNC_NEEDS_WORKQUEUE
	bool
	default y if MFD_SC16IS75X_SPI && !SPI_ASYNC
	default y if MFD_SC16IS75X_I2C && !I2C_CALLBACK
	default n

config MFD_SC16IS75X_ASYNC
	bool
	default n
	depends on POLL

config MFD_SC16IS75X_INTERRUPTS
	bool "Interrupt support"
	default y if $(DT_NXP_SC16IS75X_HAS_IRQ)
	depends on GPIO
	select MFD_SC16IS75X_ASYNC
	select POLL # dependency of MFD_SC16IS75X_ASYNC
	help
	  Enable interrupts on SC16IS75x bridges.

config MFD_SC16IS75X_SPI
	bool "NXP SC16IS75x SPI bus support"
	default y
	depends on $(dt_compat_on_bus,$(DT_COMPAT_NXP_SC16IS75X),spi)
	depends on SPI
	help
	  Enable the SPI bus transfer functions for SC16IS75x.

config MFD_SC16IS75X_I2C
	bool "NXP SC16IS75x I2C bus support"
	default y
	depends on $(dt_compat_on_bus,$(DT_COMPAT_NXP_SC16IS75X),i2c)
	depends on I2C
	help
	  Enable the I2C bus transfer functions for SC16IS75x.

config MFD_SC16IS75X_INIT_PRIORITY
	int "Init priority"
	default 55 if UART_SC16IS75X
	default MFD_INIT_PRIORITY
	help
	  Multi-function device initialization priority for SC16IS75x.

if MFD_SC16IS75X_ASYNC

config HEAP_MEM_POOL_ADD_SIZE_MFD_SC16IS75X
	int
	default 128 # Enough for 16 concurrent transfers (k_calloc)
	depends on MFD_SC16IS75X_ASYNC

config MFD_SC16IS75X_ASWQ
	bool
	default y if MFD_SC16IS75X_ASYNC && MFD_SC16IS75X_ASYNC_NEEDS_WORKQUEUE
	default n

config MFD_SC16IS75X_WORKQUEUE_STACK_SIZE
	int
	default 512
	depends on MFD_SC16IS75X_ASWQ

endif # MFD_SC16IS75X_ASYNC

endif # MFD_SC16IS75X
```

## drivers/mfd/Kconfig.sc18is604
```kconfig
# Copyright (c) 2024 TiaC Systems
# SPDX-License-Identifier: Apache-2.0

menuconfig MFD_SC18IS604
	bool "SC18IM604 SPI to I2C & GPIO bridge"
	default y
	depends on DT_HAS_NXP_SC18IS604_ENABLED
	depends on SPI
	help
	  Enable driver for SC18IM604 bridge.

config MFD_SC18IS604_INIT_PRIORITY
	int "Init priority"
	default 55 if I2C_SC18IS604
	default MFD_INIT_PRIORITY
	depends on MFD_SC18IS604
	help
	  Device driver initialization priority.

config MFD_SC18IS604_ASYNC
	bool "Enable asynchronous transfer functions over SC18IS604 bus"
	default y if I2C_SC18IS604
	default n
	depends on POLL
	depends on DYNAMIC_THREAD

if MFD_SC18IS604_ASYNC

config MFD_SC18IS604_WORKQUEUE_STACK_SIZE
	int
	default 512

config HEAP_MEM_POOL_ADD_SIZE_MFD_SC18IS604
	int
	default 256

endif # MFD_SC18IS604_ASYNC
```

## drivers/mfd/Kconfig.sipomuxgp
```kconfig
# Generic latched SIPO/MUX GP matrix configuration options

# Copyright (c) 2023 TiaC Systems
# SPDX-License-Identifier: Apache-2.0

menu "Generic latched SIPO/MUX GP matrix controller"

config MFD_SIPOMUXGP
	bool
	help
	  Enable the generic latched SIPO/MUX General Purpose (GP) matrix
	  controller to have access to each GP signal individually. The
	  controller is implemented in software and supports currently
	  only outputs.

	  Hidden configuration entry for all SIPO/MUX GP backend drivers.

config MFD_SIPOMUXGP_XFR_WORKQUEUE_STACK_SIZE
	int "Stack size for the transfer work queue"
	default 1024
	depends on MFD_SIPOMUXGP
	help
	  Size of the stack used for the internal SIPO/MUX GP transfer
	  work queue.

config MFD_SIPOMUXGP_XFR_WORKQUEUE_NO_YIELD
	bool "Select whether transfer work queue yields"
	help
	  By default, the internal SIPO/MUX GP transfer work queue yields
	  between each work item, to prevent other threads from being starved.
	  Selecting this removes this yield, which may be useful if the work
	  queue thread is cooperative and a sequence of work items is expected
	  to complete without yielding.

config MFD_SIPOMUXGP_XFR_WORKQUEUE_PRIORITY
	int "Priority for transfer work queue"
	default 0 if !COOP_ENABLED
	default 8
	depends on MFD_SIPOMUXGP
	help
	  Priority level of the internal SIPO/MUX GP transfer work queue.

config MFD_SIPOMUXGP_INIT_PRIORITY
	int "Initialization priority"
	default MFD_INIT_PRIORITY
	depends on MFD_SIPOMUXGP
	help
	  Multi-function device initialization priority for the generic
	  latched SIPO/MUX General Purpose (GP) matrix controller. It
	  must be greater than the underlying controller init priority
	  of selected backend, e.g. SPI or GPIO.

config MFD_SIPOMUXGP_SPI
	bool "SPI driver backend"
	default y
	depends on DT_HAS_SIPO_MUX_GP_SPI_ENABLED
	depends on SPI
	select MFD_SIPOMUXGP
	help
	  The SPI driver is portable, as long as a Zephyr SPI API driver
	  is available on the SoC.

endmenu
```

## drivers/pinctrl/Kconfig
```kconfig
# Copyright (c) 2025 TiaC Systems
# SPDX-License-Identifier: Apache-2.0

if PINCTRL

# zephyr-keep-sorted-start
rsource "Kconfig.ch32x035"
# zephyr-keep-sorted-stop

endif # PINCTRL
```

## drivers/pinctrl/Kconfig.ch32x035
```kconfig
# Copyright (c) 2025 TiaC Systems
# SPDX-License-Identifier: Apache-2.0

config PINCTRL_CH32X035_AFIO
	bool "WCH CH32X035 Alternate Function IO pin controller driver"
	default y
	depends on DT_HAS_WCH_CH32X035_AFIO_ENABLED
```

## drivers/pinctrl/Kconfig.wch_x035_afio
```kconfig
# Copyright (c) 2025 TiaC Systems
# SPDX-License-Identifier: Apache-2.0

config PINCTRL_WCH_X035_AFIO
	bool "WCH AFIO pin controller driver for CH32X035"
	default y
	depends on DT_HAS_WCH_X035_AFIO_ENABLED
	help
	  WCH CH32X035 AFIO pin controller driver.
```

## drivers/rtc/Kconfig.ds3231
```kconfig
# Maxim DS3231 RTC configuration options

# Copyright (c) 2024 TiaC Systems
# SPDX-License-Identifier: Apache-2.0

menuconfig RTC_DS3231
	bool "Maxim DS3231 Real-Time-Clock"
	default y
	depends on DT_HAS_MAXIM_DS3231_RTC_ENABLED
	select MFD
	help
	  Enable the Maxim DS3231 RTC driver.

config RTC_DS3231_INIT_PRIORITY
	int "Initialization priority"
	default 60
	depends on RTC_DS3231
	help
	  RTC device initialization priority for the Maxim DS3231 RTC.
```

## drivers/sensor/Kconfig
```kconfig
# Copyright (c) 2025 TiaC Systems
# SPDX-License-Identifier: Apache-2.0

if SENSOR

# zephyr-keep-sorted-start
rsource "sensortek/Kconfig"
# zephyr-keep-sorted-stop

endif # SENSOR
```

## drivers/sensor/Kconfig.ds3231_temp
```kconfig
# Maxim DS3231 RTC temperature sensor configuration options

# Copyright (c) 2024 TiaC Systems
# SPDX-License-Identifier: Apache-2.0

menuconfig DS3231_TEMP
	bool "Maxim DS3231 Ambient Temperature Sensor"
	default y
	depends on DT_HAS_MAXIM_DS3231_TEMP_ENABLED
	select MFD
	help
	  Enable the driver for the digital temperature sensor inside
	  the Maxim DS3231 RTC device.

config DS3231_TEMP_INIT_PRIORITY
	int "Initialization priority"
	default SENSOR_INIT_PRIORITY
	depends on DS3231_TEMP
	help
	  Sensor device initialization priority for the digital temperature
	  sensor inside the Maxim DS3231 RTC device.
```

## drivers/sensor/sensortek/stk8ba58/Kconfig
```kconfig
# Copyright (c) 2025 TiaC Systems
# SPDX-License-Identifier: Apache-2.0

config STK8BA58
	bool "STK8BA58 I2C accelerometer sensor"
	default y
	depends on DT_HAS_SENSORTEK_STK8BA58_ENABLED
	select I2C
	select CRC
	help
	  Enable driver for STK8BA58 3-axis MEMS accelerometer sensors.

if STK8BA58

choice STK8BA58_TRIGGER_MODE
	prompt "Trigger mode"
	help
	  Specify the type of triggering to be used by the driver.

config STK8BA58_TRIGGER_NONE
	bool "No trigger"

config STK8BA58_TRIGGER_GLOBAL_THREAD
	bool "Use global thread"
	depends on GPIO
	depends on $(dt_compat_any_has_prop,$(DT_COMPAT_SENSORTEK_STK8BA58),irq-gpios)
	select STK8BA58_TRIGGER

config STK8BA58_TRIGGER_OWN_THREAD
	bool "Use own thread"
	depends on GPIO
	depends on $(dt_compat_any_has_prop,$(DT_COMPAT_SENSORTEK_STK8BA58),irq-gpios)
	select STK8BA58_TRIGGER

endchoice

config STK8BA58_TRIGGER
	bool

config STK8BA58_THREAD_PRIORITY
	int "Thread priority"
	depends on STK8BA58_TRIGGER_OWN_THREAD
	default 10
	help
	  Priority of thread used by the driver to handle interrupts.

config STK8BA58_THREAD_STACK_SIZE
	int "Thread stack size"
	depends on STK8BA58_TRIGGER_OWN_THREAD
	default 1024
	help
	  Stack size of thread used by the driver to handle interrupts.

endif # STK8BA58
```

## drivers/serial/Kconfig.ch32
```kconfig
# Copyright (c) 2024 Matthew Tran
# SPDX-License-Identifier: Apache-2.0

menuconfig UART_CH32
	bool "CH32 UART driver"
	default y
	depends on DT_HAS_WCH_CH32_UART_ENABLED
	select SERIAL_HAS_DRIVER
	select SERIAL_SUPPORT_INTERRUPT
```
