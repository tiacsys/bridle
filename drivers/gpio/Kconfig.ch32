## drivers/serial/Kconfig.sc16is75x
```kconfig
# Copyright (c) 2024 TiaC Systems
# SPDX-License-Identifier: Apache-2.0

menuconfig UART_SC16IS75X
	bool "NXP SC16IS75x UART driver"
	default y
	depends on DT_HAS_NXP_SC16IS75X_UART_ENABLED
	depends on MFD_SC16IS75X
	help
	  Enable driver for UART controller part of an SC16IS75x bridge.

if UART_SC16IS75X

config UART_SC16IS75X_LOOPBACK
	bool "Enable internal loopback"
	help
	  Enable the NXP SC16IS75x local UART loopback mode (internal).

	  In this mode the RTS and DTR signals are looped back to the
	  CTS and DSR and the TX output is looped back to the RX input
	  internally for all channels.

config UART_SC16IS75X_INIT_PRIORITY
	int "Init priority"
	default 60
	help
	  Device driver initialization priority.

config UART_SC16IS75X_INTERRUPT_DRIVEN
	bool
	default y if UART_INTERRUPT_DRIVEN
	default n
	depends on MFD_SC16IS75X_INTERRUPTS
	depends on MFD_SC16IS75X_ASYNC

endif # UART_SC16IS75X
```

## drivers/stepper/Kconfig
```kconfig
# SPDX-FileCopyrightText: Copyright (c) 2023 Carl Zeiss Meditec AG
# SPDX-FileCopyrightText: Copyright (c) 2024 TiaC Systems
# SPDX-License-Identifier: Apache-2.0

# Top-level configuration file for Stepper motor drivers.

menuconfig STEPPER
	bool "Stepper motor drivers"
	help
	  Enable stepper motor driver configuration.

if STEPPER

module = STEPPER
module-str = stepper
source "subsys/logging/Kconfig.template.log_config"

config STEPPER_INIT_PRIORITY
	int "Stepper motor init priority"
	default 90
	help
	  System initialization priority for stepper motor drivers.

rsource "Kconfig.drv84xx"

endif # STEPPER
```

## drivers/stepper/Kconfig.drv84xx
```kconfig
# SPDX-FileCopyrightText: Copyright (c) 2024 TiaC Systems
# SPDX-License-Identifier: Apache-2.0

# FIXME: https://github.com/zephyrproject-rtos/zephyr/pull/68774#discussion_r1689296474
#        Add to build_all driver tests.
config DRV84XX
	bool "DRV84xx stepper motor driver"
	default y
	depends on DT_HAS_DRV84XX_ENABLED
	help
	  Enable driver for DRV84xx stepper motor driver.
```
