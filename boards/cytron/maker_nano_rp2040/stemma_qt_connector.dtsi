/*
 * SPDX-FileCopyrightText: Copyright (c) 2023-2026 TiaC Systems
 * SPDX-License-Identifier: Apache-2.0
 */

/ {
	stemma_connector: stemma-qt-connector {
		compatible = "stemma-qt-connector";
		#gpio-cells = <2>;
		gpio-map-mask = <0xffffffff 0xffffffc0>;
		gpio-map-pass-thru = <0 0x3f>;
		gpio-map = <0 0 &gpio0 27 0>,	/* GP27/PWM11 / A1 / I2C1-SCL */
			   <1 0 &gpio0 26 0>;	/* GP26/PWM10 / A0 / I2C1-SDA */
	};
};

zephyr_i2c: &i2c1 {};

stemma_i2c: &zephyr_i2c {};

qwiic_connector: &stemma_connector {};
qwiic_i2c: &stemma_i2c {};
