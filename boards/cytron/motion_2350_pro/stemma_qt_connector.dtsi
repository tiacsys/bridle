/*
 * SPDX-FileCopyrightText: Copyright (c) 2026 TiaC Systems
 * SPDX-License-Identifier: Apache-2.0
 */

/ {
	stemma_connector: stemma-qt-connector {
		compatible = "stemma-qt-connector";
		#gpio-cells = <2>;
		gpio-map-mask = <0xffffffff 0xffffffc0>;
		gpio-map-pass-thru = <0 0x3f>;
		gpio-map = <0 0 &gpio0 17 0>,	/* GP17/PWM1 / I2C0-SCL */
			   <1 0 &gpio0 16 0>;	/* GP16/PWM0 / I2C0-SDA */
	};
};

zephyr_i2c: &i2c0 {};

stemma_i2c: &zephyr_i2c {};

qwiic_connector: &stemma_connector {};
qwiic_i2c: &stemma_i2c {};
