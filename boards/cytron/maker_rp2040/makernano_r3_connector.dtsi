/*
 * Copyright (c) 2023-2024 TiaC Systems
 * SPDX-License-Identifier: Apache-2.0
 */

/ {
	arduino_nano_header: connector {
		compatible = "arduino-nano-header-r3";
		#gpio-cells = <2>;
		gpio-map-mask = <0xffffffff 0xffffffc0>;
		gpio-map-pass-thru = <0 0x3f>;
		gpio-map = <0 0 &gpio0 1 0>,	/* D0 / GP1/PWM1 / UART-RX */
			   <1 0 &gpio0 0 0>,	/* D1 / GP0/PWM0 / UART-TX */
			   <2 0 &gpio0 2 0>,	/* D2 / GP2/PWM2 */
			   <3 0 &gpio0 3 0>,	/* D3 / GP3/PWM3 */
			   <4 0 &gpio0 4 0>,	/* D4 / GP4/PWM4 */
			   <5 0 &gpio0 5 0>,	/* D5 / GP5/PWM5 */
			   <6 0 &gpio0 6 0>,	/* D6 / GP6/PWM6 */
			   <7 0 &gpio0 7 0>,	/* D7 / GP7/PWM7 */
			   <8 0 &gpio0 8 0>,	/* D8 / GP8/PWM8 */
			   <9 0 &gpio0 9 0>,	/* D9 / GP9/PWM9 */
			   <10 0 &gpio0 17 0>,	/* D10 / GP17/PWM1 / SPI-CSn */
			   <11 0 &gpio0 19 0>,	/* D11 / GP19/PWM3 / SPI-COPI */
			   <12 0 &gpio0 16 0>,	/* D12 / GP16/PWM0 / SPI-CIPO */
			   <13 0 &gpio0 18 0>,	/* D13 / GP18/PWM2 / SPI-SCK */
			   <14 0 &gpio0 26 0>,	/* D14 / GP26/PWM10 / A0 */
			   <15 0 &gpio0 27 0>,	/* D15 / GP27/PWM11 / A1 */
			   <16 0 &gpio0 28 0>,	/* D16 / GP28/PWM12 / A2 */
			   <17 0 &gpio0 29 0>,	/* D17 / GP29/PWM13 / A3 */
			   <18 0 &gpio0 12 0>,	/* D18 / GP12/PWM12 / I2C-SDA */
			   <19 0 &gpio0 13 0>,	/* D19 / GP13/PWM13 / I2C-SCL */
			   <20 0 &gpio0 14 0>,	/* D20 / GP14/PWM14 / (A6) */
			   <21 0 &gpio0 15 0>;	/* D21 / GP15/PWM15 / (A7) */
	};
};
