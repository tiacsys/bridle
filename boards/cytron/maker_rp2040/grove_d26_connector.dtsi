/*
 * Copyright (c) 2023-2024 TiaC Systems
 * SPDX-License-Identifier: Apache-2.0
 */

/ {
	grove_d26_header: grove-d26-connector {
		compatible = "seeed,grove-connector";
		#gpio-cells = <2>;
		gpio-map-mask = <0xffffffff 0xffffffc0>;
		gpio-map-pass-thru = <0 0x3f>;
		gpio-map = <0 0 &gpio0 26 0>,	/* GP26/PWM10 / A0 */
			   <1 0 &gpio0 6 0>;	/* GP6/PWM6 */
	};
};

&gpio0 {
	status = "okay";
};

#undef GROVE_PWM_D6_SLOW
#define GROVE_PWM_D6_SLOW				\
	&pwm {						\
		divider-frac-3 = <15>;			\
		divider-int-3 = <255>;			\
	};

#undef GROVE_PWM_D6_ENABLE
#define GROVE_PWM_D6_ENABLE				\
	&pwm {						\
		status = "okay";			\
	};

#undef GROVE_PWM_D6_PINCTRL
#define GROVE_PWM_D6_PINCTRL				\
	&pwm_grove {					\
		group6 {				\
			pinmux = <PWM_3A_P6>;		\
		};					\
	};

#undef GROVE_PWM_D26_SLOW
#define GROVE_PWM_D26_SLOW				\
	&pwm {						\
		divider-frac-5 = <15>;			\
		divider-int-5 = <255>;			\
	};

#undef GROVE_PWM_D26_ENABLE
#define GROVE_PWM_D26_ENABLE				\
	&pwm {						\
		status = "okay";			\
	};

#undef GROVE_PWM_D26_PINCTRL
#define GROVE_PWM_D26_PINCTRL				\
	&pwm_grove {					\
		group26 {				\
			pinmux = <PWM_5A_P26>;		\
		};					\
	};
