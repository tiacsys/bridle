## boards/cytron/maker_pi_rp2040/board.yml
```yaml
# SPDX-FileCopyrightText: Copyright (c) 2023-2026 TiaC Systems
# SPDX-License-Identifier: Apache-2.0

board:
  name: cytron_maker_pi_rp2040
  full_name: Cytron Maker Pi RP2040
  vendor: cytron
  socs:
    - name: rp2040
```

## boards/jsed/picoboy/Kconfig.picoboy
```kconfig
# SPDX-FileCopyrightText: Copyright (c) 2023-2026 TiaC Systems
# SPDX-License-Identifier: Apache-2.0

config BOARD_PICOBOY
	select SOC_RP2040 if BOARD_PICOBOY_RP2040
```

## boards/jsed/picoboy/board.yml
```yaml
# SPDX-FileCopyrightText: Copyright (c) 2023-2026 TiaC Systems
# SPDX-License-Identifier: Apache-2.0

board:
  name: picoboy
  full_name: PicoBoy
  vendor: jsed
  socs:
    - name: rp2040
```

## boards/jsed/picoboy_color/board.yml
```yaml
# SPDX-FileCopyrightText: Copyright (c) 2023-2026 TiaC Systems
# SPDX-License-Identifier: Apache-2.0

board:
  name: picoboy_color
  full_name: PicoBoy Color
  vendor: jsed
  socs:
    - name: rp2040
```

## boards/jsed/picoboy_color_plus/Kconfig.picoboy_color_plus
```kconfig
# SPDX-FileCopyrightText: Copyright (c) 2023-2026 TiaC Systems
# SPDX-License-Identifier: Apache-2.0

config BOARD_PICOBOY_COLOR_PLUS
	select SOC_RP2350A_M33 if BOARD_PICOBOY_COLOR_PLUS_RP2350A_M33
	select SOC_RP2350A_HAZARD3 if BOARD_PICOBOY_COLOR_PLUS_RP2350A_HAZARD3
```

## boards/jsed/picoboy_color_plus/board.yml
```yaml
# SPDX-FileCopyrightText: Copyright (c) 2023-2026 TiaC Systems
# SPDX-License-Identifier: Apache-2.0

board:
  name: picoboy_color_plus
  full_name: PicoBoy Color Plus
  vendor: jsed
  socs:
    - name: rp2350a
```

## boards/nologo/mini_usb_rp2040/board.yml
```yaml
# SPDX-FileCopyrightText: Copyright (c) 2025-2026 TiaC Systems
# SPDX-License-Identifier: Apache-2.0

board:
  name: mini_usb_rp2040
  full_name: Mini USB RP2040
  vendor: nologo
  socs:
    - name: rp2040
  revision:
    format: "custom"
    default: "4mb"
    revisions:
      - name: "4mb"
      - name: "16mb"
      - name: "chipled"
```

## boards/nologo/mini_usb_rp2350/Kconfig.mini_usb_rp2350
```kconfig
# SPDX-FileCopyrightText: Copyright (c) 2025-2026 TiaC Systems
# SPDX-License-Identifier: Apache-2.0

config BOARD_MINI_USB_RP2350
	select SOC_RP2350A_M33_0 if BOARD_MINI_USB_RP2350_RP2350A_M33_0
```

## boards/nologo/mini_usb_rp2350/board.yml
```yaml
# SPDX-FileCopyrightText: Copyright (c) 2025-2026 TiaC Systems
# SPDX-License-Identifier: Apache-2.0

board:
  name: mini_usb_rp2350
  full_name: Mini USB RP2350
  vendor: nologo
  socs:
    - name: rp2350a
  revision:
    format: "custom"
    default: "4mb"
    revisions:
      - name: "4mb"
      - name: "16mb"
```

## boards/nxp/mimxrt1170_evk/board.yml
```yaml
# SPDX-FileCopyrightText: 2026 TiaC Systems
# SPDX-License-Identifier: Apache-2.0

board:
  extend: mimxrt1170_evk
```

## boards/raspberrypi/rpi_pico2/Kconfig.rpi_pico2
```kconfig
# SPDX-FileCopyrightText: Copyright (c) 2026 TiaC Systems
# SPDX-License-Identifier: Apache-2.0

config BOARD_RPI_PICO2_RP2350A_HAZARD3_0
	bool

config BOARD_RPI_PICO2_RP2350A_HAZARD3_0_BBE
	bool
	select BOARD_RPI_PICO2_RP2350A_HAZARD3_0

config BOARD_RPI_PICO2_RP2350A_M33_0
	bool

config BOARD_RPI_PICO2_RP2350A_M33_0_BBE
	bool
	select BOARD_RPI_PICO2_RP2350A_M33_0

config BOARD_RPI_PICO2_RP2350A_M33_0_W
	bool

config BOARD_RPI_PICO2_RP2350A_M33_0_W_BBE
	bool
	select BOARD_RPI_PICO2_RP2350A_M33_0_W

config BOARD_RPI_PICO2_RP2350A_M33_0_MCUBOOT
	bool

config BOARD_RPI_PICO2_RP2350A_M33_0_MCUBOOT_BBE
	bool
	select BOARD_RPI_PICO2_RP2350A_M33_0_MCUBOOT

config BOARD_RPI_PICO2_RP2350A_M33_0_W_MCUBOOT
	bool

config BOARD_RPI_PICO2_RP2350A_M33_0_W_MCUBOOT_BBE
	bool
	select BOARD_RPI_PICO2_RP2350A_M33_0_W_MCUBOOT
```

## boards/raspberrypi/rpi_pico2/board.yml
```yaml
# SPDX-FileCopyrightText: Copyright (c) 2026 TiaC Systems
# SPDX-License-Identifier: Apache-2.0

board:
  extend: rpi_pico2
  variants:
    - name: bbe
      qualifier: rp2350a/hazard3_0
    - name: bbe
      qualifier: rp2350a/m33_0
    - name: bbe
      qualifier: rp2350a/m33_0/mcuboot
    - name: bbe
      qualifier: rp2350a/m33_0/w
    - name: bbe
      qualifier: rp2350a/m33_0/w/mcuboot
```

## boards/seeed/seeeduino_cm0/board.yml
```yaml
# SPDX-FileCopyrightText: 2023-2026 TiaC Systems
# SPDX-License-Identifier: Apache-2.0

board:
  name: seeeduino_cm0
  full_name: Seeeduino Cortex-M0+
  vendor: seeed
  socs:
    - name: samd21g18a
```

## boards/seeed/seeeduino_lotus/Kconfig.seeeduino_lotus
```kconfig
# Seeeduino Lotus Cortex-M0+ board configuration

# SPDX-FileCopyrightText: 2023-2026 TiaC Systems
# SPDX-License-Identifier: Apache-2.0

config BOARD_SEEEDUINO_LOTUS
	select SOC_SAMD21G18A
```

## boards/seeed/xiao_rp2350/Kconfig.xiao_rp2350
```kconfig
# SPDX-FileCopyrightText: Copyright (c) 2026 TiaC Systems
# SPDX-License-Identifier: Apache-2.0

config BOARD_XIAO_RP2350_RP2350A_HAZARD3_0
	bool

config BOARD_XIAO_RP2350_RP2350A_HAZARD3_0_BBE
	bool
	select BOARD_XIAO_RP2350_RP2350A_HAZARD3_0

config BOARD_XIAO_RP2350_RP2350A_M33_0
	bool

config BOARD_XIAO_RP2350_RP2350A_M33_0_BBE
	bool
	select BOARD_XIAO_RP2350_RP2350A_M33_0
```

## boards/seeed/xiao_rp2350/board.yml
```yaml
# SPDX-FileCopyrightText: Copyright (c) 2026 TiaC Systems
# SPDX-License-Identifier: Apache-2.0

board:
  extend: xiao_rp2350
  variants:
    - name: bbe
      qualifier: rp2350a/hazard3_0
    - name: bbe
      qualifier: rp2350a/m33_0
```

## boards/seeed/xiao_stm32c5/Kconfig.xiao_stm32c5
```kconfig
# SPDX-FileCopyrightText: Copyright (c) 2026 TiaC Systems
# SPDX-License-Identifier: Apache-2.0

config BOARD_XIAO_STM32C5_STM32C5A3XX
	bool

config BOARD_XIAO_STM32C5_STM32C5A3XX_BBE
	bool
	select BOARD_XIAO_STM32C5_STM32C5A3XX
```

## boards/seeed/xiao_stm32c5/board.yml
```yaml
# SPDX-FileCopyrightText: Copyright (c) 2026 TiaC Systems
# SPDX-License-Identifier: Apache-2.0

board:
  extend: xiao_stm32c5
  variants:
    - name: bbe
      qualifier: stm32c5a3xx
```

## boards/shields/arduino_led/Kconfig.shield
```kconfig
# SPDX-FileCopyrightText: Copyright (c) 2026 TiaC Systems
# SPDX-License-Identifier: Apache-2.0

config SHIELD_ADAFRUIT_NEOPIXEL_8X5_RGB_MATRIX_ARDUINO
	def_bool $(shields_list_contains,adafruit_neopixel_8x5_rgb_matrix_arduino)
```

## boards/shields/grove_btn/Kconfig.shield
```kconfig
# Copyright (c) 2026 TiaC Systems
# SPDX-License-Identifier: Apache-2.0

config SHIELD_GROVE_BTN_RIG
	def_bool $(shields_list_contains,grove_btn)
```

## boards/shields/grove_led/Kconfig.shield
```kconfig
# SPDX-License-Identifier: Apache-2.0

config SHIELD_GROVE_LED_RIG
	def_bool $(shields_list_contains,grove_led)

config SHIELD_GROVE_PWM_LED_RIG
	def_bool $(shields_list_contains,grove_pwm_led)
```
