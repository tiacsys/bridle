/*
 * SPDX-FileCopyrightText: Copyright (c) 2023-2026 TiaC Systems
 * SPDX-License-Identifier: Apache-2.0
 */

#include <mem.h>

#include <raspberrypi/partitions_2M_default.dtsi>

/ {
	model = "Waveshare RP2040-Plus (4MB) @ UART Concole";
	compatible = "waveshare,rp2040-plus",
		     "waveshare,rp2040-plus-uartcons",
		     "waveshare,rp2040-plus-4mb",
		     "waveshare,rp2040-plus-4mb-uartcons";
};

&flash0 {
	reg = <0x10000000 DT_SIZE_M(4)>;
	ranges = <0x0 0x10000000 DT_SIZE_M(4)>;
};

&storage_partition {
	reg = <0x100000 DT_SIZE_M(3)>;
};
