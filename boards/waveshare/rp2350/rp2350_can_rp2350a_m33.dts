/*
 * Copyright (c) 2025 TiaC Systems
 * SPDX-License-Identifier: Apache-2.0
 */
 # 

/dts-v1/;

#include <raspberrypi/rpi_pico/rp2350a.dtsi>
#include <raspberrypi/rpi_pico/m33.dtsi>

#include "rp2350_can_base_peripherals.dtsi"
#include "xl2515_can.dtsi"
#include "rpi_pico-led.dtsi"
