/*
 * Copyright (c) 2025 TiaC Systems
 * SPDX-License-Identifier: Apache-2.0
 */

#include <mem.h>

#include "waveshare_rp2350-flash.dtsi"
#include <raspberrypi/partitions_4M_default.dtsi>

&flash0 {
	reg = <0x10000000 DT_SIZE_M(4)>;
};
