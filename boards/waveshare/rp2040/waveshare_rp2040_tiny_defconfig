## boards/waveshare/rp2040/waveshare_rp2040_tiny_defconfig
```kconfig
# Copyright (c) 2023-2025 TiaC Systems
# SPDX-License-Identifier: Apache-2.0

CONFIG_BUILD_OUTPUT_UF2=y
CONFIG_BUILD_OUTPUT_HEX=y

CONFIG_USE_DT_CODE_PARTITION=y

CONFIG_SERIAL=y
CONFIG_CONSOLE=y
CONFIG_UART_CONSOLE=y
CONFIG_UART_INTERRUPT_DRIVEN=y
```

## boards/waveshare/rp2350/Kconfig.rp2350_can
```kconfig
# Copyright (c) 2025 TiaC Systems
# SPDX-License-Identifier: Apache-2.0

config BOARD_RP2350_CAN
	select SOC_RP2350A

config  BOARD_RP2350_CAN_RP2350A_M33
	select SOC_RP2350A_M33
```

## boards/waveshare/rp2350/Kconfig.waveshare_rp2350_can
```kconfig
# Copyright (c) 2025 TiaC Systems
# SPDX-License-Identifier: Apache-2.0

config BOARD_WAVESHARE_RP2350_CAN
	select SOC_RP2350A_M33 if BOARD_WAVESHARE_RP2350_CAN_RP2350A_M33
	select SOC_RP2350A_HAZARD3 if BOARD_WAVESHARE_RP2350_CAN_RP2350A_HAZARD3
```

## boards/waveshare/rp2350/board.yml
```yaml
# Copyright (c) 2025 TiaC Systems
# SPDX-License-Identifier: Apache-2.0

boards:
  - name: waveshare_rp2350_can
    full_name: Waveshare RP2350-CAN
    vendor: waveshare
    socs:
      - name: rp2350a
```

## boards/weact/bluepill_f103cb/Kconfig.bluepill_f103cb
```kconfig
# Copyright (c) 2024 TiaC Systems
# SPDX-License-Identifier: Apache-2.0

config BOARD_BLUEPILL_F103CB
	select SOC_STM32F103XB
```

## boards/weact/bluepill_f103cb/Kconfig.defconfig
```kconfig
# Copyright (c) 2024 TiaC Systems
# SPDX-License-Identifier: Apache-2.0

# F103CB based Blue Pill Plus V1.0 board board configuration

config SPI_STM32_INTERRUPT
	default y
	depends on SPI && BOARD_BLUEPILL_F103CB
```

## boards/weact/bluepill_f103cb/bluepill_f103cb_defconfig
```kconfig
# Copyright (c) 2024 TiaC Systems
# SPDX-License-Identifier: Apache-2.0

CONFIG_GPIO=y
CONFIG_CONSOLE=y
CONFIG_SERIAL=y
CONFIG_UART_CONSOLE=y
CONFIG_UART_LINE_CTRL=y
CONFIG_UART_INTERRUPT_DRIVEN=y

CONFIG_USB_DEVICE_STACK=y
CONFIG_USB_DEVICE_VID=0x0483
CONFIG_USB_DEVICE_PID=0x5740
CONFIG_USB_DEVICE_MANUFACTURER="WeAct Studio"
CONFIG_USB_DEVICE_PRODUCT="Blue Pill Plus V1.0 STM32F1 (CDC ACM)"
CONFIG_USB_DEVICE_INITIALIZE_AT_BOOT=y

CONFIG_USB_DC_STM32_CLOCK_CHECK=y
# TODO: CONFIG_USB_DEVICE_REMOTE_WAKEUP=n
```

## boards/weact/bluepill_f103cb/board.yml
```yaml
# Copyright (c) 2024 TiaC Systems
# SPDX-License-Identifier: Apache-2.0

board:
  name: bluepill_f103cb
  full_name: Blue Pill Plus V1.0
  vendor: weact
  socs:
    - name: stm32f103xb
```

## boards/weact/bluepillplus/Kconfig.defconfig
```kconfig
# Copyright (c) 2025 TiaC Systems
# SPDX-License-Identifier: Apache-2.0

config BOARD_WEACT_BLUEPILLPLUS
	bool
	default y if BOARD_WEACT_BLUEPILLPLUS_STM32F103C8
	default y if BOARD_WEACT_BLUEPILLPLUS_STM32F103CB
	default y if BOARD_WEACT_BLUEPILLPLUS_CH32V203C6
	default y if BOARD_WEACT_BLUEPILLPLUS_CH32V203C8
	default n

config BOARD_WEACT_BLUEPILLPLUS_USBCONS
	bool
	default y if BOARD_WEACT_BLUEPILLPLUS_STM32F103C8
	default y if BOARD_WEACT_BLUEPILLPLUS_STM32F103CB
	default n

config CLOCK_CONTROL
	default y
	depends on DT_HAS_ST_STM32_RCC_ENABLED || DT_HAS_WCH_RCC_ENABLED

config RESET
	default y
	depends on DT_HAS_ST_STM32_RCC_RCTL_ENABLED || DT_HAS_WCH_RCC_ENABLED

config GPIO
	default y
	depends on DT_HAS_ST_STM32_GPIO_ENABLED || DT_HAS_WCH_GPIO_ENABLED

# Workaround for not being able to have commas in macro arguments
DT_CHOSEN_Z_CONSOLE := zephyr,console
DT_COMPAT_Z_CDC_ACM_UART := zephyr,cdc-acm-uart
DT_COMPAT_STM32_USB := st,stm32-usb

# Macros to shorten Kconfig expressions
DT_CHOSEN_CONSOLE_NODE := $(dt_chosen_path,$(DT_CHOSEN_Z_CONSOLE))
DT_CHOSEN_CONSOLE_PARENT := $(dt_node_parent,$(DT_CHOSEN_CONSOLE_NODE))

if BOARD_WEACT_BLUEPILLPLUS_USBCONS && \
	$(dt_chosen_enabled,$(DT_CHOSEN_Z_CONSOLE)) && \
	$(dt_compat_on_bus,$(DT_COMPAT_Z_CDC_ACM_UART),usb) && \
	$(dt_node_has_compat,$(DT_CHOSEN_CONSOLE_PARENT),$(DT_COMPAT_STM32_USB))

config CDC_ACM_SERIAL_SELF_POWERED
	default n
	depends on USB_DEVICE_STACK_NEXT && USBD_CDC_ACM_CLASS

config CDC_ACM_SERIAL_MAX_POWER
	default 250 if BOARD_WEACT_BLUEPILLPLUS_STM32F103C8	# 500mA
	default 250 if BOARD_WEACT_BLUEPILLPLUS_STM32F103CB	# 500mA
	depends on USB_DEVICE_STACK_NEXT && USBD_CDC_ACM_CLASS

# Logger cannot use itself to log
choice USBD_CDC_ACM_LOG_LEVEL_CHOICE
	default USBD_CDC_ACM_LOG_LEVEL_OFF
	depends on LOG && USB_DEVICE_STACK_NEXT && USBD_CDC_ACM_CLASS
endchoice

# Set USB log level to error only
choice USBD_LOG_LEVEL_CHOICE
	default USBD_LOG_LEVEL_ERR
	depends on LOG && USB_DEVICE_STACK_NEXT && USBD_CDC_ACM_CLASS
endchoice

# Set UDC driver log level to error only
choice UDC_DRIVER_LOG_LEVEL_CHOICE
	default UDC_DRIVER_LOG_LEVEL_ERR
	depends on LOG && USB_DEVICE_STACK_NEXT && USBD_CDC_ACM_CLASS
endchoice

endif # zephyr,cdc-acm-uart
```

## boards/weact/bluepillplus/Kconfig.weact_bluepillplus_ch32v203c8
```kconfig
# Copyright (c) 2025 TiaC Systems
# SPDX-License-Identifier: Apache-2.0

config BOARD_WEACT_BLUEPILLPLUS_CH32V203C8
	select SOC_CH32V203
```

## boards/weact/bluepillplus/Kconfig.weact_bluepillplus_stm32f103cb
```kconfig
# Copyright (c) 2025 TiaC Systems
# SPDX-License-Identifier: Apache-2.0

config BOARD_WEACT_BLUEPILLPLUS_STM32F103CB
	select SOC_STM32F103XB
```

## boards/weact/bluepillplus/board.yml
```yaml
# Copyright (c) 2025 TiaC Systems
# SPDX-License-Identifier: Apache-2.0

boards:
  - name: weact_bluepillplus_stm32f103c8
    full_name: WeAct BluePill+ STM32F103C8
    vendor: weact
    socs:
      - name: stm32f103xb
  - name: weact_bluepillplus_stm32f103cb
    full_name: WeAct BluePill+ STM32F103CB
    vendor: weact
    socs:
      - name: stm32f103xb
  - name: weact_bluepillplus_ch32v203c6
    full_name: WeAct BluePill+ CH32V203C6
    vendor: weact
    socs:
      - name: ch32v203
  - name: weact_bluepillplus_ch32v203c8
    full_name: WeAct BluePill+ CH32V203C8
    vendor: weact
    socs:
      - name: ch32v203
```

## drivers/Kconfig
```kconfig
# Copyright (c) 2021-2025 TiaC Systems
# Copyright (c) 2019-2021 Li-Pro.Net
# SPDX-License-Identifier: Apache-2.0

menu "Device Drivers"

# zephyr-keep-sorted-start
rsource "display/Kconfig"
rsource "gpio/Kconfig"
rsource "i2c/Kconfig"
rsource "mfd/Kconfig"
rsource "sensor/Kconfig"
rsource "serial/Kconfig"
# zephyr-keep-sorted-stop

endmenu
```

## drivers/actuator/Kconfig
```kconfig
# Copyright (c) 2023 TiaC Systems
#
# SPDX-License-Identifier: Apache-2.0

menuconfig BRIDLE_ACTUATOR
	bool "Actuator Drivers"
	help
	  Include actuator drivers in system config.

if BRIDLE_ACTUATOR

module = BRIDLE_ACTUATOR
module-dep = LOG
module-str = Bridle actuator
module-help = Sets log level for Bridle actuator.
source "subsys/logging/Kconfig.template.log_config"

config BRIDLE_ACTUATOR_INIT_PRIORITY
	int "Actuator init priority"
	default 90
	help
	  Actuator initialization priority.

config BRIDLE_ACTUATOR_SHELL
	bool "Actuator shell"
	depends on SHELL
	select CBPRINTF_FP_SUPPORT
	default y if !SHELL_MINIMAL
	help
	  This shell provides access to basic actuator actions.

config BRIDLE_ACTUATOR_INFO
	bool "Actuator Info iterable section"

comment "Device Drivers"

endif # BRIDLE_ACTUATOR
```

## drivers/actuator/tmc/Kconfig
```kconfig
# Copyright (c) 2023 TiaC Systems
#
# SPDX-License-Identifier: Apache-2.0

menuconfig TMC
	bool "Trinamic Motion Control (TMC) support"
	help
	  Enable Trinamic Motion Control (TMC) driver support.

if TMC

config TMC_SD
	bool "Use STEP/DIR mode"
	select GPIO

config TMC_SPI
	bool "Use SPI mode"
	select SPI

config TMC_UART
	bool "Use UART mode"
	select SERIAL

comment "TMC Chip Drivers"

endif # TMC
```

## drivers/actuator/tmc/Kconfig.tmc2130
```kconfig
# Copyright (c) 2023 TiaC Systems
# Copyright (c) 2022 Stefano Cottafavi
#
# SPDX-License-Identifier: Apache-2.0

config TMC2130
	bool "Enable support for the TMC2130 stepper driver"
	default y
	depends on DT_HAS_TRINAMIC_TMC2130_ENABLED
	select TMC_SPI if $(dt_compat_on_bus,$(DT_COMPAT_TRINAMIC_TMC2130),spi)
	select HAS_TMCAPI
	select USE_TCMAPI_TMC2130
	help
	  Enable TMC2130 stepper driver.

if TMC2130

# TODO: diag pins and others

endif # TMC2130
```

## drivers/adc/Kconfig
```kconfig
# Copyright (c) 2025 TiaC Systems
# Copyright (c) 2024 Matthew Tran
# SPDX-License-Identifier: Apache-2.0

if ADC

# zephyr-keep-sorted-start
rsource "Kconfig.ch32"
# zephyr-keep-sorted-stop

endif # ADC
```

## drivers/adc/Kconfig.ch32
```kconfig
# Copyright (c) 2024 Matthew Tran
# SPDX-License-Identifier: Apache-2.0

menuconfig ADC_CH32
	bool "CH32 ADC driver"
	default y
	depends on DT_HAS_WCH_CH32_ADC_ENABLED

config ADC_CH32_INIT_PRIORITY
	int "Init priority"
	default KERNEL_INIT_PRIORITY_DEFAULT
	depends on ADC_CH32
	help
	  Device driver initialization priority.
```

## drivers/clock_control/Kconfig
```kconfig
# Copyright (c) 2025 TiaC Systems
# SPDX-License-Identifier: Apache-2.0

if CLOCK_CONTROL

# zephyr-keep-sorted-start
rsource "Kconfig.ch32"
# zephyr-keep-sorted-stop

endif # CLOCK_CONTROL
```

## drivers/clock_control/Kconfig.ch32
```kconfig
# Copyright (c) 2025 TiaC Systems
# Copyright (c) 2024 Michael Hope
# SPDX-License-Identifier: Apache-2.0

menuconfig CLOCK_CONTROL_CH32_RCC
	bool "WCH CH32 Reset and Clock Control (RCC) driver"
	default y
	depends on DT_HAS_WCH_CH32_RCC_ENABLED
```

## drivers/display/Kconfig
```kconfig
# Copyright (c) 2023-2025 TiaC Systems
# SPDX-License-Identifier: Apache-2.0

if DISPLAY

# zephyr-keep-sorted-start
rsource "Kconfig.sipomux"
# zephyr-keep-sorted-stop

endif # DISPLAY
```

## drivers/display/Kconfig.led_panel
```kconfig
# Copyright (c) 2023 TOKITA Hiroshi
# SPDX-License-Identifier: Apache-2.0

config LED_PANEL
	bool "LED panel display driver"
	default y
	depends on DT_HAS_LED_PANEL_ENABLED
	help
	  Enable dummy display driver compliant with display driver API.

##############################################################################
#
# TODO: needs CMake arguments:
#
#       -DCONFIG_ASSERT=y
#       -DCONFIG_DISPLAY_LOG_LEVEL_DBG=y
#
#       -DCONFIG_LED_STRIP=y
#       -DCONFIG_WS2812_STRIP=y
#
#       -DCONFIG_DISPLAY_INIT_PRIORITY=91     (orig: 85)
#       -DCONFIG_LED_STRIP_INIT_PRIORITY=90

config LED_STRIP
	default y if DT_HAS_LED_PANEL_ENABLED
	depends on LED_PANEL

config WS2812_STRIP
	default y if DT_HAS_LED_PANEL_ENABLED
	depends on LED_PANEL

config LED_STRIP_INIT_PRIORITY
	default 90 if DT_HAS_LED_PANEL_ENABLED
	depends on LED_PANEL

config DISPLAY_INIT_PRIORITY
	default 91 if DT_HAS_LED_PANEL_ENABLED
	depends on LED_PANEL

config ASSERT
	default y if DT_HAS_LED_PANEL_ENABLED
	depends on LED_PANEL

choice DISPLAY_LOG_LEVEL_CHOICE
	default DISPLAY_LOG_LEVEL_DBG if DT_HAS_LED_PANEL_ENABLED
	depends on LED_PANEL && LOG
endchoice
```

## drivers/display/Kconfig.sipomux
```kconfig
# Latched SIPO/MUX display configuration options

# Copyright (c) 2023 TiaC Systems
# SPDX-License-Identifier: Apache-2.0

menuconfig DISPLAY_SIPOMUX
	bool "Generic latched SIPO/MUX display controller"
	default y
	depends on DT_HAS_SIPO_MUX_DISPLAY_ENABLED
	select MFD
	help
	  Enable the generic latched SIPO/MUX display driver.

config DISPLAY_SIPOMUX_INIT_PRIORITY
	int "Initialization priority"
	default DISPLAY_INIT_PRIORITY
	depends on DISPLAY_SIPOMUX
	help
	  Initialization priority for the generic latched SIPO/MUX display
	  driver. It must be greater than the MFD controller init priority.
```

## drivers/gpio/Kconfig
```kconfig
# Copyright (c) 2021-2024 TiaC Systems
# SPDX-License-Identifier: Apache-2.0

if GPIO

rsource "Kconfig.pca9554_regrst"
rsource "Kconfig.pca9555"
rsource "Kconfig.sc16is75x"
rsource "Kconfig.sc18is604"
rsource "Kconfig.sipomux"

endif # GPIO
```
