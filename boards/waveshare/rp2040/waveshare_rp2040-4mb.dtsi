/*
 * Copyright (c) 2023-2025 TiaC Systems
 * SPDX-License-Identifier: Apache-2.0
 */

#include <mem.h>

#include "waveshare_rp2040-flash.dtsi"
#include <raspberrypi/partitions_2M_default.dtsi>

&flash0 {
	reg = <0x10000000 DT_SIZE_M(4)>;
};

&storage_partition {
	reg = <0x100000 DT_SIZE_M(3)>;
};
