/*
 * Copyright (c) 2023-2024 TiaC Systems
 * SPDX-License-Identifier: Apache-2.0
 */

#include "waveshare_rp2040-4mb.dtsi"

/ {
	model = "Waveshare RP2040-Plus (4MB) @ UART Concole";
	compatible = "waveshare,rp2040-plus", "waveshare,rp2040-plus-uartcons",
		     "waveshare,rp2040-plus-4mb", "waveshare,rp2040-plus-4mb-uartcons";
};
