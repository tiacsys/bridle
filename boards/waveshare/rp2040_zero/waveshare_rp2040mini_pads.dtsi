/*
 * SPDX-FileCopyrightText: Copyright (c) 2023-2026 TiaC Systems
 * SPDX-License-Identifier: Apache-2.0
 */

#include <zephyr/dt-bindings/gpio/waveshare-rp2040mini-pcbpads.h>

/ {
	rp2040mini_pcbpads: rp2040mini-solder-pads {
		compatible = "waveshare,rp2040mini-pcbpads";
		#gpio-cells = <2>;
		gpio-map-mask = <0xffffffff 0xffffffc0>;
		gpio-map-pass-thru = <0 0x3f>;
		gpio-map = <WS_RP2040MINI_PCBPAD_D0 0 &gpio0 17 0>,	/* GP17 */
			   <WS_RP2040MINI_PCBPAD_D1 0 &gpio0 18 0>,	/* GP18 */
			   <WS_RP2040MINI_PCBPAD_D2 0 &gpio0 19 0>,	/* GP19 */
			   <WS_RP2040MINI_PCBPAD_D3 0 &gpio0 20 0>,	/* GP20 */
			   <WS_RP2040MINI_PCBPAD_D4 0 &gpio0 21 0>,	/* GP21 */
			   <WS_RP2040MINI_PCBPAD_D5 0 &gpio0 22 0>,	/* GP22 */
			   <WS_RP2040MINI_PCBPAD_D6 0 &gpio0 23 0>,	/* GP23 */
			   <WS_RP2040MINI_PCBPAD_D7 0 &gpio0 24 0>,	/* GP24 */
			   <WS_RP2040MINI_PCBPAD_D8 0 &gpio0 25 0>;	/* GP25 */
	};
};
