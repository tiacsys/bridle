## boards/waveshare/rp2040_zero/board.yml
```yaml
# SPDX-FileCopyrightText: Copyright (c) 2023-2026 TiaC Systems
# SPDX-License-Identifier: Apache-2.0

board:
  name: waveshare_rp2040_zero
  full_name: Waveshare RP2040-Zero
  vendor: waveshare
  socs:
    - name: rp2040
```

## boards/waveshare/rp2350_can/Kconfig.waveshare_rp2350_can
```kconfig
# SPDX-FileCopyrightText: Copyright (c) 2025-2026 TiaC Systems
# SPDX-License-Identifier: Apache-2.0

config BOARD_WAVESHARE_RP2350_CAN
	select SOC_RP2350A_HAZARD3_0 if BOARD_WAVESHARE_RP2350_CAN_RP2350A_HAZARD3_0
	select SOC_RP2350A_M33_0 if BOARD_WAVESHARE_RP2350_CAN_RP2350A_M33_0
```

## boards/waveshare/rp2350_can/board.yml
```yaml
# SPDX-FileCopyrightText: Copyright (c) 2025-2026 TiaC Systems
# SPDX-License-Identifier: Apache-2.0

board:
  name: waveshare_rp2350_can
  full_name: Waveshare RP2350-CAN
  vendor: waveshare
  socs:
    - name: rp2350a
```

## boards/waveshare/rp2350_matrix/Kconfig.waveshare_rp2350_matrix
```kconfig
# SPDX-FileCopyrightText: Copyright (c) 2026 TiaC Systems
# SPDX-License-Identifier: Apache-2.0

config BOARD_WAVESHARE_RP2350_MATRIX
	select SOC_RP2350A_HAZARD3_0 if BOARD_WAVESHARE_RP2350_MATRIX_RP2350A_HAZARD3_0
	select SOC_RP2350A_M33_0 if BOARD_WAVESHARE_RP2350_MATRIX_RP2350A_M33_0
```

## boards/waveshare/rp2350_matrix/board.yml
```yaml
# SPDX-FileCopyrightText: Copyright (c) 2026 TiaC Systems
# SPDX-License-Identifier: Apache-2.0

board:
  name: waveshare_rp2350_matrix
  full_name: Waveshare RP2350-Matrix
  vendor: waveshare
  socs:
    - name: rp2350a
```

## drivers/i2c/Kconfig
```kconfig
# SPDX-FileCopyrightText: 2024-2026 TiaC Systems
# SPDX-License-Identifier: Apache-2.0

if I2C

# zephyr-keep-sorted-start
rsource "Kconfig.sc18is604"
# zephyr-keep-sorted-stop

endif # I2C
```

## drivers/mfd/Kconfig
```kconfig
# SPDX-FileCopyrightText: 2023-2026 TiaC Systems
# SPDX-License-Identifier: Apache-2.0

if MFD

# zephyr-keep-sorted-start
rsource "Kconfig.sc16is75x"
rsource "Kconfig.sipomuxgp"
rsource "sc18is604/Kconfig"
# zephyr-keep-sorted-stop

endif # MFD
```

## drivers/sensor/sensortek/Kconfig
```kconfig
# SPDX-FileCopyrightText: 2025-2026 TiaC Systems
# SPDX-License-Identifier: Apache-2.0

# zephyr-keep-sorted-start
rsource "stk8ba58/Kconfig"
# zephyr-keep-sorted-stop
```

## drivers/serial/Kconfig
```kconfig
# SPDX-FileCopyrightText: 2024-2026 TiaC Systems
# SPDX-License-Identifier: Apache-2.0

if SERIAL

# zephyr-keep-sorted-start
rsource "Kconfig.sc16is75x"
# zephyr-keep-sorted-stop

endif # SERIAL
```

## dts/bindings/gpio/adafruit,stemma-connector.yaml
```yaml
# SPDX-FileCopyrightText: Copyright (c) 2023-2026 TiaC Systems
# SPDX-License-Identifier: Apache-2.0

description: |
    GPIO pins exposed on Adafruit STEMMA connector.

    The STEMMA layout provides either an 3-pin or 4-pin 2mm JST PH connector,
    along on one edge of the board. Information and pin assignment can be
    found at:

    - https://learn.adafruit.com/introducing-adafruit-stemma-qt/what-is-stemma

    This binding provides a nexus mapping for 2 pins where parent
    pins 0 through 1 correspond as depicted below (with cable color):

        4-pin      I2C only

         (green) 0 SCL
         (white) 1 SDA
           (red) - VCC  (3V3 or 5V0)
         (black) - GND

        3-pin      analog or digital sensors

         (green) 0 A/D
           (red) - VCC  (3V3 or 5V0)
         (black) - GND

    STEMMA QT, Grove, Qwiic, and Gravity connectors are similar to this,
    but the connector form and VCC voltage are different. Please see
    https://learn.adafruit.com/introducing-adafruit-stemma-qt/stemma-qt-comparison

    Use STEMMA_* constants in
    <zephyr/dt-bindings/gpio/stemma-connector.h> to refer to specific
    pins using convenient constant names.

compatible: "adafruit,stemma-connector"

include: [gpio-nexus.yaml, base.yaml]
```

## dts/bindings/gpio/adafruit,stemma-qt-connector.yaml
```yaml
# SPDX-FileCopyrightText: Copyright (c) 2023-2026 TiaC Systems
# SPDX-License-Identifier: Apache-2.0

description: |
    GPIO pins exposed on Adafruit STEMMA QT connector.

    The STEMMA QT layout provides an 4-pin 1mm JST SH connector, along on
    one edge of the board. Pin assignment can be found at:

    - https://learn.adafruit.com/introducing-adafruit-stemma-qt/what-is-stemma-qt

    This binding provides a nexus mapping for 2 pins where parent
    pins 0 through 1 correspond as depicted below (with cable color):

        4-pin      I2C only

        (yellow) 0 SCL
          (blue) 1 SDA
           (red) - VCC  (3V3 or 5V0)
         (black) - GND

    STEMMA, Grove, Qwiic, and Gravity connectors are similar to this,
    but the connector form and VCC voltage are different. Please see
    https://learn.adafruit.com/introducing-adafruit-stemma-qt/stemma-qt-comparison

    Use STEMMA_QT_* constants in
    <zephyr/dt-bindings/gpio/stemma-qt-connector.h> to refer to specific
    pins using convenient constant names.

compatible: "adafruit,stemma-qt-connector"

include: [gpio-nexus.yaml, base.yaml]
```

## dts/bindings/gpio/nologo,miniusb-header.yaml
```yaml
# SPDX-FileCopyrightText: Copyright (c) 2025-2026 TiaC Systems
# SPDX-License-Identifier: Apache-2.0

description: |
    GPIO pins exposed on No Name Technology Mini USB RP2040/RP2350 headers.

    The Mini USB RP2040/RP2350 layout provides a wraparound header on the
    longer freely accessible edges of the board and can be divided into
    two sections, two headers on the longer opposite sides.

    Proceeding counter-clockwise:
    * A 9-pin header. 9 pins on this header are exposed by this binding.
    * A 9-pin header. 6 pins on this header are exposed by this binding.

    This binding provides a nexus mapping for 15 pins where parent pins 11
    through 14 correspond to ADC0 through ADC3, and parent pins 0 through 14
    correspond as depicted below:

                  .---------.
                  |         |
                  |  USB-A  |
                  |         |
                  |         |
                  |         |
               .--´         `--.
               |               |
        D0   0 GP0            5V -
        D1   1 GP1           GND -
        D2   2 GP2           3V3 -
        D3   3 GP3     ADC3/GP29 14  A3
        D4   4 GP4     ADC2/GP28 13  A2
        D5   5 GP5     ADC1/GP27 12  A1
        D6   6 GP6     ADC0/GP26 11  A0
        D7   7 GP7          GP15 10  D10
        D8   8 GP8          GP14 9   D9
               |               |
               `---------------´

    Use NNT_MINIUSB_HEADER_* constants in
    <zephyr/dt-bindings/gpio/nologo-miniusb-header.h> to refer
    to specific pins using convenient constant names.

compatible: "nologo,miniusb-header"

include: [gpio-nexus.yaml, base.yaml]
```

## dts/bindings/gpio/nologo,miniusb-pcbpads.yaml
```yaml
# SPDX-FileCopyrightText: Copyright (c) 2025-2026 TiaC Systems
# SPDX-License-Identifier: Apache-2.0

description: |
    GPIO pins exposed on No Name Technology Mini USB RP2040/RP2350 solder pads.

    The Mini USB RP2040/RP2350 layout provides a line of ten solder pads on the
    bottom side of the board.

    This binding provides a nexus mapping for 13 pads where parent pins 0
    through 12 correspond as depicted below:

                  .---------.
                  |         |
                  |  USB-A  |
                  |         |
                  |         |
                  |         |
               .--´         `--.
               |               |
               ]               [
               ]         GP9   [ 0   D0
       D12  12 ]  GP25   GP10  [ 1   D1
       D11  11 ]  GP24   GP11  [ 2   D2
       D10  10 ]  GP23   GP12  [ 3   D3
       D9    9 ]  GP22   GP13  [ 4   D4
       D8    8 ]  GP21   GP18  [ 5   D5
       D7    7 ]  GP20   GP19  [ 6   D6
               ]               [
               |               |
               `---------------´

    Use NNT_MINIUSB_PCBPAD_* constants in
    <zephyr/dt-bindings/gpio/nologo-miniusb-pcbpads.h> to refer
    to specific pins using convenient constant names.

compatible: "nologo,miniusb-pcbpads"

include: [gpio-nexus.yaml, base.yaml]
```

## dts/bindings/gpio/nxp,sc18is604-gpio.yaml
```yaml
# Copyright (c) 2024-2026 TiaC Systems
# SPDX-License-Identifier: Apache-2.0

description: GPIO controller part of an SC18IS604 bridge

compatible: "nxp,sc18is604-gpio"

include: [gpio-controller.yaml]

properties:
  "#gpio-cells":
    const: 2

  ngpios:
    required: true
    const: 5

gpio-cells:
  - pin
  - flags

on-bus: nxp,sc18is604
```

## dts/bindings/gpio/raspberrypi,pico-header-r3.yaml
```yaml
# SPDX-FileCopyrightText: Copyright (c) 2023-2026 TiaC Systems
# SPDX-License-Identifier: Apache-2.0

description: |
    GPIO pins exposed on Raspberry Pi Pico (R3) headers.

    The Pico layout provides two headers, one each along opposite edges
    of the board.

    Proceeding counter-clockwise:
    * A 20-pin header.  16 pins on this header are exposed by this binding.
    * A 20-pin header.  10 pins on this header are exposed by this binding.

    This binding provides a nexus mapping for 26 pins where parent pins 23
    through 25 correspond to ADC0 through ADC2, and parent pins 0 through 22
    correspond as depicted below:

        0 GP0/UART0_TX                    VBUS -
        1 GP1/UART0_RX                    VSYS -
        - GND                              GND -
        2 GP2/UART0_CTS                 3V3_EN -
        3 GP3/UART0_RTS                3V3_OUT -
        4 GP4/I2C0_SDA                 ADC_REF -
        5 GP5/I2C0_SCL               ADC2/GP28 25
        - GND                         AGND/GND -
        6 GP6                        ADC1/GP27 24
        7 GP7                        ADC0/GP26 23
        8 GP8                              RUN -
        9 GP9/SPI1_CSn                    GP22 22
        - GND                              GND -
       10 GP10/SPI1_SCK                   GP21 21
       11 GP11/SPI1_TX                    GP20 20
       12 GP12/SPI1_RX            SPI0_TX/GP19 19
       13 GP13                   SPI0_SCK/GP18 18
        - GND                              GND -
       14 GP14/I2C1_SDA          SPI0_CSn/GP17 17
       15 GP15/I2C1_SCL           SPI0_RX/GP16 16

    Use RPIPICO_HEADER_R3_* constants in
    <zephyr/dt-bindings/gpio/raspberrypi-pico-header-r3.h> to refer to specific
    pins using convenient constant names.

compatible: "raspberrypi,pico-header-r3"

include: [gpio-nexus.yaml, base.yaml]
```

## dts/bindings/gpio/seeed,grove-laced-if.yaml
```yaml
# SPDX-FileCopyrightText: Copyright (c) 2023-2026 TiaC Systems
# SPDX-License-Identifier: Apache-2.0

description: |
    The Laced Grove Signal Interface.

    The Laced Grove Signal Interface provide an linear mapping of individuell
    signals dependent on a concrete Grove Interconnect Shield.

    Use GROVE_LIF_* constants in
    <zephyr/dt-bindings/gpio/grove-laced-if.h> to refer to specific
    pins using convenient constant names.

compatible: "seeed,grove-laced-if"

include: [pwm-nexus.yaml, gpio-nexus.yaml, base.yaml]
```

## dts/bindings/gpio/sparkfun,qwiic-connector.yaml
```yaml
# SPDX-FileCopyrightText: Copyright (c) 2023-2026 TiaC Systems
# SPDX-License-Identifier: Apache-2.0

description: |
    GPIO pins exposed on SparkFun Qwiic connector.

    The Qwiic layout provides an 4-pin 1mm JST SH connector, along on
    one edge of the board. Pin assignment can be found at:

    - https://www.sparkfun.com/qwiic
    - https://learn.adafruit.com/introducing-adafruit-stemma-qt/sparkfun-qwiic

    This binding provides a nexus mapping for 2 pins where parent
    pins 0 through 1 correspond as depicted below (with cable color):

        4-pin      I2C only

        (yellow) 0 SCL
          (blue) 1 SDA
           (red) - 3V3
         (black) - GND

    STEMMA, STEMMA QT, Grove, and Gravity connectors are similar to this,
    but the connector form and VCC voltage are different. Please see
    https://learn.adafruit.com/introducing-adafruit-stemma-qt/stemma-qt-comparison

    Use QWIIC_* constants in
    <zephyr/dt-bindings/gpio/qwiic-connector.h> to refer to specific
    pins using convenient constant names.

compatible: "sparkfun,qwiic-connector"

include: [gpio-nexus.yaml, base.yaml]
```

## dts/bindings/gpio/tiac,604-gpio-header.yaml
```yaml
# SPDX-FileCopyrightText: Copyright (c) 2024-2026 TiaC Systems
# SPDX-License-Identifier: Apache-2.0

description: |
    GPIO pins exposed on TiaC SC18IS604 shields.

    The TiaC SC18IS604 shields features multiple separate headers. The
    GPIO interface described by this binding comprises the pins exposed
    on header X1, on pins 1 through 5 (pin 6 is wired to GND).

          .-.
        0 |o| IO0
        1 |o| IO1
        2 |o| IO2
        3 |o| IO3
        4 |o| IO4
        - |o| GND
          `-´
          X1 (GPIO)

    Use TCS_604_GPIO_HEADER_* constants in
    <zephyr/dt-bindings/gpio/tiac-604-gpio-header.h> to refer to specific
    pins using convenient constant names.

compatible: "tiac,604-gpio-header"

include: [base.yaml, gpio-nexus.yaml]
```

## dts/bindings/gpio/tiac,magpie-io-header.yaml
```yaml
# SPDX-FileCopyrightText: Copyright (c) 2021-2026 TiaC Systems
# SPDX-FileCopyrightText: Copyright (c) 2021 Li-Pro.Net
# SPDX-License-Identifier: Apache-2.0

description: |
    GPIO pins exposed on TiaC MAGPIE I/O headers.

    The TiaC Magpie layout provides five headers, each two rows with
    seven pins per row.

    This binding provides a nexus mapping for 12 pins for each header,
    left side pins are the odd pins numbered 0, 2, 4, 6, 8, 10, the right
    side pins are the even pins numbered 1, 3, 5, 7, 9, 11. The bottom pins
    on each side are used for ground, they are not mapped in the nexus.

             (GPIOx/1)  TMPHx/1  0 --o  o-- 1  TMPHx/2  (GPIOx/2)
             (GPIOx/3)  TMPHx/3  2 --o  o-- 3  TMPHx/4  (GPIOx/4)
             (GPIOx/5)  TMPHx/5  4 --o  o-- 5  TMPHx/6  (GPIOx/6)
             (GPIOx/7)  TMPHx/7  6 --o  o-- 7  TMPHx/8  (GPIOx/8)
             (GPIOx/9)  TMPHx/9  8 --o  o-- 9  TMPHx/10 (GPIOx/10)
            (GPIOx/12) TMPHx/11 10 --o  o-- 11 TMPHx/12 (GPIOx/12)
                 (GND)           - --o  o-- -           (GND)

    Board's silkscreen may vary depending your board, but coherent with the
    description above as it's according to the standard's specification.
    Not every TiaC board provides all five headers.

    Use TCS_MAGPIE_IO_HEADER_* constants in
    <zephyr/dt-bindings/gpio/tiac-magpie-io-header.h> to refer to specific
    pins using convenient constant names.

compatible: "tiac,magpie-io-header"

include: [gpio-nexus.yaml, base.yaml]
```
