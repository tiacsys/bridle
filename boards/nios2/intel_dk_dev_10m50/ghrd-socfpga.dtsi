/*
 * Copyright (c) 2021 TiaC Systems
 * Copyright (c) 2018 Intel Corporation
 * SPDX-License-Identifier: Apache-2.0
 */

#include <dt-bindings/i2c/i2c.h>

/ {
	soc {
		uart0: uart@100000 {
			compatible = "ns16550";
			reg = <0x100000 0x200>;
			clock-frequency = <50000000>;
			interrupts = <8 0>;
			label = "UART_0";

			status = "disabled";
		};

		i2c0: i2c@101000 {
			compatible = "nios2,i2c";
			clock-frequency = <I2C_BITRATE_ULTRA>;
			#address-cells = <1>;
			#size-cells = <0>;
			reg = <0x101000 0x40>;
			interrupts = <16 10>;
			label = "I2C_0";

			status = "disabled";
		};
	};
};
