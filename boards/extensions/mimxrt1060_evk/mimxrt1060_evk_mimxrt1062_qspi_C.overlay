/*
 * Copyright (c) 2023-2025 TiaC Systems
 * SPDX-License-Identifier: Apache-2.0
 */

/*
 * FLEXPWM not routed to LED on this EVK revision, thus why board DTS
 * disables &flexpwm2_pwm3 but neither related &pwmleds node nor alias.
 */

/ {
	aliases {
		/delete-property/ pwm-led0;
	};

	/delete-node/ pwmleds;
};
