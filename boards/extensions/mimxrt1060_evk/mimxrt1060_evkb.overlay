/*
 * Copyright (c) 2023-2024 TiaC Systems
 * SPDX-License-Identifier: Apache-2.0
 */

#include "mimxrt1060_evk.dtsi"

/* FLEXPWM not routed to LED on this EVK revision, thus why board DTS
 * disables &flexpwm2_pwm3 but neither related &pwmleds node nor alias. */

/ {
	aliases {
		/delete-property/ pwm-led0;
	};

	/delete-node/ pwmleds;
};
