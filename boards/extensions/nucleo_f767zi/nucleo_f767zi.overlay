/*
 * Copyright (c) 2024 TiaC Systems
 * SPDX-License-Identifier: Apache-2.0
 */

/ {
	model = "STMicroelectronics STM32F767ZI-NUCLEO board @ UART Concole";
	compatible = "st,stm32f767zi-nucleo", "st,stm32f767zi-nucleo-uartcons";

	chosen {
		zephyr,console = &usart3;
		zephyr,shell-uart = &usart3;
	};
};
