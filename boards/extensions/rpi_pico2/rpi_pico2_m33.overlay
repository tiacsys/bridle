/*
 * Copyright (c) 2025 TiaC Systems
 * SPDX-License-Identifier: Apache-2.0
 */

/ {
	model = "Raspberry Pi Pico 2 @ UART Concole";
	compatible = "raspberrypi,rpi-pico2",
		     "raspberrypi,rpi-pico2-uartcons";

	chosen {
		zephyr,console = &uart0;
		zephyr,shell-uart = &uart0;
	};
};

#include "rpipico_r3.dtsi"
