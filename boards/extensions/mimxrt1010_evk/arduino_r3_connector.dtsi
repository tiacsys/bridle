/*
 * Copyright (c) 2023 TiaC Systems
 * SPDX-License-Identifier: Apache-2.0
 */

/*
 * On NXP MIMXRT1010-EVK pin D4 (GPIO), D5 (GPIO/PWM), and D9 (GPIO/PWM)
 * are disconnected in default and can be closed optionally. But keep in
 * mind that the signals are already connected to a on-board header for
 * the NXP special motor driver add-on bard.
 *
 * The following GPIO map overwrites the default settings of the board,
 * as the resistors R793, R795 and R800 must be fitted for proper use.
 */

&arduino_header {
	gpio-map = <0 0 &gpio1 21 0>,	/* A0 */
		   <1 0 &gpio1 23 0>,	/* A1 */
		   <2 0 &gpio1 24 0>,	/* A2 */
		   <3 0 &gpio1 28 0>,	/* A3 */
		   <4 0 &gpio1 15 0>,	/* A4 (shared with D6) */
		   <5 0 &gpio1 16 0>,	/* A5 (shared with D7) */
		   <6 0 &gpio1 9 0>,	/* D0 */
		   <7 0 &gpio1 10 0>,	/* D1 */
		   <8 0 &gpio1 19 0>,	/* D2 (shared with D10) */
		   <9 0 &gpio1 20 0>,	/* D3 (shared with D13) */
		   <10 0 &gpio1 8 0>,	/* D4 (R800 populated) */
		   <11 0 &gpio1 1 0>,	/* D5 (R793, shared with D14) */
		   <12 0 &gpio1 15 0>,	/* D6 (shared with A4) */
		   <13 0 &gpio1 16 0>,	/* D7 (shared with A5) */
		   <14 0 &gpio2 2 0>,	/* D8 */
		   <15 0 &gpio1 3 0>,	/* D9 (R795 populated) */
		   <16 0 &gpio1 19 0>,	/* D10 (shared with D2) */
		   <17 0 &gpio1 18 0>,	/* D11 */
		   <18 0 &gpio1 17 0>,	/* D12 */
		   <19 0 &gpio1 20 0>,	/* D13 (shared with D3) */
		   <20 0 &gpio1 1 0>,	/* D14 (shared with D5)*/
		   <21 0 &gpio1 2 0>;	/* D15 */
};
