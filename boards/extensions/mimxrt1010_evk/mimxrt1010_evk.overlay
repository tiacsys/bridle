/*
 * Copyright (c) 2023-2025 TiaC Systems
 * SPDX-License-Identifier: Apache-2.0
 */

#include "arduino_r3_connector.dtsi"

/ {
	model = "NXP MIMXRT1010-EVK board @ UART Concole";
	compatible = "nxp,mimxrt1010", "nxp,mimxrt1010-uartcons";

	chosen {
		zephyr,console = &lpuart1;
		zephyr,shell-uart = &lpuart1;
	};

	msc_disk0 {
		compatible = "zephyr,flash-disk";
		partition = <&storage_partition>;
		disk-name = "NAND";
		cache-size = <4096>;
	};
};

&green_led {
	gpios = <&gpio1 11 GPIO_ACTIVE_HIGH>;
};
