/*
 * Copyright (c) 2024 TiaC Systems
 * SPDX-License-Identifier: Apache-2.0
 */

/ {
	model = "Raspberry Pi Pico W @ UART Concole";
	compatible = "raspberrypi,rpi-pico-w", "raspberrypi,rpi-pico-w-uartcons";

	chosen {
		zephyr,console = &uart0;
		zephyr,shell-uart = &uart0;
	};
};

#include "rpipico_r3.dtsi"
