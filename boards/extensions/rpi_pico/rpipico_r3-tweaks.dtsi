/*
 * Copyright (c) 2023 TiaC Systems
 * SPDX-License-Identifier: Apache-2.0
 */

&rpipico_i2c0 {
	compatible = "gpio-i2c";	/* I2C0_SDA_P4 and I2C0_SCL_P5 */
	sda-gpios = <&rpipico_header 4 (GPIO_OPEN_DRAIN | GPIO_PULL_UP)>;
	scl-gpios = <&rpipico_header 5 (GPIO_OPEN_DRAIN | GPIO_PULL_UP)>;
	/delete-property/ resets;
	/delete-property/ clocks;
	/delete-property/ interrupts;
	/delete-property/ interrupt-names;
	/delete-property/ pinctrl-0;
	/delete-property/ pinctrl-names;
};

&rpipico_i2c1 {
	compatible = "gpio-i2c";	/* I2C1_SDA_P6 and I2C1_SCL_P7 */
	sda-gpios = <&rpipico_header 6 (GPIO_OPEN_DRAIN | GPIO_PULL_UP)>;
	scl-gpios = <&rpipico_header 7 (GPIO_OPEN_DRAIN | GPIO_PULL_UP)>;
	/delete-property/ resets;
	/delete-property/ clocks;
	/delete-property/ interrupts;
	/delete-property/ interrupt-names;
	/delete-property/ pinctrl-0;
	/delete-property/ pinctrl-names;
};

&gpio0 {
	status = "okay";
};
