/*
 * Copyright (c) 2025 TiaC Systems
 * SPDX-License-Identifier: Apache-2.0
 */

/dts-v1/;

#include <st/f0/stm32f072Xb.dtsi>
#include <st/f0/stm32f072c(8-b)tx-pinctrl.dtsi>

/ {
	model = "VccGND Studio BluePill STM32F072CB @ UART Concole";
	compatible = "vccgnd,bluepill-stm32f072cb",
		     "vccgnd,bluepill-stm32f072cb-uartcons";
};

#include "stm32/48mhz.dtsi"
#include "stm32/usart1.dtsi"
#include "stm32/dietemp.dtsi"
#include "stm32/vref.dtsi"
#include "stm32/vbat.dtsi"
#include "stm32f0/adc.dtsi"

#include "stm32/io_adc.dtsi"
#include "stm32/user_led.dtsi"

#include "stm32/connector.dtsi"
bluepill_serial: &usart1 {};
