/*
 * Copyright (c) 2025 TiaC Systems
 * SPDX-License-Identifier: Apache-2.0
 */

/dts-v1/;

#include <st/f0/stm32f072X8.dtsi>
#include <st/f0/stm32f072c(8-b)tx-pinctrl.dtsi>

/ {
	model = "VccGND Studio BluePill STM32F072C8 @ UART Concole";
	compatible = "vccgnd,bluepill-stm32f072c8",
		     "vccgnd,bluepill-stm32f072c8-uartcons";
};

#include "stm32/48mhz.dtsi"
#include "stm32/usart1.dtsi"

#include "stm32/user_led.dtsi"

#include "stm32/connector.dtsi"
bluepill_serial: &usart1 {};
