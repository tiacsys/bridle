/*
 * Copyright (c) 2023-2026 TiaC Systems
 * SPDX-License-Identifier: Apache-2.0
 */

#include "../../zephyr/boards/st/nucleo_f303re/nucleo_f303re.dts"

/ {
	model = "STMicroelectronics STM32F303RE-NUCLEO board (BBE)";
	compatible = "st,stm32f303re-nucleo", "st,stm32f303re-nucleo-bbe";
};

/*
 * On ST Nucleo F303RE pin D0 (RX) and D1 (TX) should be disconnected from
 * the on-board STLinx/V2; open the solder bridges SB13 (RX) and SB14 (TX).
 * For more details, see schematic MB1136-C05 on sheet 4 and manual UM1724
 * section 6.8 on page 25 and table 10 on page 27.
 */

arduino_serial: &usart2 {};
