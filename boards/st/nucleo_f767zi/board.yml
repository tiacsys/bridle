## boards/waveshare/rp2040/Kconfig.defconfig
```kconfig
# Copyright (c) 2023-2025 TiaC Systems
# SPDX-License-Identifier: Apache-2.0

config BOARD_WAVESHARE_RP2040_MINI
	bool
	default y if BOARD_WAVESHARE_RP2040_ONE
	default y if BOARD_WAVESHARE_RP2040_ZERO
	default y if BOARD_WAVESHARE_RP2040_MATRIX
	default y if BOARD_WAVESHARE_RP2040_TINY
	default n

config BOARD_WAVESHARE_RP2040_PICO
	bool
	default y if BOARD_WAVESHARE_RP2040_ETH
	default y if BOARD_WAVESHARE_RP2040_LCD_0_96
	default y if BOARD_WAVESHARE_RP2040_PLUS
	default n

config BOARD_WAVESHARE_RP2040_LCD
	bool
	default y if BOARD_WAVESHARE_RP2040_LCD_0_96
	default y if BOARD_WAVESHARE_RP2040_GEEK
	default n

config BOARD_WAVESHARE_RP2040
	bool
	default y if BOARD_WAVESHARE_RP2040_MINI
	default y if BOARD_WAVESHARE_RP2040_PICO
	default y if BOARD_WAVESHARE_RP2040_GEEK
	default n

config RP2_FLASH_W25Q080
	default y
	depends on BOARD_WAVESHARE_RP2040

config CLOCK_CONTROL
	default y
	depends on DT_HAS_RASPBERRYPI_PICO_CLOCK_ENABLED && \
		   DT_HAS_RASPBERRYPI_PICO_CLOCK_CONTROLLER_ENABLED

config REGULATOR
	default y
	depends on DT_HAS_RASPBERRYPI_CORE_SUPPLY_REGULATOR_ENABLED

config RESET
	default y
	depends on DT_HAS_RASPBERRYPI_PICO_RESET_ENABLED

config WATCHDOG
	default y
	depends on DT_HAS_RASPBERRYPI_PICO_WATCHDOG_ENABLED

config WDT_DISABLE_AT_BOOT
	default y if BOARD_WAVESHARE_RP2040
	depends on WATCHDOG && HAS_WDT_DISABLE_AT_BOOT

config COUNTER
	default y
	depends on DT_HAS_RASPBERRYPI_PICO_TIMER_ENABLED

config DMA
	default y
	depends on DT_HAS_RASPBERRYPI_PICO_DMA_ENABLED

config GPIO
	default y
	depends on DT_HAS_RASPBERRYPI_PICO_GPIO_ENABLED

config PWM
	default y
	depends on DT_HAS_RASPBERRYPI_PICO_PWM_ENABLED

config LED_STRIP
	default y
	depends on BOARD_WAVESHARE_RP2040_MATRIX && DISPLAY

choice ST7789V_PIXEL_FORMAT
	default ST7789V_BGR565 if BOARD_WAVESHARE_RP2040_GEEK
	depends on BOARD_WAVESHARE_RP2040_LCD && DISPLAY
endchoice

config LV_Z_BITS_PER_PIXEL
	default 16 if BOARD_WAVESHARE_RP2040_LCD_0_96
	default 16 if BOARD_WAVESHARE_RP2040_GEEK
	depends on BOARD_WAVESHARE_RP2040_LCD && DISPLAY && LVGL

choice LV_COLOR_DEPTH
	default LV_COLOR_DEPTH_16 if BOARD_WAVESHARE_RP2040_LCD_0_96
	default LV_COLOR_DEPTH_16 if BOARD_WAVESHARE_RP2040_GEEK
	depends on BOARD_WAVESHARE_RP2040_LCD && DISPLAY && LVGL
endchoice

config LV_COLOR_16_SWAP
	default y if BOARD_WAVESHARE_RP2040_LCD_0_96
	default y if BOARD_WAVESHARE_RP2040_GEEK
	depends on BOARD_WAVESHARE_RP2040_LCD && DISPLAY && LVGL

# Workaround for not being able to have commas in macro arguments
DT_CHOSEN_Z_CONSOLE := zephyr,console
DT_COMPAT_Z_CDC_ACM_UART := zephyr,cdc-acm-uart
DT_COMPAT_RPIPICO_USB := raspberrypi,pico-usbd

# Macros to shorten Kconfig expressions
DT_CHOSEN_CONSOLE_NODE := $(dt_chosen_path,$(DT_CHOSEN_Z_CONSOLE))
DT_CHOSEN_CONSOLE_PARENT := $(dt_node_parent,$(DT_CHOSEN_CONSOLE_NODE))

if BOARD_WAVESHARE_RP2040 && \
	$(dt_chosen_enabled,$(DT_CHOSEN_Z_CONSOLE)) && \
	$(dt_compat_on_bus,$(DT_COMPAT_Z_CDC_ACM_UART),usb) && \
	$(dt_node_has_compat,$(DT_CHOSEN_CONSOLE_PARENT),$(DT_COMPAT_RPIPICO_USB))

config CDC_ACM_SERIAL_SELF_POWERED
	default n
	depends on USB_DEVICE_STACK_NEXT && USBD_CDC_ACM_CLASS

config CDC_ACM_SERIAL_MAX_POWER
	default 150 if BOARD_WAVESHARE_RP2040_ONE	# 300mA
	default 240 if BOARD_WAVESHARE_RP2040_ZERO	# 480mA
	default 150 if BOARD_WAVESHARE_RP2040_MATRIX	# 300mA
	default 150 if BOARD_WAVESHARE_RP2040_TINY	# 300mA
	default 240 if BOARD_WAVESHARE_RP2040_ETH	# 480mA
	default 250 if BOARD_WAVESHARE_RP2040_LCD_0_96	# 500mA
	default 250 if BOARD_WAVESHARE_RP2040_PLUS	# 500mA
	default 100 if BOARD_WAVESHARE_RP2040_GEEK	# 200mA
	depends on USB_DEVICE_STACK_NEXT && USBD_CDC_ACM_CLASS

# Logger cannot use itself to log
choice USBD_CDC_ACM_LOG_LEVEL_CHOICE
	default USBD_CDC_ACM_LOG_LEVEL_OFF
	depends on LOG && USB_DEVICE_STACK_NEXT && USBD_CDC_ACM_CLASS
endchoice

# Set USB log level to error only
choice USBD_LOG_LEVEL_CHOICE
	default USBD_LOG_LEVEL_ERR
	depends on LOG && USB_DEVICE_STACK_NEXT && USBD_CDC_ACM_CLASS
endchoice

# Set UDC driver log level to error only
choice UDC_DRIVER_LOG_LEVEL_CHOICE
	default UDC_DRIVER_LOG_LEVEL_ERR
	depends on LOG && USB_DEVICE_STACK_NEXT && USBD_CDC_ACM_CLASS
endchoice

endif # zephyr,cdc-acm-uart
```

## boards/waveshare/rp2040/Kconfig.waveshare_rp2040_plus
```kconfig
# Copyright (c) 2023-2024 TiaC Systems
# SPDX-License-Identifier: Apache-2.0

config BOARD_WAVESHARE_RP2040_PLUS
	select SOC_RP2040
```

## boards/waveshare/rp2040/Kconfig.waveshare_rp2040_tiny
```kconfig
# Copyright (c) 2023-2024 TiaC Systems
# SPDX-License-Identifier: Apache-2.0

config BOARD_WAVESHARE_RP2040_TINY
	select SOC_RP2040
```
