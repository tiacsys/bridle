## boards/st/nucleo_f767zi/board.yml
```yaml
# Copyright (c) 2026 TiaC Systems
# SPDX-License-Identifier: Apache-2.0

board:
  extend: nucleo_f767zi
  variants:
    - name: bbe
      qualifier: stm32f767xx
```

## boards/st/nucleo_f767zi/nucleo_f767zi_bbe_defconfig
```kconfig
# Copyright (c) 2026 TiaC Systems
# SPDX-License-Identifier: Apache-2.0
#
# NOTE: copy and own from original default configuration in
# "zephyr/boards/st/nucleo_f767zi/nucleo_f767zi_defconfig"

# Enable MPU
CONFIG_ARM_MPU=y

# Enable HW stack protection
CONFIG_HW_STACK_PROTECTION=y

# Enable UART
CONFIG_SERIAL=y

# Console
CONFIG_CONSOLE=y
CONFIG_UART_CONSOLE=y

# Enable GPIO
CONFIG_GPIO=y
```

## boards/st/nucleo_l496zg/Kconfig.nucleo_l496zg
```kconfig
# Copyright (c) 2026 TiaC Systems
# SPDX-License-Identifier: Apache-2.0

config BOARD_NUCLEO_L496ZG_STM32L496XX
	bool

config BOARD_NUCLEO_L496ZG_STM32L496XX_BBE
	bool
	select BOARD_NUCLEO_L496ZG_STM32L496XX
```

## boards/st/nucleo_l496zg/board.yml
```yaml
# Copyright (c) 2026 TiaC Systems
# SPDX-License-Identifier: Apache-2.0

board:
  extend: nucleo_l496zg
  variants:
    - name: bbe
      qualifier: stm32l496xx
```

## boards/st/nucleo_l496zg/nucleo_l496zg_bbe_defconfig
```kconfig
# Copyright (c) 2026 TiaC Systems
# SPDX-License-Identifier: Apache-2.0
#
# NOTE: copy and own from original default configuration in
# "zephyr/boards/st/nucleo_l496zg/nucleo_l496zg_defconfig"

# enable uart driver
CONFIG_SERIAL=y

# enable GPIO
CONFIG_GPIO=y

# console
CONFIG_CONSOLE=y
CONFIG_UART_CONSOLE=y

#enable MPU
CONFIG_ARM_MPU=y

# Enable HW stack protection
CONFIG_HW_STACK_PROTECTION=y
```

## boards/tiac/coffeecaller/Kconfig.coffeecaller_nrf52
```kconfig
# Copyright (c) 2025 TiaC Systems
# SPDX-License-Identifier: Apache-2.0

config BOARD_COFFEECALLER_NRF52
	select SOC_NRF52840_QIAA
```

## boards/tiac/coffeecaller/Kconfig.defconfig
```kconfig
# Copyright (c) 2025 TiaC Systems
# SPDX-License-Identifier: Apache-2.0

config GPIO
	default y
	depends on DT_HAS_NORDIC_NRF_GPIO_ENABLED

# TODO: move all DELAY_* objects to Devicetree node
config DELAY_T1H
	default 64 if BOARD_COFFEECALLER_NRF52
	depends on LED_STRIP && DT_HAS_WORLDSEMI_WS2812_GPIO_ENABLED

config DELAY_T1L
	default 64 if BOARD_COFFEECALLER_NRF52
	depends on LED_STRIP && DT_HAS_WORLDSEMI_WS2812_GPIO_ENABLED

config DELAY_T0H
	default 16 if BOARD_COFFEECALLER_NRF52
	depends on LED_STRIP && DT_HAS_WORLDSEMI_WS2812_GPIO_ENABLED

config DELAY_T0L
	default 64 if BOARD_COFFEECALLER_NRF52
	depends on LED_STRIP && DT_HAS_WORLDSEMI_WS2812_GPIO_ENABLED

# Workaround for not being able to have commas in macro arguments
DT_CHOSEN_Z_CONSOLE := zephyr,console
DT_COMPAT_Z_CDC_ACM_UART := zephyr,cdc-acm-uart
DT_COMPAT_NORDICNRF_USB := nordic,nrf-usbd

# Macros to shorten Kconfig expressions
DT_CHOSEN_CONSOLE_NODE := $(dt_chosen_path,$(DT_CHOSEN_Z_CONSOLE))
DT_CHOSEN_CONSOLE_PARENT := $(dt_node_parent,$(DT_CHOSEN_CONSOLE_NODE))

if BOARD_COFFEECALLER_NRF52 && \
	$(dt_chosen_enabled,$(DT_CHOSEN_Z_CONSOLE)) && \
	$(dt_compat_on_bus,$(DT_COMPAT_Z_CDC_ACM_UART),usb) && \
	$(dt_node_has_compat,$(DT_CHOSEN_CONSOLE_PARENT),$(DT_COMPAT_NORDICNRF_USB))

config CDC_ACM_SERIAL_SELF_POWERED
	default n
	depends on USB_DEVICE_STACK_NEXT && USBD_CDC_ACM_CLASS

config CDC_ACM_SERIAL_MAX_POWER
	default 75 if BOARD_COFFEECALLER_NRF52	# 150mA
	depends on USB_DEVICE_STACK_NEXT && USBD_CDC_ACM_CLASS

# Logger cannot use itself to log
choice USBD_CDC_ACM_LOG_LEVEL_CHOICE
	default USBD_CDC_ACM_LOG_LEVEL_OFF
	depends on LOG && USB_DEVICE_STACK_NEXT && USBD_CDC_ACM_CLASS
endchoice

# Set USB log level to error only
choice USBD_LOG_LEVEL_CHOICE
	default USBD_LOG_LEVEL_ERR
	depends on LOG && USB_DEVICE_STACK_NEXT && USBD_CDC_ACM_CLASS
endchoice

# Set UDC driver log level to error only
choice UDC_DRIVER_LOG_LEVEL_CHOICE
	default UDC_DRIVER_LOG_LEVEL_ERR
	depends on LOG && USB_DEVICE_STACK_NEXT && USBD_CDC_ACM_CLASS
endchoice

endif # zephyr,cdc-acm-uart
```

## boards/tiac/coffeecaller/Kconfig.tiac_coffeecaller
```kconfig
# Copyright (c) 2025 TiaC Systems
# SPDX-License-Identifier: Apache-2.0


config BOARD_TIAC_COFFEECALLER
	select SOC_NRF52840_QIAA if BOARD_TIAC_COFFEECALLER
```

## boards/tiac/coffeecaller/coffeecaller_nrf52_nrf52840_defconfig
```kconfig
# Copyright (c) 2025 TiaC Systems
# SPDX-License-Identifier: Apache-2.0

# No external 32 kHz crystal present
CONFIG_NRFX_CLOCK_LFXO_TWO_STAGE_ENABLED=n
CONFIG_CLOCK_CONTROL_NRF_K32SRC_RC=y

# Enable MPU
CONFIG_ARM_MPU=y

# Enable hardware stack protection
CONFIG_HW_STACK_PROTECTION=y

# Build UF2 by default, supported by the Adafruit nRF52 Bootloader
CONFIG_BUILD_OUTPUT_UF2=y
CONFIG_BUILD_OUTPUT_HEX=y
CONFIG_USE_DT_CODE_PARTITION=y

# enable uart console
CONFIG_SERIAL=y
CONFIG_CONSOLE=y
CONFIG_UART_CONSOLE=y
CONFIG_UART_LINE_CTRL=y
CONFIG_UART_INTERRUPT_DRIVEN=y

# USB configuration
CONFIG_USB_DEVICE_STACK_NEXT=y
CONFIG_CDC_ACM_SERIAL_VID=0x1915
CONFIG_CDC_ACM_SERIAL_PID=0xC0CA
CONFIG_CDC_ACM_SERIAL_MANUFACTURER_STRING="TiaC (Nordic Semiconductor ASA)"
CONFIG_CDC_ACM_SERIAL_PRODUCT_STRING="CoffeeCaller nRF52 (CDC ACM)"
CONFIG_CDC_ACM_SERIAL_INITIALIZE_AT_BOOT=y
```

## boards/tiac/coffeecaller/tiac_coffeecaller_nrf52840_defconfig
```kconfig
# Copyright (c) 2025 TiaC Systems
# SPDX-License-Identifier: Apache-2.0

# No external 32 kHz crystal present
CONFIG_NRFX_CLOCK_LFXO_TWO_STAGE_ENABLED=n
CONFIG_CLOCK_CONTROL_NRF_K32SRC_RC=y

# Build UF2 by default, supported by the Adafruit nRF52 Bootloader
CONFIG_BUILD_OUTPUT_UF2=y
CONFIG_USE_DT_CODE_PARTITION=y

# Enable MPU
CONFIG_ARM_MPU=y

# Enable hardware stack protection
CONFIG_HW_STACK_PROTECTION=y

# enable uart driver
CONFIG_SERIAL=y

# enable console
CONFIG_CONSOLE=y
CONFIG_UART_CONSOLE=y

# enable peripherals
CONFIG_GPIO=y
CONFIG_I2C=y
CONFIG_SPI=y
CONFIG_PWM=y
CONFIG_LED_STRIP=y

# enable shells
CONFIG_SHELL=y
CONFIG_GPIO_SHELL=y
CONFIG_I2C_SHELL=y
CONFIG_SPI_SHELL=y
CONFIG_PWM_SHELL=y
CONFIG_SENSOR_SHELL=y

# USB configuration
CONFIG_USB_DEVICE_STACK=y
CONFIG_USB_DEVICE_PRODUCT="TiaC CoffeeCaller"
CONFIG_USB_DEVICE_PID=0x0004
CONFIG_USB_DEVICE_VID=0x1337
CONFIG_USB_CDC_ACM_LOG_LEVEL_OFF=y
CONFIG_CDC_ACM_SERIAL_INITIALIZE_AT_BOOT=y

# configure LED strip timings
CONFIG_DELAY_T1H=64
CONFIG_DELAY_T1L=64
CONFIG_DELAY_T0H=16
CONFIG_DELAY_T0L=64
```

## boards/tiac/magpie_f777ni/Kconfig.defconfig
```kconfig
# Copyright (c) 2021-2025 TiaC Systems
# Copyright (c) 2021 Li-Pro.Net
# SPDX-License-Identifier: Apache-2.0

# TiaC Magpie F777NI board configuration

if BOARD_MAGPIE_F777NI

choice RNG_GENERATOR_CHOICE
	default ENTROPY_DEVICE_RANDOM_GENERATOR
	depends on ENTROPY_GENERATOR
endchoice

if NETWORKING

config NET_L2_ETHERNET
	default y

endif # NETWORKING

endif # BOARD_MAGPIE_F777NI

# Workaround for not being able to have commas in macro arguments
DT_CHOSEN_Z_CONSOLE := zephyr,console
DT_COMPAT_Z_CDC_ACM_UART := zephyr,cdc-acm-uart
DT_COMPAT_STM32_USB := st,stm32-otgfs

# Macros to shorten Kconfig expressions
DT_CHOSEN_CONSOLE_NODE := $(dt_chosen_path,$(DT_CHOSEN_Z_CONSOLE))
DT_CHOSEN_CONSOLE_PARENT := $(dt_node_parent,$(DT_CHOSEN_CONSOLE_NODE))

if BOARD_MAGPIE_F777NI && \
	$(dt_chosen_enabled,$(DT_CHOSEN_Z_CONSOLE)) && \
	$(dt_compat_on_bus,$(DT_COMPAT_Z_CDC_ACM_UART),usb) && \
	$(dt_node_has_compat,$(DT_CHOSEN_CONSOLE_PARENT),$(DT_COMPAT_STM32_USB))

config CDC_ACM_SERIAL_SELF_POWERED
	default y
	depends on USB_DEVICE_STACK_NEXT && USBD_CDC_ACM_CLASS

config CDC_ACM_SERIAL_MAX_POWER
	default 0 if BOARD_MAGPIE_F777NI	# 0mA (self powered)
	depends on USB_DEVICE_STACK_NEXT && USBD_CDC_ACM_CLASS

# Logger cannot use itself to log
choice USBD_CDC_ACM_LOG_LEVEL_CHOICE
	default USBD_CDC_ACM_LOG_LEVEL_OFF
	depends on LOG && USB_DEVICE_STACK_NEXT && USBD_CDC_ACM_CLASS
endchoice

# Set USB log level to error only
choice USBD_LOG_LEVEL_CHOICE
	default USBD_LOG_LEVEL_ERR
	depends on LOG && USB_DEVICE_STACK_NEXT && USBD_CDC_ACM_CLASS
endchoice

# Set UDC driver log level to error only
choice UDC_DRIVER_LOG_LEVEL_CHOICE
	default UDC_DRIVER_LOG_LEVEL_ERR
	depends on LOG && USB_DEVICE_STACK_NEXT && USBD_CDC_ACM_CLASS
endchoice

endif # zephyr,cdc-acm-uart
```

## boards/tiac/magpie_f777ni/Kconfig.tiac_magpie
```kconfig
# Copyright (c) 2021-2024 TiaC Systems
# Copyright (c) 2021 Li-Pro.Net
# SPDX-License-Identifier: Apache-2.0

# TiaC STM32F777NIHx Magpie board configuration

config BOARD_TIAC_MAGPIE
	select SOC_STM32F777XX
```

## boards/tiac/nrfcoffee/Kconfig.tiac_nrfcoffee
```kconfig
# Copyright (c) 2025 TiaC Systems
# SPDX-License-Identifier: Apache-2.0


config BOARD_TIAC_NRFCOFFEE
	select SOC_NRF52840_QIAA if BOARD_TIAC_NRFCOFFEE
```

## boards/tiac/nrfcoffee/board.yml
```yaml
board:
  name: tiac_nrfcoffee
  full_name: TiaC Systems nRFCoffee
  vendor: tiac
  socs:
  - name: nrf52840
```

## boards/uicpal/mini_usb_rp2040/Kconfig
```kconfig
# Copyright (c) 2024 TiaC Systems
# SPDX-License-Identifier: Apache-2.0

if BOARD_MINI_USB_RP2040_RP2040

config BOARD_MINI_USB_RP2040_INIT_PRIORITY
	int "Board control initialization priority"
	default 60
	help
	  Set the priority for board control (tweaks), must be greater than
	  KERNEL_INIT_PRIORITY_DEVICE but smaller than LED_INIT_PRIORITY and
	  APPLICATION_INIT_PRIORITY.

module = BOARD_MINI_USB_RP2040
module-str = Board Control
source "subsys/logging/Kconfig.template.log_config"

endif # BOARD_MINI_USB_RP2040
```

## boards/uicpal/mini_usb_rp2040/Kconfig.defconfig
```kconfig
# Copyright (c) 2024 TiaC Systems
# SPDX-License-Identifier: Apache-2.0

config RP2_FLASH_W25Q080
	default y
	depends on BOARD_MINI_USB_RP2040

config CLOCK_CONTROL
	default y
	depends on DT_HAS_RASPBERRYPI_PICO_CLOCK_ENABLED && \
		   DT_HAS_RASPBERRYPI_PICO_CLOCK_CONTROLLER_ENABLED

config REGULATOR
	default y
	depends on DT_HAS_REGULATOR_FIXED_ENABLED

config RESET
	default y
	depends on DT_HAS_RASPBERRYPI_PICO_RESET_ENABLED

config DMA
	default y
	depends on DT_HAS_RASPBERRYPI_PICO_DMA_ENABLED

config GPIO
	default y
	depends on DT_HAS_RASPBERRYPI_PICO_GPIO_ENABLED
```

## boards/uicpal/mini_usb_rp2040/Kconfig.mini_usb_rp2040
```kconfig
# Copyright (c) 2024 TiaC Systems
# SPDX-License-Identifier: Apache-2.0

config BOARD_MINI_USB_RP2040
	select SOC_RP2040
```

## boards/uicpal/mini_usb_rp2040/board.yml
```yaml
# Copyright (c) 2024 TiaC Systems
# SPDX-License-Identifier: Apache-2.0

boards:
  - name: mini_usb_rp2040
    full_name: Mini USB RP2040
    vendor: uicpal
    revision:
      format: "custom"
      default: "neopixel"
      revisions:
        - name: "neopixel"
        - name: "chipled"
    socs:
      - name: rp2040
```

## boards/vccgnd/bluepill/Kconfig.defconfig
```kconfig
# Copyright (c) 2025 TiaC Systems
# SPDX-License-Identifier: Apache-2.0

config BOARD_VCCGND_BLUEPILL
	bool
	default y if BOARD_VCCGND_BLUEPILL_STM32F103C8
	default y if BOARD_VCCGND_BLUEPILL_STM32F103CB
	default y if BOARD_VCCGND_BLUEPILL_STM32F072C8
	default y if BOARD_VCCGND_BLUEPILL_STM32F072CB
	default y if BOARD_VCCGND_BLUEPILL_STM32F051C8
	default y if BOARD_VCCGND_BLUEPILL_STM32F030C8
	default n

config BOARD_VCCGND_BLUEPILL_USBCONS
	bool
	default y if BOARD_VCCGND_BLUEPILL_STM32F103C8
	default y if BOARD_VCCGND_BLUEPILL_STM32F103CB
	default y if BOARD_VCCGND_BLUEPILL_STM32F072C8
	default y if BOARD_VCCGND_BLUEPILL_STM32F072CB
	default n

config CLOCK_CONTROL
	default y
	depends on DT_HAS_ST_STM32_RCC_ENABLED || DT_HAS_ST_STM32F0_RCC_ENABLED

config RESET
	default y
	depends on DT_HAS_ST_STM32_RCC_RCTL_ENABLED

config GPIO
	default y
	depends on DT_HAS_ST_STM32_GPIO_ENABLED

# Workaround for not being able to have commas in macro arguments
DT_CHOSEN_Z_CONSOLE := zephyr,console
DT_COMPAT_Z_CDC_ACM_UART := zephyr,cdc-acm-uart
DT_COMPAT_STM32_USB := st,stm32-usb

# Macros to shorten Kconfig expressions
DT_CHOSEN_CONSOLE_NODE := $(dt_chosen_path,$(DT_CHOSEN_Z_CONSOLE))
DT_CHOSEN_CONSOLE_PARENT := $(dt_node_parent,$(DT_CHOSEN_CONSOLE_NODE))

if BOARD_VCCGND_BLUEPILL_USBCONS && \
	$(dt_chosen_enabled,$(DT_CHOSEN_Z_CONSOLE)) && \
	$(dt_compat_on_bus,$(DT_COMPAT_Z_CDC_ACM_UART),usb) && \
	$(dt_node_has_compat,$(DT_CHOSEN_CONSOLE_PARENT),$(DT_COMPAT_STM32_USB))

config CDC_ACM_SERIAL_SELF_POWERED
	default n
	depends on USB_DEVICE_STACK_NEXT && USBD_CDC_ACM_CLASS

config CDC_ACM_SERIAL_MAX_POWER
	default 250 if BOARD_VCCGND_BLUEPILL_STM32F103C8	# 500mA
	default 250 if BOARD_VCCGND_BLUEPILL_STM32F103CB	# 500mA
	default 250 if BOARD_VCCGND_BLUEPILL_STM32F072C8	# 500mA
	default 250 if BOARD_VCCGND_BLUEPILL_STM32F072CB	# 500mA
	depends on USB_DEVICE_STACK_NEXT && USBD_CDC_ACM_CLASS

# Logger cannot use itself to log
choice USBD_CDC_ACM_LOG_LEVEL_CHOICE
	default USBD_CDC_ACM_LOG_LEVEL_OFF
	depends on LOG && USB_DEVICE_STACK_NEXT && USBD_CDC_ACM_CLASS
endchoice

# Set USB log level to error only
choice USBD_LOG_LEVEL_CHOICE
	default USBD_LOG_LEVEL_ERR
	depends on LOG && USB_DEVICE_STACK_NEXT && USBD_CDC_ACM_CLASS
endchoice

# Set UDC driver log level to error only
choice UDC_DRIVER_LOG_LEVEL_CHOICE
	default UDC_DRIVER_LOG_LEVEL_ERR
	depends on LOG && USB_DEVICE_STACK_NEXT && USBD_CDC_ACM_CLASS
endchoice

endif # zephyr,cdc-acm-uart
```

## boards/vccgnd/bluepill/Kconfig.vccgnd_bluepill_stm32f051c8
```kconfig
# Copyright (c) 2025 TiaC Systems
# SPDX-License-Identifier: Apache-2.0

config BOARD_VCCGND_BLUEPILL_STM32F051C8
	select SOC_STM32F051X8
```

## boards/vccgnd/bluepill/Kconfig.vccgnd_bluepill_stm32f072cb
```kconfig
# Copyright (c) 2025 TiaC Systems
# SPDX-License-Identifier: Apache-2.0

config BOARD_VCCGND_BLUEPILL_STM32F072CB
	select SOC_STM32F072XB
```

## boards/vccgnd/bluepill/board.yml
```yaml
# Copyright (c) 2025 TiaC Systems
# SPDX-License-Identifier: Apache-2.0

boards:
  - name: vccgnd_bluepill_stm32f103c8
    full_name: VccGND BluePill STM32F103C8
    vendor: vccgnd
    socs:
      - name: stm32f103xb
  - name: vccgnd_bluepill_stm32f103cb
    full_name: VccGND BluePill STM32F103CB
    vendor: vccgnd
    socs:
      - name: stm32f103xb
  - name: vccgnd_bluepill_stm32f072c8
    full_name: VccGND BluePill STM32F072C8
    vendor: vccgnd
    socs:
      - name: stm32f072xb
  - name: vccgnd_bluepill_stm32f072cb
    full_name: VccGND BluePill STM32F072CB
    vendor: vccgnd
    socs:
      - name: stm32f072xb
  - name: vccgnd_bluepill_stm32f051c8
    full_name: VccGND BluePill STM32F051C8
    vendor: vccgnd
    socs:
      - name: stm32f051x8
  - name: vccgnd_bluepill_stm32f030c8
    full_name: VccGND BluePill STM32F030C8
    vendor: vccgnd
    socs:
      - name: stm32f030x8
```
