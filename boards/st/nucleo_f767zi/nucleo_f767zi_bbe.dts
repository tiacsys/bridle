/*
 * Copyright (c) 2024-2026 TiaC Systems
 * SPDX-License-Identifier: Apache-2.0
 */

#include "../../zephyr/boards/st/nucleo_f767zi/nucleo_f767zi.dts"

/ {
	model = "STMicroelectronics STM32F767ZI-NUCLEO board @ UART Concole (BBE)";
	compatible = "st,stm32f767zi-nucleo",
		     "st,stm32f767zi-nucleo-bbe",
		     "st,stm32f767zi-nucleo-uartcons",
		     "st,stm32f767zi-nucleo-uartcons-bbe";

	chosen {
		zephyr,console = &usart3;
		zephyr,shell-uart = &usart3;
	};
};
