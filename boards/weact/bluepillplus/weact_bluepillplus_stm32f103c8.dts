/*
 * Copyright (c) 2025 TiaC Systems
 * SPDX-License-Identifier: Apache-2.0
 */

/dts-v1/;

#include <st/f1/stm32f103X8.dtsi>
#include <st/f1/stm32f103c(8-b)tx-pinctrl.dtsi>

/ {
	model = "WeAct Studio BluePill+ STM32F103C8 @ UART Concole";
	compatible = "weact,bluepillplus-stm32f103c8",
		     "weact,bluepillplus-stm32f103c8-uartcons";
};

#include "stm32/72mhz.dtsi"
#include "stm32/usart1.dtsi"
#include "stm32/dietemp.dtsi"
#include "stm32f1/adc.dtsi"
#include "stm32f1/spi.dtsi"

#include "stm32/io_adc.dtsi"
#include "stm32/io_i2c.dtsi"
#include "stm32/io_spi.dtsi"
#include "stm32/user_button.dtsi"
#include "stm32/user_led.dtsi"

#include "stm32/connector.dtsi"
bluepill_serial: &usart1 {};
bluepill_i2c: &i2c1 {};
bluepill_spi: &spi2 {};
