/*
 * Copyright (c) 2023 TiaC Systems
 * SPDX-License-Identifier: Apache-2.0
 */

/ {
	grove_d7_header: grove-d7-connector {
		compatible = "seeed,grove-connector";
		#gpio-cells = <2>;
		gpio-map-mask = <0xffffffff 0xffffffc0>;
		gpio-map-pass-thru = <0 0x3f>;
		gpio-map = <0 0 &porta 21 0>,	/* D7 */
			   <1 0 &porta 6 0>;	/* D8 */
	};
};

#undef GROVE_PWM_D7_FAST
#define GROVE_PWM_D7_FAST				\
	&tcc0 {						\
		prescaler = <1>;			\
	};

#undef GROVE_PWM_D7_SLOW
#define GROVE_PWM_D7_SLOW				\
	&tcc0 {						\
		prescaler = <1024>;			\
	};

#undef GROVE_PWM_D7_ENABLE
#define GROVE_PWM_D7_ENABLE				\
	&tcc0 {						\
		status = "okay";			\
	};

#undef GROVE_PWM_D7_PINCTRL
#define GROVE_PWM_D7_PINCTRL				\
	&tcc0_pwm_default {				\
		group7 {				\
			pinmux = <PA21F_TCC0_WO7>;	\
		};					\
	};

#undef GROVE_PWM_D8_FAST
#define GROVE_PWM_D8_FAST				\
	&tcc1 {						\
		prescaler = <1>;			\
	};

#undef GROVE_PWM_D8_SLOW
#define GROVE_PWM_D8_SLOW				\
	&tcc1 {						\
		prescaler = <1024>;			\
	};

#undef GROVE_PWM_D8_ENABLE
#define GROVE_PWM_D8_ENABLE				\
	&tcc1 {						\
		status = "okay";			\
	};

#undef GROVE_PWM_D8_PINCTRL
#define GROVE_PWM_D8_PINCTRL				\
	&tcc1_pwm_default {				\
		group0 {				\
			pinmux = <PA6E_TCC1_WO0>;	\
		};					\
	};
