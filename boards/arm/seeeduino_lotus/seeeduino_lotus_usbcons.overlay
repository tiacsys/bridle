/*
 * Copyright (c) 2023 TiaC Systems
 * SPDX-License-Identifier: Apache-2.0
 */

/ {
	model = "Seeeduino Lotus Cortex-M0+ @ USB-CDC/ACM Concole";
	compatible = "seeed,seeeduino-lotus", "seeed,seeeduino-lotus-usbcons";

	chosen {
		zephyr,console = &cdc_acm_uart0;
		zephyr,shell-uart = &cdc_acm_uart0;
	};
};

&zephyr_udc0 {
	cdc_acm_uart0: cdc-acm-uart-0 {
		compatible = "zephyr,cdc-acm-uart";
	};
};
