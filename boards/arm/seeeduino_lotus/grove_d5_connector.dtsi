/*
 * Copyright (c) 2023 TiaC Systems
 * SPDX-License-Identifier: Apache-2.0
 */

/ {
	grove_d5_header: grove-d5-connector {
		compatible = "seeed,grove-connector";
		#gpio-cells = <2>;
		gpio-map-mask = <0xffffffff 0xffffffc0>;
		gpio-map-pass-thru = <0 0x3f>;
		gpio-map = <0 0 &porta 15 0>,	/* D5 */
			   <1 0 &porta 20 0>;	/* D6 */
	};
};

#undef GROVE_PWM_D5_FAST
#define GROVE_PWM_D5_FAST				\
	&tcc0 {						\
		prescaler = <1>;			\
	};

#undef GROVE_PWM_D5_SLOW
#define GROVE_PWM_D5_SLOW				\
	&tcc0 {						\
		prescaler = <1024>;			\
	};

#undef GROVE_PWM_D5_ENABLE
#define GROVE_PWM_D5_ENABLE				\
	&tcc0 {						\
		status = "okay";			\
	};

#undef GROVE_PWM_D5_PINCTRL
#define GROVE_PWM_D5_PINCTRL				\
	&tcc0_pwm_default {				\
		group5 {				\
			pinmux = <PA15F_TCC0_WO5>;	\
		};					\
	};
