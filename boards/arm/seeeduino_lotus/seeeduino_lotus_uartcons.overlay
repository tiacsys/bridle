/*
 * Copyright (c) 2023 TiaC Systems
 * SPDX-License-Identifier: Apache-2.0
 */

/ {
	model = "Seeeduino Lotus Cortex-M0+ @ UART Concole";
	compatible = "seeed,seeeduino-lotus", "seeed,seeeduino-lotus-uartcons";

	chosen {
		zephyr,console = &sercom2;
		zephyr,shell-uart = &sercom2;
	};
};
