/*
 * Copyright (c) 2023 TiaC Systems
 * SPDX-License-Identifier: Apache-2.0
 */

/ {
	grove_d3_header: grove-d3-connector {
		compatible = "seeed,grove-connector";
		#gpio-cells = <2>;
		gpio-map-mask = <0xffffffff 0xffffffc0>;
		gpio-map-pass-thru = <0 0x3f>;
		gpio-map = <0 0 &porta 9 0>,	/* D3 */
			   <1 0 &porta 8 0>;	/* D4 */
	};
};

#undef GROVE_PWM_D3_FAST
#define GROVE_PWM_D3_FAST				\
	&tcc0 {						\
		prescaler = <1>;			\
	};

#undef GROVE_PWM_D3_SLOW
#define GROVE_PWM_D3_SLOW				\
	&tcc0 {						\
		prescaler = <1024>;			\
	};

#undef GROVE_PWM_D3_ENABLE
#define GROVE_PWM_D3_ENABLE				\
	&tcc0 {						\
		status = "okay";			\
	};

#undef GROVE_PWM_D3_PINCTRL
#define GROVE_PWM_D3_PINCTRL				\
	&tcc0_pwm_default {				\
		group1 {				\
			pinmux = <PA9E_TCC0_WO1>;	\
		};					\
	};

grove_pwm_d3: &tcc0 {};
