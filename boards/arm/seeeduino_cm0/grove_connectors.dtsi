/*
 * Copyright (c) 2023 TiaC Systems
 * SPDX-License-Identifier: Apache-2.0
 */

#include <bridle/dt-bindings/seeed_grove_pwms_defaults.h>

#include "grove_i2c_connector.dtsi"
#include "grove_uart_connector.dtsi"

/ {
	grove_laced_if_cm0: grove-laced-if-cm0 {
		compatible = "seeed,grove-laced-if";

		#gpio-cells = <2>;
		gpio-map-mask = <0xffffffff 0xffffffc0>;
		gpio-map-pass-thru = <0 0x3f>;
		gpio-map =
			<0 0 &grove_uart_header 0 0>,	/* D0: UART-RX as GPIO */
			<1 0 &grove_uart_header 1 0>,	/* D1: UART-TX as GPIO */
			/*  2 - D2:  not wired */
			/*  3 - D3:  not wired */
			/*  4 - D4:  not wired */
			/*  5 - D5:  not wired */
			/*  6 - D6:  not wired */
			/*  7 - D7:  not wired */
			/*  8 - D8:  not wired */
			/*  9 - D9:  not wired */
			/* 10 - D10: not wired */
			/* 11 - D11: not wired */
			/* 12 - D12: not wired */
			/* 13 - D13: not wired */
			/* 14 - D14: A0 as GPIO not wired */
			/* 15 - D15: A1 as GPIO not wired */
			/* 16 - D16: A2 as GPIO not wired */
			/* 17 - D17: A3 as GPIO not wired */
			<18 0 &grove_i2c_header 1 0>,	/* D18: I2C-SDA as GPIO */
			<19 0 &grove_i2c_header 0 0>;	/* D19: I2C-SCL as GPIO */

		#pwm-cells = <2>;
		pwm-map-mask = <0xffffffff 0>;
		pwm-map-pass-thru = <0 0xffffffff>;
		pwm-map;
			/*  0 - D0: not possible */
			/*  1 - D1: not possible */
			/*  2 - D2:  not wired */
			/*  3 - D3:  not wired */
			/*  4 - D4:  not wired */
			/*  5 - D5:  not wired */
			/*  6 - D6:  not wired */
			/*  7 - D7:  not wired */
			/*  8 - D8:  not possible */
			/*  9 - D9:  not possible */
			/* 10 - D10: not possible */
			/* 11 - D11: not possible */
			/* 12 - D12: not possible */
			/* 13 - D13: not possible */
			/* 14 - D14: not possible */
			/* 15 - D15: not possible */
			/* 16 - D16: not possible */
			/* 17 - D17: not possible */
	};
};

grove_gpios: &grove_laced_if_cm0 {};
