/*
 * Copyright (c) 2023 TiaC Systems
 * SPDX-License-Identifier: Apache-2.0
 */

/ {
	arduino_header: connector {
		compatible = "arduino-header-r3";
		#gpio-cells = <2>;
		gpio-map-mask = <0xffffffff 0xffffffc0>;
		gpio-map-pass-thru = <0 0x3f>;
		gpio-map = <0 0 &porta 2 0>,	/* A0 */
			   <1 0 &portb 8 0>,	/* A1 */
			   <2 0 &portb 9 0>,	/* A2 */
			   <3 0 &porta 4 0>,	/* A3 */
			   <4 0 &porta 5 0>,	/* A4 */
			   <5 0 &portb 2 0>,	/* A5 */
			   <6 0 &porta 11 0>,	/* D0 */
			   <7 0 &porta 10 0>,	/* D1 */
			   <8 0 &porta 14 0>,	/* D2 */
			   <9 0 &porta 9 0>,	/* D3 */
			   <10 0 &porta 8 0>,	/* D4 */
			   <11 0 &porta 15 0>,	/* D5 */
			   <12 0 &porta 20 0>,	/* D6 */
			   <13 0 &porta 21 0>,	/* D7 */
			   <14 0 &porta 6 0>,	/* D8 */
			   <15 0 &porta 7 0>,	/* D9 */
			   <16 0 &porta 18 0>,	/* D10 */
			   <17 0 &porta 16 0>,	/* D11 */
			   <18 0 &porta 19 0>,	/* D12 */
			   <19 0 &porta 17 0>,	/* D13 */
			   <20 0 &porta 22 0>,	/* D14 */
			   <21 0 &porta 23 0>;	/* D15 */
	};
};

arduino_serial: &sercom0 {};
