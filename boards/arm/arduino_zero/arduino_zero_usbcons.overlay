/*
 * Copyright (c) 2023 TiaC Systems
 * SPDX-License-Identifier: Apache-2.0
 */

/ {
	model = "Arduino Zero @ USB-CDC/ACM Concole";
	compatible = "arduino,zero-usbcons", "arduino,zero",
		     "atmel,samd21g18a", "atmel,samd21";

	chosen {
		zephyr,console = &cdc_acm_uart0;
		zephyr,shell-uart = &cdc_acm_uart0;
	};
};

&zephyr_udc0 {
	cdc_acm_uart0: cdc-acm-uart-0 {
		compatible = "zephyr,cdc-acm-uart";
	};
};
