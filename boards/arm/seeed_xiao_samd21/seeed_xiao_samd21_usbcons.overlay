/*
 * Copyright (c) 2023 TiaC Systems
 * SPDX-License-Identifier: Apache-2.0
 */

/ {
	model = "Seeed Studio XIAO SAMD21 (Seeeduino XIAO) @ USB-CDC/ACM Concole";
	compatible = "seeed,seeed-xiao-samd21-usbcons",
		     "seeed,seeed-xiao-samd21",
		     "seeed,seeeduino-xiao-usbcons",
		     "seeed,seeeduino-xiao",
		     "atmel,samd21g18a",
		     "atmel,samd21";

	chosen {
		zephyr,console = &cdc_acm_uart0;
		zephyr,shell-uart = &cdc_acm_uart0;
	};
};

&zephyr_udc0 {
	cdc_acm_uart0: cdc-acm-uart-0 {
		compatible = "zephyr,cdc-acm-uart";
	};
};
