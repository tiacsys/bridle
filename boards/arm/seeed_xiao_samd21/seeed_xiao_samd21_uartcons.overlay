/*
 * Copyright (c) 2023 TiaC Systems
 * SPDX-License-Identifier: Apache-2.0
 */

/ {
	model = "Seeed Studio XIAO SAMD21 (Seeeduino XIAO) @ UART Concole";
	compatible = "seeed,seeed-xiao-samd21-uartcons",
		     "seeed,seeed-xiao-samd21",
		     "seeed,seeeduino-xiao-uartcons",
		     "seeed,seeeduino-xiao",
		     "atmel,samd21g18a",
		     "atmel,samd21";

	chosen {
		zephyr,console = &sercom4;
		zephyr,shell-uart = &sercom4;
	};
};
