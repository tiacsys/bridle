## boards/arm/vccgnd_bluepill/Kconfig.defconfig
```kconfig
# Copyright (c) 2022 TiaC Systems
# Copyright (c) 2017, embedjournal.com
# SPDX-License-Identifier: Apache-2.0

# STM32F103C8 based Blue Pill board configuration

if BOARD_VCCGND_BLUEPILL

config BOARD
	default "vccgnd_bluepill"

endif # BOARD_VCCGND_BLUEPILL
```

## boards/arm/vccgnd_bluepill/vccgnd_bluepill_defconfig
```kconfig
# Copyright (c) 2022 TiaC Systems
# Copyright (c) 2017, embedjournal.com
# SPDX-License-Identifier: Apache-2.0

CONFIG_SOC_SERIES_STM32F1X=y
CONFIG_SOC_STM32F103X8=y

# enable uart driver
CONFIG_SERIAL=y

# enable console
CONFIG_CONSOLE=y
CONFIG_UART_CONSOLE=y

# enable GPIO
CONFIG_GPIO=y

# enable clock control
CONFIG_CLOCK_CONTROL=y

# enable pin controller
CONFIG_PINCTRL=y

# Respect STM32duino DFU Bootloader,
# link application behind.
CONFIG_USE_DT_CODE_PARTITION=y
```

## boards/arm/waveshare_rp2040/Kconfig.board
```kconfig
# Copyright (c) 2023 TiaC Systems
# SPDX-License-Identifier: Apache-2.0

config BOARD_WAVESHARE_RP2040_ONE
	bool "Waveshare RP2040-One Board"
	depends on SOC_RP2040

config BOARD_WAVESHARE_RP2040_ZERO
	bool "Waveshare RP2040-Zero Board"
	depends on SOC_RP2040

config BOARD_WAVESHARE_RP2040_MATRIX
	bool "Waveshare RP2040-Matrix Board"
	depends on SOC_RP2040

config BOARD_WAVESHARE_RP2040_TINY
	bool "Waveshare RP2040-Tiny Board"
	depends on SOC_RP2040

config BOARD_WAVESHARE_RP2040_ETH
	bool "Waveshare RP2040-ETH Board"
	depends on SOC_RP2040

config BOARD_WAVESHARE_RP2040_LCD_0_96
	bool "Waveshare RP2040-LCD-0.96 Board"
	depends on SOC_RP2040

config BOARD_WAVESHARE_RP2040_PLUS
	bool "Waveshare RP2040-Plus Board"
	depends on SOC_RP2040

config BOARD_WAVESHARE_RP2040_GEEK
	bool "Waveshare RP2040-Geek Board"
	depends on SOC_RP2040
```

## boards/arm/waveshare_rp2040/Kconfig.defconfig
```kconfig
# Copyright (c) 2023 TiaC Systems
# SPDX-License-Identifier: Apache-2.0

config BOARD
	default "waveshare_rp2040_one" if BOARD_WAVESHARE_RP2040_ONE
	default "waveshare_rp2040_zero" if BOARD_WAVESHARE_RP2040_ZERO
	default "waveshare_rp2040_matrix" if BOARD_WAVESHARE_RP2040_MATRIX
	default "waveshare_rp2040_tiny" if BOARD_WAVESHARE_RP2040_TINY
	default "waveshare_rp2040_eth" if BOARD_WAVESHARE_RP2040_ETH
	default "waveshare_rp2040_lcd_0_96" if BOARD_WAVESHARE_RP2040_LCD_0_96
	default "waveshare_rp2040_plus" if BOARD_WAVESHARE_RP2040_PLUS
	default "waveshare_rp2040_geek" if BOARD_WAVESHARE_RP2040_GEEK
	depends on BOARD_WAVESHARE_RP2040

config BOARD_WAVESHARE_RP2040_MINI
	bool
	default y if BOARD_WAVESHARE_RP2040_ONE
	default y if BOARD_WAVESHARE_RP2040_ZERO
	default y if BOARD_WAVESHARE_RP2040_MATRIX
	default y if BOARD_WAVESHARE_RP2040_TINY
	default n

config BOARD_WAVESHARE_RP2040_PICO
	bool
	default y if BOARD_WAVESHARE_RP2040_ETH
	default y if BOARD_WAVESHARE_RP2040_LCD_0_96
	default y if BOARD_WAVESHARE_RP2040_PLUS
	default n

config BOARD_WAVESHARE_RP2040_LCD
	bool
	default y if BOARD_WAVESHARE_RP2040_LCD_0_96
	default y if BOARD_WAVESHARE_RP2040_GEEK
	default n

config BOARD_WAVESHARE_RP2040
	bool
	default y if BOARD_WAVESHARE_RP2040_MINI
	default y if BOARD_WAVESHARE_RP2040_PICO
	default y if BOARD_WAVESHARE_RP2040_GEEK
	default n

config RP2_FLASH_W25Q080
	default y
	depends on BOARD_WAVESHARE_RP2040

config CLOCK_CONTROL
	default y
	depends on DT_HAS_RASPBERRYPI_PICO_CLOCK_ENABLED && \
		   DT_HAS_RASPBERRYPI_PICO_CLOCK_CONTROLLER_ENABLED

config RESET
	default y
	depends on DT_HAS_RASPBERRYPI_PICO_RESET_ENABLED

config GPIO
	default y
	depends on DT_HAS_RASPBERRYPI_PICO_GPIO_ENABLED

config REGULATOR
	default y
	depends on DT_HAS_REGULATOR_FIXED_ENABLED

config I2C_DW_CLOCK_SPEED
	default 125
	depends on I2C_DW && BOARD_WAVESHARE_RP2040

choice ST7789V_PIXEL_FORMAT
	default ST7789V_RGB565 if BOARD_WAVESHARE_RP2040_GEEK
	depends on BOARD_WAVESHARE_RP2040_LCD && DISPLAY
endchoice

config LV_Z_BITS_PER_PIXEL
	default 16 if BOARD_WAVESHARE_RP2040_LCD_0_96
	default 16 if BOARD_WAVESHARE_RP2040_GEEK
	depends on BOARD_WAVESHARE_RP2040_LCD && DISPLAY && LVGL

choice LV_COLOR_DEPTH
	default LV_COLOR_DEPTH_16 if BOARD_WAVESHARE_RP2040_LCD_0_96
	default LV_COLOR_DEPTH_16 if BOARD_WAVESHARE_RP2040_GEEK
	depends on BOARD_WAVESHARE_RP2040_LCD && DISPLAY && LVGL
endchoice

config LV_COLOR_16_SWAP
	default y if BOARD_WAVESHARE_RP2040_LCD_0_96
	default y if BOARD_WAVESHARE_RP2040_GEEK
	depends on BOARD_WAVESHARE_RP2040_LCD && DISPLAY && LVGL

config USB_SELF_POWERED
	default n
	depends on USB_DEVICE_STACK && BOARD_WAVESHARE_RP2040

config USB_MAX_POWER
	default 150 if BOARD_WAVESHARE_RP2040_ONE	# 300mA
	default 240 if BOARD_WAVESHARE_RP2040_ZERO	# 480mA
	default 150 if BOARD_WAVESHARE_RP2040_MATRIX	# 300mA
	default 150 if BOARD_WAVESHARE_RP2040_TINY	# 300mA
	default 240 if BOARD_WAVESHARE_RP2040_ETH	# 480mA
	default 250 if BOARD_WAVESHARE_RP2040_LCD_0_96	# 500mA
	default 250 if BOARD_WAVESHARE_RP2040_PLUS	# 500mA
	default 100 if BOARD_WAVESHARE_RP2040_GEEK	# 200mA
	depends on USB_DEVICE_STACK && BOARD_WAVESHARE_RP2040

# Workaround for not being able to have commas in macro arguments
DT_CHOSEN_Z_CONSOLE := zephyr,console
DT_COMPAT_Z_CDC_ACM_UART := zephyr,cdc-acm-uart
DT_COMPAT_RPIPICO_USB := raspberrypi,pico-usbd

# Macros to shorten Kconfig expressions
DT_CHOSEN_CONSOLE_NODE := $(dt_chosen_path,$(DT_CHOSEN_Z_CONSOLE))
DT_CHOSEN_CONSOLE_PARENT := $(dt_node_parent,$(DT_CHOSEN_CONSOLE_NODE))

if BOARD_WAVESHARE_RP2040 && \
   $(dt_chosen_enabled,$(DT_CHOSEN_Z_CONSOLE)) && \
   $(dt_compat_on_bus,$(DT_COMPAT_Z_CDC_ACM_UART),usb) && \
   $(dt_node_has_compat,$(DT_CHOSEN_CONSOLE_PARENT),$(DT_COMPAT_RPIPICO_USB))

# Logger cannot use itself to log
choice USB_CDC_ACM_LOG_LEVEL_CHOICE
	default USB_CDC_ACM_LOG_LEVEL_OFF
	depends on LOG
endchoice

# Set USB log level to error only
choice USB_DEVICE_LOG_LEVEL_CHOICE
	default USB_DEVICE_LOG_LEVEL_ERR
	depends on LOG
endchoice

# Wait 4000ms at startup for logging
config LOG_PROCESS_THREAD_STARTUP_DELAY_MS
	default 4000
	depends on LOG

# Wait 4000ms at startup for USB enumeration on host side
config BOOT_DELAY
	default 4000

endif # zephyr,cdc-acm-uart
```

## boards/arm/waveshare_rp2040/waveshare_rp2040_lcd_0_96_defconfig
```kconfig
# Copyright (c) 2023 TiaC Systems
# SPDX-License-Identifier: Apache-2.0

CONFIG_SOC_SERIES_RP2XXX=y
CONFIG_SOC_RP2040=y
CONFIG_BOARD_WAVESHARE_RP2040_LCD_0_96=y
CONFIG_SYS_CLOCK_HW_CYCLES_PER_SEC=125000000
CONFIG_CONSOLE=y
CONFIG_UART_CONSOLE=y
CONFIG_UART_INTERRUPT_DRIVEN=y
CONFIG_SERIAL=y
CONFIG_USE_DT_CODE_PARTITION=y
CONFIG_BUILD_OUTPUT_UF2=y
CONFIG_BUILD_OUTPUT_HEX=y
```

## boards/arm/weact_blackpill_v30/Kconfig.board
```kconfig
# Copyright (c) 2022 TiaC Systems
# Copyright (c) 2020 Kalyan Sriram <coder.kalyan@gmail.com>
# SPDX-License-Identifier: Apache-2.0

# STM32F401CE based Black Pill V3.0 board configuration

config BOARD_WEACT_BLACKPILL_V30
	bool "WeAct Studio Black Pill V3.0 Board"
	depends on SOC_STM32F401XE
```

## boards/arm/weact_blackpill_v30/Kconfig.defconfig
```kconfig
# Copyright (c) 2022 TiaC Systems
# Copyright (c) 2020 Kalyan Sriram <coder.kalyan@gmail.com>
# SPDX-License-Identifier: Apache-2.0

# STM32F401CE based Black Pill V3.0 board configuration

if BOARD_WEACT_BLACKPILL_V30

config BOARD
	default "weact_blackpill_v30"

config SPI_STM32_INTERRUPT
	default y
	depends on SPI

endif # BOARD_WEACT_BLACKPILL_V30
```

## boards/cytron/maker_rp2040/Kconfig.cytron_maker_pi_rp2040
```kconfig
# Copyright (c) 2023-2024 TiaC Systems
# SPDX-License-Identifier: Apache-2.0

config BOARD_CYTRON_MAKER_PI_RP2040
	select SOC_RP2040
```

## boards/cytron/maker_rp2040/board.yml
```yaml
boards:
  - name: cytron_maker_nano_rp2040
    full_name: Cytron Maker Nano RP2040
    vendor: cytron
    socs:
      - name: rp2040
  - name: cytron_maker_pi_rp2040
    full_name: Cytron Maker Pi RP2040
    vendor: cytron
    socs:
      - name: rp2040
```

## boards/cytron/motion_2350/Kconfig.cytron_motion_2350_pro
```kconfig
# Copyright (c) 2026 TiaC Systems
# SPDX-License-Identifier: Apache-2.0

config BOARD_CYTRON_MOTION_2350_PRO
	select SOC_RP2350A_M33 if BOARD_CYTRON_MOTION_2350_PRO_RP2350A_M33
	select SOC_RP2350A_HAZARD3 if BOARD_CYTRON_MOTION_2350_PRO_RP2350A_HAZARD3
```

## boards/cytron/motion_2350/board.yml
```yaml
# Copyright (c) 2026 TiaC Systems
# SPDX-License-Identifier: Apache-2.0

boards:
  - name: cytron_motion_2350_pro
    full_name: Cytron MOTION 2350 Pro
    vendor: cytron
    socs:
      - name: rp2350a
```

## boards/cytron/motion_2350/cytron_motion_2350_pro_rp2350a_hazard3_defconfig
```kconfig
# Copyright (c) 2026 TiaC Systems
# SPDX-License-Identifier: Apache-2.0

# This configuration is orthogonal to whether the Cortex-M33
# or Hazard3 cores are in use, but Zephyr does not support
# providing a qualifier-agnostic "_defconfig" file.

CONFIG_BUILD_OUTPUT_HEX=y
CONFIG_BUILD_OUTPUT_UF2=y

CONFIG_USE_DT_CODE_PARTITION=y

CONFIG_CONSOLE=y
CONFIG_SERIAL=y
CONFIG_UART_CONSOLE=y
CONFIG_UART_INTERRUPT_DRIVEN=y
```

## boards/extensions/Kconfig.arduino_zero
```kconfig
# Copyright (c) 2024 TiaC Systems
# SPDX-License-Identifier: Apache-2.0

rsource "zero/Kconfig.defconfig"
```

## boards/extensions/Kconfig.mimxrt1010_evk
```kconfig
# Copyright (c) 2024-2025 TiaC Systems
# SPDX-License-Identifier: Apache-2.0

# zephyr-keep-sorted-start
rsource "mimxrt1010_evk/Kconfig.defconfig"
# zephyr-keep-sorted-stop
```

## boards/extensions/Kconfig.mimxrt1060_evk
```kconfig
# Copyright (c) 2024 TiaC Systems
# SPDX-License-Identifier: Apache-2.0

rsource "mimxrt1060_evk/Kconfig.defconfig"
```

## boards/extensions/Kconfig.nucleo_f767zi
```kconfig
# Copyright (c) 2024-2025 TiaC Systems
# SPDX-License-Identifier: Apache-2.0

# zephyr-keep-sorted-start
rsource "nucleo_f767zi/Kconfig.defconfig"
# zephyr-keep-sorted-stop
```

## boards/extensions/Kconfig.rpi_pico2
```kconfig
# Copyright (c) 2025 TiaC Systems
# SPDX-License-Identifier: Apache-2.0

# zephyr-keep-sorted-start
rsource "rpi_pico2/Kconfig.defconfig"
# zephyr-keep-sorted-stop
```

## boards/extensions/Kconfig.rpi_pico_w
```kconfig
# Copyright (c) 2024-2025 TiaC Systems
# SPDX-License-Identifier: Apache-2.0

# zephyr-keep-sorted-start
rsource "rpi_pico/Kconfig.defconfig"
# zephyr-keep-sorted-stop
```

## boards/extensions/Kconfig.xiao_rp2350
```kconfig
# Copyright (c) 2026 TiaC Systems
# SPDX-License-Identifier: Apache-2.0

# zephyr-keep-sorted-start
rsource "xiao_rp2350/Kconfig.defconfig"
# zephyr-keep-sorted-stop
```

## boards/extensions/mimxrt1060_evk/Kconfig.defconfig
```kconfig
# NXP MIMXRT1060-EVK board extended configuration

# Copyright (c) 2024 TiaC Systems
# SPDX-License-Identifier: Apache-2.0

config USB_SELF_POWERED
	default y
	depends on USB_DEVICE_STACK && BOARD_MIMXRT1060_EVK

config USB_MAX_POWER
	default 0 if BOARD_MIMXRT1060_EVK	# 0mA (self powered)
	depends on USB_DEVICE_STACK && BOARD_MIMXRT1060_EVK

# Workaround for not being able to have commas in macro arguments
DT_CHOSEN_Z_CONSOLE := zephyr,console
DT_COMPAT_Z_CDC_ACM_UART := zephyr,cdc-acm-uart
DT_COMPAT_NXP_USB := nxp,ehci

# Macros to shorten Kconfig expressions
DT_CHOSEN_CONSOLE_NODE := $(dt_chosen_path,$(DT_CHOSEN_Z_CONSOLE))
DT_CHOSEN_CONSOLE_PARENT := $(dt_node_parent,$(DT_CHOSEN_CONSOLE_NODE))

if BOARD_MIMXRT1060_EVK && \
	$(dt_chosen_enabled,$(DT_CHOSEN_Z_CONSOLE)) && \
	$(dt_compat_on_bus,$(DT_COMPAT_Z_CDC_ACM_UART),usb) && \
	$(dt_node_has_compat,$(DT_CHOSEN_CONSOLE_PARENT),$(DT_COMPAT_NXP_USB))

# Logger cannot use itself to log
choice USB_CDC_ACM_LOG_LEVEL_CHOICE
	default USB_CDC_ACM_LOG_LEVEL_OFF
	depends on LOG
endchoice

# Set USB log level to error only
choice USB_DEVICE_LOG_LEVEL_CHOICE
	default USB_DEVICE_LOG_LEVEL_ERR
	depends on LOG
endchoice

# Wait 4000ms at startup for logging
config LOG_PROCESS_THREAD_STARTUP_DELAY_MS
	default 4000
	depends on LOG

# Wait 4000ms at startup for USB enumeration on host side
config BOOT_DELAY
	default 4000

endif # zephyr,cdc-acm-uart

#
# WARNINGS and NOTES for the disk name (CONFIG_MASS_STORAGE_DISK_NAME):
#
# 1. In principle, the disk name can be freely selected. If this is changed
#    here in Kconfig, then the corresponding property "disk-name" in the
#    corresponding Devicetree node with the compatibility "zephyr,flash-disk"
#    must also be adapted. This should be improved in the future, as it
#    represents double data storage.
#
# 2. If the FAT file system is used, the disk name defined here will also
#    be used as the mountpoint. The currently used FATFS implementation
#    automatically enters the disk name as mountpoint, which means that
#    an application can only reach the correct disk via the exact same
#    mountpoint name. Unfortunately, the current example application under
#    "zephyr/samples/subsys/usb/mass" is hard-coded at this point and only
#    expects the (disk) mountpoint name "NAND" and nothing else. This must
#    be changed, as this implicitly represents a special configuration at
#    source code level.
#

config MASS_STORAGE_DISK_NAME
	default "NAND" if BOARD_MIMXRT1060_EVK
	depends on USB_DEVICE_STACK && USB_MASS_STORAGE
```

## boards/extensions/nucleo_f767zi/Kconfig.defconfig
```kconfig
# STMicroelectronics Nucleo F767ZI board extended configuration

# Copyright (c) 2024-2025 TiaC Systems
# SPDX-License-Identifier: Apache-2.0

# Workaround for not being able to have commas in macro arguments
DT_CHOSEN_Z_CONSOLE := zephyr,console
DT_COMPAT_Z_CDC_ACM_UART := zephyr,cdc-acm-uart
DT_COMPAT_STM32_USB := st,stm32-otgfs

# Macros to shorten Kconfig expressions
DT_CHOSEN_CONSOLE_NODE := $(dt_chosen_path,$(DT_CHOSEN_Z_CONSOLE))
DT_CHOSEN_CONSOLE_PARENT := $(dt_node_parent,$(DT_CHOSEN_CONSOLE_NODE))

if BOARD_NUCLEO_F767ZI && \
	$(dt_chosen_enabled,$(DT_CHOSEN_Z_CONSOLE)) && \
	$(dt_compat_on_bus,$(DT_COMPAT_Z_CDC_ACM_UART),usb) && \
	$(dt_node_has_compat,$(DT_CHOSEN_CONSOLE_PARENT),$(DT_COMPAT_STM32_USB))

config CDC_ACM_SERIAL_SELF_POWERED
	default y
	depends on USB_DEVICE_STACK_NEXT && USBD_CDC_ACM_CLASS

config CDC_ACM_SERIAL_MAX_POWER
	default 0 if BOARD_NUCLEO_F767ZI	# 0mA (self powered)
	depends on USB_DEVICE_STACK_NEXT && USBD_CDC_ACM_CLASS

# Logger cannot use itself to log
choice USBD_CDC_ACM_LOG_LEVEL_CHOICE
	default USBD_CDC_ACM_LOG_LEVEL_OFF
	depends on LOG && USB_DEVICE_STACK_NEXT && USBD_CDC_ACM_CLASS
endchoice

# Set USB log level to error only
choice USBD_LOG_LEVEL_CHOICE
	default USBD_LOG_LEVEL_ERR
	depends on LOG && USB_DEVICE_STACK_NEXT && USBD_CDC_ACM_CLASS
endchoice

# Set UDC driver log level to error only
choice UDC_DRIVER_LOG_LEVEL_CHOICE
	default UDC_DRIVER_LOG_LEVEL_ERR
	depends on LOG && USB_DEVICE_STACK_NEXT && USBD_CDC_ACM_CLASS
endchoice

endif # zephyr,cdc-acm-uart
```
