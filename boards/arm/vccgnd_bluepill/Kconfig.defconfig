## boards/jsed/picoboy/Kconfig.defconfig
```kconfig
# Copyright (c) 2023-2025 TiaC Systems
# SPDX-License-Identifier: Apache-2.0

config BOARD_PICOBOY_OLED_1_3
	bool
	default y if BOARD_PICOBOY
	default n

config BOARD_PICOBOY_LCD_1_69
	bool
	default y if BOARD_PICOBOY_COLOR
	default y if BOARD_PICOBOY_COLOR_PLUS
	default n

config BOARD_PICOBOY_ACCEL_TRIG
	bool
	default y if BOARD_PICOBOY_COLOR_PLUS
	default n

config BOARD_PICOBOY_USBCONS
	bool
	default y if BOARD_PICOBOY
	default y if BOARD_PICOBOY_COLOR
	default y if BOARD_PICOBOY_COLOR_PLUS
	default n

config RP2_FLASH_W25Q080
	default y if BOARD_PICOBOY
	default y if BOARD_PICOBOY_COLOR
	depends on SOC_SERIES_RP2040

config CLOCK_CONTROL
	default y
	depends on DT_HAS_RASPBERRYPI_PICO_CLOCK_ENABLED && \
		   DT_HAS_RASPBERRYPI_PICO_CLOCK_CONTROLLER_ENABLED

config REGULATOR
	default y
	depends on DT_HAS_RASPBERRYPI_CORE_SUPPLY_REGULATOR_ENABLED

config RESET
	default y
	depends on DT_HAS_RASPBERRYPI_PICO_RESET_ENABLED

config WATCHDOG
	default y
	depends on DT_HAS_RASPBERRYPI_PICO_WATCHDOG_ENABLED

config WDT_DISABLE_AT_BOOT
	default y if BOARD_PICOBOY
	default y if BOARD_PICOBOY_COLOR
	default y if BOARD_PICOBOY_COLOR_PLUS
	depends on WATCHDOG && HAS_WDT_DISABLE_AT_BOOT

config COUNTER
	default y
	depends on DT_HAS_RASPBERRYPI_PICO_TIMER_ENABLED

config DMA
	default y
	depends on DT_HAS_RASPBERRYPI_PICO_DMA_ENABLED

config GPIO
	default y
	depends on DT_HAS_RASPBERRYPI_PICO_GPIO_ENABLED

config PWM
	default y
	depends on DT_HAS_RASPBERRYPI_PICO_PWM_ENABLED

choice STK8BA58_TRIGGER_MODE
#	default STK8BA58_TRIGGER_GLOBAL_THREAD if BOARD_PICOBOY_ACCEL_TRIG
	default STK8BA58_TRIGGER_OWN_THREAD if BOARD_PICOBOY_ACCEL_TRIG
	default STK8BA58_TRIGGER_NONE
	depends on SENSOR && STK8BA58
endchoice

choice ST7789V_PIXEL_FORMAT
	default ST7789V_RGB565 if BOARD_PICOBOY_LCD_1_69
	depends on DISPLAY && LVGL
endchoice

config LV_Z_VDB_SIZE
	default 64 if BOARD_PICOBOY_OLED_1_3
	depends on DISPLAY && LVGL

config LV_DPI_DEF
	default 116 if BOARD_PICOBOY_OLED_1_3
	depends on DISPLAY && LVGL

config LV_Z_BITS_PER_PIXEL
	default 1 if BOARD_PICOBOY_OLED_1_3
	default 16 if BOARD_PICOBOY_LCD_1_69
	depends on DISPLAY && LVGL

choice LV_COLOR_DEPTH
	default LV_COLOR_DEPTH_1 if BOARD_PICOBOY_OLED_1_3
	default LV_COLOR_DEPTH_16 if BOARD_PICOBOY_LCD_1_69
	depends on DISPLAY && LVGL
endchoice

config LV_COLOR_16_SWAP
	default y if BOARD_PICOBOY_LCD_1_69
	depends on DISPLAY && LVGL

config LV_FONT_MONTSERRAT_8
	default y if BOARD_PICOBOY_OLED_1_3
	depends on DISPLAY && LVGL

config LV_FONT_MONTSERRAT_10
	default y if BOARD_PICOBOY_OLED_1_3
	depends on DISPLAY && LVGL

config LV_FONT_MONTSERRAT_12
	default y if BOARD_PICOBOY_OLED_1_3
	depends on DISPLAY && LVGL

config LV_FONT_MONTSERRAT_14
	default y if BOARD_PICOBOY_OLED_1_3
	depends on DISPLAY && LVGL

choice LV_FONT_DEFAULT
	default LV_FONT_DEFAULT_MONTSERRAT_10 if !LV_CONF_MINIMAL
	default LV_FONT_DEFAULT_UNSCII_8 if LV_CONF_MINIMAL
	depends on DISPLAY && LVGL
endchoice

config INPUT
	default y if DT_HAS_ZEPHYR_LVGL_BUTTON_INPUT_ENABLED
	default y if DT_HAS_ZEPHYR_LVGL_KEYPAD_INPUT_ENABLED
	depends on DISPLAY && LVGL

# Workaround for not being able to have commas in macro arguments
DT_CHOSEN_Z_CONSOLE := zephyr,console
DT_COMPAT_Z_CDC_ACM_UART := zephyr,cdc-acm-uart
DT_COMPAT_RPIPICO_USB := raspberrypi,pico-usbd

# Macros to shorten Kconfig expressions
DT_CHOSEN_CONSOLE_NODE := $(dt_chosen_path,$(DT_CHOSEN_Z_CONSOLE))
DT_CHOSEN_CONSOLE_PARENT := $(dt_node_parent,$(DT_CHOSEN_CONSOLE_NODE))

if BOARD_PICOBOY_USBCONS && \
	$(dt_chosen_enabled,$(DT_CHOSEN_Z_CONSOLE)) && \
	$(dt_compat_on_bus,$(DT_COMPAT_Z_CDC_ACM_UART),usb) && \
	$(dt_node_has_compat,$(DT_CHOSEN_CONSOLE_PARENT),$(DT_COMPAT_RPIPICO_USB))

config CDC_ACM_SERIAL_SELF_POWERED
	default n
	depends on USB_DEVICE_STACK_NEXT && BOARD_PICOBOY_USBCONS

config CDC_ACM_SERIAL_MAX_POWER
	default 125 if BOARD_PICOBOY		# 250mA
	default 125 if BOARD_PICOBOY_COLOR	# 250mA
	default 125 if BOARD_PICOBOY_COLOR_PLUS	# 250mA
	depends on USB_DEVICE_STACK_NEXT && BOARD_PICOBOY_USBCONS

# Logger cannot use itself to log
choice USBD_CDC_ACM_LOG_LEVEL_CHOICE
	default USBD_CDC_ACM_LOG_LEVEL_OFF
	depends on LOG && USB_DEVICE_STACK_NEXT && USBD_CDC_ACM_CLASS
endchoice

# Set USB log level to error only
choice USBD_LOG_LEVEL_CHOICE
	default USBD_LOG_LEVEL_ERR
	depends on LOG && USB_DEVICE_STACK_NEXT && USBD_CDC_ACM_CLASS
endchoice

# Set UDC driver log level to error only
choice UDC_DRIVER_LOG_LEVEL_CHOICE
	default UDC_DRIVER_LOG_LEVEL_ERR
	depends on LOG && USB_DEVICE_STACK_NEXT && USBD_CDC_ACM_CLASS
endchoice

endif # zephyr,cdc-acm-uart
```

## boards/jsed/picoboy/Kconfig.picoboy_color
```kconfig
# Copyright (c) 2023-2025 TiaC Systems
# SPDX-License-Identifier: Apache-2.0

config BOARD_PICOBOY_COLOR
	select SOC_RP2040 if BOARD_PICOBOY_COLOR_RP2040
```

## boards/jsed/picoboy/Kconfig.picoboy_color_plus
```kconfig
# Copyright (c) 2023-2025 TiaC Systems
# SPDX-License-Identifier: Apache-2.0

config BOARD_PICOBOY_COLOR_PLUS
	select SOC_RP2350A_M33 if BOARD_PICOBOY_COLOR_PLUS_RP2350A_M33
```

## boards/jsed/picoboy/picoboy_color_defconfig
```kconfig
# Copyright (c) 2023-2025 TiaC Systems
# SPDX-License-Identifier: Apache-2.0

CONFIG_BUILD_OUTPUT_UF2=y
CONFIG_BUILD_OUTPUT_HEX=y

CONFIG_USE_DT_CODE_PARTITION=y

CONFIG_SERIAL=y
CONFIG_CONSOLE=y
CONFIG_UART_CONSOLE=y
CONFIG_UART_LINE_CTRL=y
CONFIG_UART_INTERRUPT_DRIVEN=y

CONFIG_USB_DEVICE_STACK_NEXT=y
CONFIG_CDC_ACM_SERIAL_VID=0x2E8A
CONFIG_CDC_ACM_SERIAL_PID=0x000A
CONFIG_CDC_ACM_SERIAL_MANUFACTURER_STRING="JSED (Raspberry Pi)"
CONFIG_CDC_ACM_SERIAL_PRODUCT_STRING="PicoBoy Color (CDC ACM)"
CONFIG_CDC_ACM_SERIAL_INITIALIZE_AT_BOOT=y
```
