/*
 * Copyright (c) 2023 TiaC Systems
 *
 * SPDX-License-Identifier: Apache-2.0
 */

/ {
	model = "Trinamic Startrampe @ USB-CDC/ACM Concole";
	compatible = "trinamic,startrampe-usbcons", "trinamic,startrampe",
		     "st,stm32f205vc", "st,stm32f205";

	chosen {
		zephyr,console = &cdc_acm_uart0;
		zephyr,shell-uart = &cdc_acm_uart0;
	};
};

&zephyr_udc0 {
	cdc_acm_uart0: cdc-acm-uart-0 {
		compatible = "zephyr,cdc-acm-uart";
	};
};
