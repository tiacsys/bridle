/*
 * Copyright (c) 2023 TiaC Systems
 * SPDX-License-Identifier: Apache-2.0
 */

/ {
	model = "Waveshare RP2040-Zero @ USB-CDC/ACM Concole";
	compatible = "waveshare,rp2040-zero", "waveshare,rp2040-zero-usbcons";

	chosen {
		zephyr,console = &cdc_acm_uart0;
		zephyr,shell-uart = &cdc_acm_uart0;
	};
};

&zephyr_udc0 {
	cdc_acm_uart0: cdc-acm-uart-0 {
		compatible = "zephyr,cdc-acm-uart";
	};
};
