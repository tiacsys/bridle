/*
 * Copyright (c) 2023 TiaC Systems
 * SPDX-License-Identifier: Apache-2.0
 */

#include "waveshare_rp2040-16mb.dtsi"

/ {
	model = "Waveshare RP2040-Plus (16MB) @ UART Concole";
	compatible = "waveshare,rp2040-plus", "waveshare,rp2040-plus-uartcons",
		     "waveshare,rp2040-plus-16mb", "waveshare,rp2040-plus-16mb-uartcons";

	chosen {
		zephyr,console = &uart0;
		zephyr,shell-uart = &uart0;
	};
};
