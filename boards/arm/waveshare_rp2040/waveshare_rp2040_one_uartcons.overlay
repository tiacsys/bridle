/*
 * Copyright (c) 2023 TiaC Systems
 * SPDX-License-Identifier: Apache-2.0
 */

/ {
	model = "Waveshare RP2040-One @ UART Concole";
	compatible = "waveshare,rp2040-one", "waveshare,rp2040-one-uartcons";

	chosen {
		zephyr,console = &uart0;
		zephyr,shell-uart = &uart0;
	};
};
