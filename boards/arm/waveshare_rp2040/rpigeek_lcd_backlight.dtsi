/*
 * Copyright (c) 2023 TiaC Systems
 * SPDX-License-Identifier: Apache-2.0
 */

#include <freq.h>
#include <zephyr/dt-bindings/gpio/gpio.h>

/ {
	lcd_backlight_en: lcd-backlight-en {
		compatible = "regulator-fixed";
		enable-gpios = <&gpio0 25 GPIO_ACTIVE_HIGH>;
		regulator-name = "lcd_backlight_enable";
		regulator-boot-on;
	};
};

&gpio0 {
	status = "okay";
};
