/*
 * Copyright (c) 2023 TiaC Systems
 * SPDX-License-Identifier: Apache-2.0
 */

/ {
	model = "Waveshare RP2040-Tiny @ UART Concole";
	compatible = "waveshare,rp2040-tiny", "waveshare,rp2040-tiny-uartcons";

	chosen {
		zephyr,console = &uart0;
		zephyr,shell-uart = &uart0;
	};
};
