/*
 * Copyright (c) 2023 TiaC Systems
 * SPDX-License-Identifier: Apache-2.0
 */

/ {
	model = "Waveshare RP2040-LCD-0.96 @ UART Concole";
	compatible = "waveshare,rp2040-lcd-0.96", "waveshare,rp2040-lcd-0.96-uartcons";

	chosen {
		zephyr,console = &uart0;
		zephyr,shell-uart = &uart0;
	};
};
