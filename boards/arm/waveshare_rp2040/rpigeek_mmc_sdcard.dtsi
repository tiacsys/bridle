/*
 * Copyright (c) 2023 TiaC Systems
 * SPDX-License-Identifier: Apache-2.0
 */

#include <freq.h>
#include <zephyr/dt-bindings/gpio/gpio.h>

&spi0 {
	status = "okay";
	pinctrl-0 = <&spi0_sdhc>;
	pinctrl-names = "default";

	clock-frequency = <DT_FREQ_M(25)>;
	cs-gpios = <&gpio0 23 GPIO_ACTIVE_LOW>;

	/* SPI as Secure Digital card Host Controller (SDHC). */
	sdhc0: sdhc@0 {
		compatible = "zephyr,sdhc-spi-slot";
		reg = <0>;
		status = "okay";

		spi-max-frequency = <DT_FREQ_M(25)>;

		/* Secure Digital card as Multi-Media Card (SDMMC) */
		mmc {
			compatible = "zephyr,sdmmc-disk";
			status = "okay";
		};
	};
};

&gpio0 {
	status = "okay";
};
