/*
 * Copyright (c) 2023 TiaC Systems
 * SPDX-License-Identifier: Apache-2.0
 */

/ {
	grove_d1_header: grove-d1-connector {
		compatible = "seeed,grove-connector";
		#gpio-cells = <2>;
		gpio-map-mask = <0xffffffff 0xffffffc0>;
		gpio-map-pass-thru = <0 0x3f>;
		gpio-map = <0 0 &gpio0 1 0>,	/* GP1/PWM1 / UART0-RX */
			   <1 0 &gpio0 0 0>;	/* GP0/PWM0 / UART0-TX */
	};
};

&gpio0 {
	status = "okay";
};

#undef GROVE_PWM_D0_SLOW
#define GROVE_PWM_D0_SLOW				\
	&pwm {						\
		divider-frac-0 = <15>;			\
		divider-int-0 = <255>;			\
	};

#undef GROVE_PWM_D0_ENABLE
#define GROVE_PWM_D0_ENABLE				\
	&pwm {						\
		status = "okay";			\
	};

#undef GROVE_PWM_D0_PINCTRL
#define GROVE_PWM_D0_PINCTRL				\
	&pwm_grove {					\
		group0 {				\
			pinmux = <PWM_0A_P0>;		\
		};					\
	};

#undef GROVE_PWM_D1_SLOW
#define GROVE_PWM_D1_SLOW				\
	&pwm {						\
		divider-frac-0 = <15>;			\
		divider-int-0 = <255>;			\
	};

#undef GROVE_PWM_D1_ENABLE
#define GROVE_PWM_D1_ENABLE				\
	&pwm {						\
		status = "okay";			\
	};

#undef GROVE_PWM_D1_PINCTRL
#define GROVE_PWM_D1_PINCTRL				\
	&pwm_grove {					\
		group1 {				\
			pinmux = <PWM_0B_P1>;		\
		};					\
	};
