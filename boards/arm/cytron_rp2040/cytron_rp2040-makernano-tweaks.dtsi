/*
 * Copyright (c) 2023 TiaC Systems
 * SPDX-License-Identifier: Apache-2.0
 */

#include <zephyr/dt-bindings/gpio/gpio.h>

&i2c0 {
	compatible = "gpio-i2c";
	sda-gpios = <&gpio0 12 (GPIO_OPEN_DRAIN | GPIO_PULL_UP)>;
	scl-gpios = <&gpio0 13 (GPIO_OPEN_DRAIN | GPIO_PULL_UP)>;
	/delete-property/ resets;
	/delete-property/ clocks;
	/delete-property/ interrupts;
	/delete-property/ interrupt-names;
	/delete-property/ pinctrl-0;
	/delete-property/ pinctrl-names;
};

&i2c1 {
	compatible = "gpio-i2c";
	sda-gpios = <&gpio0 26 (GPIO_OPEN_DRAIN | GPIO_PULL_UP)>;
	scl-gpios = <&gpio0 27 (GPIO_OPEN_DRAIN | GPIO_PULL_UP)>;
	/delete-property/ resets;
	/delete-property/ clocks;
	/delete-property/ interrupts;
	/delete-property/ interrupt-names;
	/delete-property/ pinctrl-0;
	/delete-property/ pinctrl-names;
};

&gpio0 {
	status = "okay";
};
