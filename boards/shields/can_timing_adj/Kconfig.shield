## boards/shields/can_timing_adj/Kconfig.shield
```kconfig
# Copyright (c) 2022 TiaC Systems
# SPDX-License-Identifier: Apache-2.0

# CAN timing (adjustment) shield configuration

config SHIELD_CAN_TIMING_ADJ
	def_bool $(shields_list_contains,can_timing_adj)
```

## boards/shields/cjmcu_750/Kconfig.defconfig
```kconfig
# Copyright (c) 2024 TiaC Systems
# SPDX-License-Identifier: Apache-2.0

config SPI
    default y

config I2C
    default y
```

## boards/shields/cjmcu_750/Kconfig.shield
```kconfig
# Copyright (c) 2024 TiaC Systems
# SPDX-License-Identifier: Apache-2.0

config SHIELD_CJMCU_750
	def_bool $(shields_list_contains,cjmcu_750_spi) || \
		$(shields_list_contains,cjmcu_750_i2c)

config X_ARDUINO_HEADER_TO_CJMCU_750
	def_bool $(shields_list_contains,x_arduino_header_to_cjmcu_750)
```

## boards/shields/grove/Kconfig.shield
```kconfig
# Copyright (c) 2023 TiaC Systems
# SPDX-License-Identifier: Apache-2.0

config SHIELD_SEEED_GROVE_BASE_V2
	def_bool $(shields_list_contains,seeed_grove_base_v2)

config SHIELD_SEEED_GROVE_BASE_V1
	def_bool $(shields_list_contains,seeed_grove_base_v1)

config SHIELD_SEEED_GROVE_XIAO_V1
	def_bool $(shields_list_contains,seeed_grove_xiao_v1)

config SHIELD_SEEED_GROVE_RPIPICO_V1
	def_bool $(shields_list_contains,seeed_grove_rpipico_v1)
```

## boards/shields/grove_btn_legacy/Kconfig.defconfig
```kconfig
# Copyright (c) 2023 TiaC Systems
# SPDX-License-Identifier: Apache-2.0

if SHIELD_GROVE_BTN

config GPIO
	default y

config SHIELD_GROVE_BTN_D0
	def_bool $(dt_nodelabel_enabled,grove_btn_d0)

config SHIELD_GROVE_BTN_D1
	def_bool $(dt_nodelabel_enabled,grove_btn_d1)

config SHIELD_GROVE_BTN_D2
	def_bool $(dt_nodelabel_enabled,grove_btn_d2)

config SHIELD_GROVE_BTN_D3
	def_bool $(dt_nodelabel_enabled,grove_btn_d3)

config SHIELD_GROVE_BTN_D4
	def_bool $(dt_nodelabel_enabled,grove_btn_d4)

config SHIELD_GROVE_BTN_D5
	def_bool $(dt_nodelabel_enabled,grove_btn_d5)

config SHIELD_GROVE_BTN_D6
	def_bool $(dt_nodelabel_enabled,grove_btn_d6)

config SHIELD_GROVE_BTN_D7
	def_bool $(dt_nodelabel_enabled,grove_btn_d7)

config SHIELD_GROVE_BTN_D8
	def_bool $(dt_nodelabel_enabled,grove_btn_d8)

config SHIELD_GROVE_BTN_D9
	def_bool $(dt_nodelabel_enabled,grove_btn_d9)

config SHIELD_GROVE_BTN_D10
	def_bool $(dt_nodelabel_enabled,grove_btn_d10)

config SHIELD_GROVE_BTN_D11
	def_bool $(dt_nodelabel_enabled,grove_btn_d11)

config SHIELD_GROVE_BTN_D12
	def_bool $(dt_nodelabel_enabled,grove_btn_d12)

config SHIELD_GROVE_BTN_D13
	def_bool $(dt_nodelabel_enabled,grove_btn_d13)

config SHIELD_GROVE_BTN_D14
	def_bool $(dt_nodelabel_enabled,grove_btn_d14)

config SHIELD_GROVE_BTN_D15
	def_bool $(dt_nodelabel_enabled,grove_btn_d15)

config SHIELD_GROVE_BTN_D16
	def_bool $(dt_nodelabel_enabled,grove_btn_d16)

config SHIELD_GROVE_BTN_D17
	def_bool $(dt_nodelabel_enabled,grove_btn_d17)

config SHIELD_GROVE_BTN_D18
	def_bool $(dt_nodelabel_enabled,grove_btn_d18)

config SHIELD_GROVE_BTN_D19
	def_bool $(dt_nodelabel_enabled,grove_btn_d19)

config SHIELD_GROVE_BTN_D20
	def_bool $(dt_nodelabel_enabled,grove_btn_d20)

config SHIELD_GROVE_BTN_D21
	def_bool $(dt_nodelabel_enabled,grove_btn_d21)

config SHIELD_GROVE_BTN_D22
	def_bool $(dt_nodelabel_enabled,grove_btn_d22)

config SHIELD_GROVE_BTN_D23
	def_bool $(dt_nodelabel_enabled,grove_btn_d23)

config SHIELD_GROVE_BTN_D24
	def_bool $(dt_nodelabel_enabled,grove_btn_d24)

config SHIELD_GROVE_BTN_D25
	def_bool $(dt_nodelabel_enabled,grove_btn_d25)

config SHIELD_GROVE_BTN_D26
	def_bool $(dt_nodelabel_enabled,grove_btn_d26)

config SHIELD_GROVE_BTN_D27
	def_bool $(dt_nodelabel_enabled,grove_btn_d27)

config SHIELD_GROVE_BTN_D28
	def_bool $(dt_nodelabel_enabled,grove_btn_d28)

config SHIELD_GROVE_BTN_D29
	def_bool $(dt_nodelabel_enabled,grove_btn_d29)

config SHIELD_GROVE_BTN_D30
	def_bool $(dt_nodelabel_enabled,grove_btn_d30)

config SHIELD_GROVE_BTN_D31
	def_bool $(dt_nodelabel_enabled,grove_btn_d31)

endif # SHIELD_GROVE_BTN
```

## boards/shields/grove_btn_legacy/Kconfig.shield
```kconfig
# Copyright (c) 2023 TiaC Systems
# SPDX-License-Identifier: Apache-2.0

config SHIELD_GROVE_BTN
	def_bool $(shields_list_contains,grove_btn_d0) || \
		 $(shields_list_contains,grove_btn_d0_inv) || \
		 $(shields_list_contains,grove_btn_d1) || \
		 $(shields_list_contains,grove_btn_d1_inv) || \
		 $(shields_list_contains,grove_btn_d2) || \
		 $(shields_list_contains,grove_btn_d2_inv) || \
		 $(shields_list_contains,grove_btn_d3) || \
		 $(shields_list_contains,grove_btn_d3_inv) || \
		 $(shields_list_contains,grove_btn_d4) || \
		 $(shields_list_contains,grove_btn_d4_inv) || \
		 $(shields_list_contains,grove_btn_d5) || \
		 $(shields_list_contains,grove_btn_d5_inv) || \
		 $(shields_list_contains,grove_btn_d6) || \
		 $(shields_list_contains,grove_btn_d6_inv) || \
		 $(shields_list_contains,grove_btn_d7) || \
		 $(shields_list_contains,grove_btn_d7_inv) || \
		 $(shields_list_contains,grove_btn_d8) || \
		 $(shields_list_contains,grove_btn_d8_inv) || \
		 $(shields_list_contains,grove_btn_d9) || \
		 $(shields_list_contains,grove_btn_d9_inv) || \
		 $(shields_list_contains,grove_btn_d10) || \
		 $(shields_list_contains,grove_btn_d10_inv) || \
		 $(shields_list_contains,grove_btn_d11) || \
		 $(shields_list_contains,grove_btn_d11_inv) || \
		 $(shields_list_contains,grove_btn_d12) || \
		 $(shields_list_contains,grove_btn_d12_inv) || \
		 $(shields_list_contains,grove_btn_d13) || \
		 $(shields_list_contains,grove_btn_d13_inv) || \
		 $(shields_list_contains,grove_btn_d14) || \
		 $(shields_list_contains,grove_btn_d14_inv) || \
		 $(shields_list_contains,grove_btn_d15) || \
		 $(shields_list_contains,grove_btn_d15_inv) || \
		 $(shields_list_contains,grove_btn_d16) || \
		 $(shields_list_contains,grove_btn_d16_inv) || \
		 $(shields_list_contains,grove_btn_d17) || \
		 $(shields_list_contains,grove_btn_d17_inv) || \
		 $(shields_list_contains,grove_btn_d18) || \
		 $(shields_list_contains,grove_btn_d18_inv) || \
		 $(shields_list_contains,grove_btn_d19) || \
		 $(shields_list_contains,grove_btn_d19_inv) || \
		 $(shields_list_contains,grove_btn_d20) || \
		 $(shields_list_contains,grove_btn_d20_inv) || \
		 $(shields_list_contains,grove_btn_d21) || \
		 $(shields_list_contains,grove_btn_d21_inv) || \
		 $(shields_list_contains,grove_btn_d22) || \
		 $(shields_list_contains,grove_btn_d22_inv) || \
		 $(shields_list_contains,grove_btn_d23) || \
		 $(shields_list_contains,grove_btn_d23_inv) || \
		 $(shields_list_contains,grove_btn_d24) || \
		 $(shields_list_contains,grove_btn_d24_inv) || \
		 $(shields_list_contains,grove_btn_d25) || \
		 $(shields_list_contains,grove_btn_d25_inv) || \
		 $(shields_list_contains,grove_btn_d26) || \
		 $(shields_list_contains,grove_btn_d26_inv) || \
		 $(shields_list_contains,grove_btn_d27) || \
		 $(shields_list_contains,grove_btn_d27_inv) || \
		 $(shields_list_contains,grove_btn_d28) || \
		 $(shields_list_contains,grove_btn_d28_inv) || \
		 $(shields_list_contains,grove_btn_d29) || \
		 $(shields_list_contains,grove_btn_d29_inv) || \
		 $(shields_list_contains,grove_btn_d30) || \
		 $(shields_list_contains,grove_btn_d30_inv) || \
		 $(shields_list_contains,grove_btn_d31) || \
		 $(shields_list_contains,grove_btn_d31_inv)
```

## boards/shields/grove_led_legacy/Kconfig.defconfig
```kconfig
# Copyright (c) 2023 TiaC Systems
# SPDX-License-Identifier: Apache-2.0

if SHIELD_GROVE_LED

config GPIO
	default y

config SHIELD_GROVE_LED_D0
	def_bool $(dt_nodelabel_enabled,grove_led_d0)

config SHIELD_GROVE_LED_D1
	def_bool $(dt_nodelabel_enabled,grove_led_d1)

config SHIELD_GROVE_LED_D2
	def_bool $(dt_nodelabel_enabled,grove_led_d2)

config SHIELD_GROVE_LED_D3
	def_bool $(dt_nodelabel_enabled,grove_led_d3)

config SHIELD_GROVE_LED_D4
	def_bool $(dt_nodelabel_enabled,grove_led_d4)

config SHIELD_GROVE_LED_D5
	def_bool $(dt_nodelabel_enabled,grove_led_d5)

config SHIELD_GROVE_LED_D6
	def_bool $(dt_nodelabel_enabled,grove_led_d6)

config SHIELD_GROVE_LED_D7
	def_bool $(dt_nodelabel_enabled,grove_led_d7)

config SHIELD_GROVE_LED_D8
	def_bool $(dt_nodelabel_enabled,grove_led_d8)

config SHIELD_GROVE_LED_D9
	def_bool $(dt_nodelabel_enabled,grove_led_d9)

config SHIELD_GROVE_LED_D10
	def_bool $(dt_nodelabel_enabled,grove_led_d10)

config SHIELD_GROVE_LED_D11
	def_bool $(dt_nodelabel_enabled,grove_led_d11)

config SHIELD_GROVE_LED_D12
	def_bool $(dt_nodelabel_enabled,grove_led_d12)

config SHIELD_GROVE_LED_D13
	def_bool $(dt_nodelabel_enabled,grove_led_d13)

config SHIELD_GROVE_LED_D14
	def_bool $(dt_nodelabel_enabled,grove_led_d14)

config SHIELD_GROVE_LED_D15
	def_bool $(dt_nodelabel_enabled,grove_led_d15)

config SHIELD_GROVE_LED_D16
	def_bool $(dt_nodelabel_enabled,grove_led_d16)

config SHIELD_GROVE_LED_D17
	def_bool $(dt_nodelabel_enabled,grove_led_d17)

config SHIELD_GROVE_LED_D18
	def_bool $(dt_nodelabel_enabled,grove_led_d18)

config SHIELD_GROVE_LED_D19
	def_bool $(dt_nodelabel_enabled,grove_led_d19)

config SHIELD_GROVE_LED_D20
	def_bool $(dt_nodelabel_enabled,grove_led_d20)

config SHIELD_GROVE_LED_D21
	def_bool $(dt_nodelabel_enabled,grove_led_d21)

config SHIELD_GROVE_LED_D22
	def_bool $(dt_nodelabel_enabled,grove_led_d22)

config SHIELD_GROVE_LED_D23
	def_bool $(dt_nodelabel_enabled,grove_led_d23)

config SHIELD_GROVE_LED_D24
	def_bool $(dt_nodelabel_enabled,grove_led_d24)

config SHIELD_GROVE_LED_D25
	def_bool $(dt_nodelabel_enabled,grove_led_d25)

config SHIELD_GROVE_LED_D26
	def_bool $(dt_nodelabel_enabled,grove_led_d26)

config SHIELD_GROVE_LED_D27
	def_bool $(dt_nodelabel_enabled,grove_led_d27)

config SHIELD_GROVE_LED_D28
	def_bool $(dt_nodelabel_enabled,grove_led_d28)

config SHIELD_GROVE_LED_D29
	def_bool $(dt_nodelabel_enabled,grove_led_d29)

config SHIELD_GROVE_LED_D30
	def_bool $(dt_nodelabel_enabled,grove_led_d30)

config SHIELD_GROVE_LED_D31
	def_bool $(dt_nodelabel_enabled,grove_led_d31)

endif # SHIELD_GROVE_LED

if SHIELD_GROVE_PWM_LED

config PWM
	default y

config SHIELD_GROVE_PWM_LED_D0
	def_bool $(dt_nodelabel_enabled,grove_pwm_led_d0)

config SHIELD_GROVE_PWM_LED_D1
	def_bool $(dt_nodelabel_enabled,grove_pwm_led_d1)

config SHIELD_GROVE_PWM_LED_D2
	def_bool $(dt_nodelabel_enabled,grove_pwm_led_d2)

config SHIELD_GROVE_PWM_LED_D3
	def_bool $(dt_nodelabel_enabled,grove_pwm_led_d3)

config SHIELD_GROVE_PWM_LED_D4
	def_bool $(dt_nodelabel_enabled,grove_pwm_led_d4)

config SHIELD_GROVE_PWM_LED_D5
	def_bool $(dt_nodelabel_enabled,grove_pwm_led_d5)

config SHIELD_GROVE_PWM_LED_D6
	def_bool $(dt_nodelabel_enabled,grove_pwm_led_d6)

config SHIELD_GROVE_PWM_LED_D7
	def_bool $(dt_nodelabel_enabled,grove_pwm_led_d7)

config SHIELD_GROVE_PWM_LED_D8
	def_bool $(dt_nodelabel_enabled,grove_pwm_led_d8)

config SHIELD_GROVE_PWM_LED_D9
	def_bool $(dt_nodelabel_enabled,grove_pwm_led_d9)

config SHIELD_GROVE_PWM_LED_D10
	def_bool $(dt_nodelabel_enabled,grove_pwm_led_d10)

config SHIELD_GROVE_PWM_LED_D11
	def_bool $(dt_nodelabel_enabled,grove_pwm_led_d11)

config SHIELD_GROVE_PWM_LED_D12
	def_bool $(dt_nodelabel_enabled,grove_pwm_led_d12)

config SHIELD_GROVE_PWM_LED_D13
	def_bool $(dt_nodelabel_enabled,grove_pwm_led_d13)

config SHIELD_GROVE_PWM_LED_D14
	def_bool $(dt_nodelabel_enabled,grove_pwm_led_d14)

config SHIELD_GROVE_PWM_LED_D15
	def_bool $(dt_nodelabel_enabled,grove_pwm_led_d15)

config SHIELD_GROVE_PWM_LED_D16
	def_bool $(dt_nodelabel_enabled,grove_pwm_led_d16)

config SHIELD_GROVE_PWM_LED_D17
	def_bool $(dt_nodelabel_enabled,grove_pwm_led_d17)

config SHIELD_GROVE_PWM_LED_D18
	def_bool $(dt_nodelabel_enabled,grove_pwm_led_d18)

config SHIELD_GROVE_PWM_LED_D19
	def_bool $(dt_nodelabel_enabled,grove_pwm_led_d19)

config SHIELD_GROVE_PWM_LED_D20
	def_bool $(dt_nodelabel_enabled,grove_pwm_led_d20)

config SHIELD_GROVE_PWM_LED_D21
	def_bool $(dt_nodelabel_enabled,grove_pwm_led_d21)

config SHIELD_GROVE_PWM_LED_D22
	def_bool $(dt_nodelabel_enabled,grove_pwm_led_d22)

config SHIELD_GROVE_PWM_LED_D23
	def_bool $(dt_nodelabel_enabled,grove_pwm_led_d23)

config SHIELD_GROVE_PWM_LED_D24
	def_bool $(dt_nodelabel_enabled,grove_pwm_led_d24)

config SHIELD_GROVE_PWM_LED_D25
	def_bool $(dt_nodelabel_enabled,grove_pwm_led_d25)

config SHIELD_GROVE_PWM_LED_D26
	def_bool $(dt_nodelabel_enabled,grove_pwm_led_d26)

config SHIELD_GROVE_PWM_LED_D27
	def_bool $(dt_nodelabel_enabled,grove_pwm_led_d27)

config SHIELD_GROVE_PWM_LED_D28
	def_bool $(dt_nodelabel_enabled,grove_pwm_led_d28)

config SHIELD_GROVE_PWM_LED_D29
	def_bool $(dt_nodelabel_enabled,grove_pwm_led_d29)

config SHIELD_GROVE_PWM_LED_D30
	def_bool $(dt_nodelabel_enabled,grove_pwm_led_d30)

config SHIELD_GROVE_PWM_LED_D31
	def_bool $(dt_nodelabel_enabled,grove_pwm_led_d31)

endif # SHIELD_GROVE_PWM_LED
```

## boards/shields/grove_led_legacy/Kconfig.shield
```kconfig
# Copyright (c) 2023 TiaC Systems
# SPDX-License-Identifier: Apache-2.0

config SHIELD_GROVE_LED
	def_bool $(shields_list_contains,grove_led_d0) || \
		 $(shields_list_contains,grove_led_d1) || \
		 $(shields_list_contains,grove_led_d2) || \
		 $(shields_list_contains,grove_led_d3) || \
		 $(shields_list_contains,grove_led_d4) || \
		 $(shields_list_contains,grove_led_d5) || \
		 $(shields_list_contains,grove_led_d6) || \
		 $(shields_list_contains,grove_led_d7) || \
		 $(shields_list_contains,grove_led_d8) || \
		 $(shields_list_contains,grove_led_d9) || \
		 $(shields_list_contains,grove_led_d10) || \
		 $(shields_list_contains,grove_led_d11) || \
		 $(shields_list_contains,grove_led_d12) || \
		 $(shields_list_contains,grove_led_d13) || \
		 $(shields_list_contains,grove_led_d14) || \
		 $(shields_list_contains,grove_led_d15) || \
		 $(shields_list_contains,grove_led_d16) || \
		 $(shields_list_contains,grove_led_d17) || \
		 $(shields_list_contains,grove_led_d18) || \
		 $(shields_list_contains,grove_led_d19) || \
		 $(shields_list_contains,grove_led_d20) || \
		 $(shields_list_contains,grove_led_d21) || \
		 $(shields_list_contains,grove_led_d22) || \
		 $(shields_list_contains,grove_led_d23) || \
		 $(shields_list_contains,grove_led_d24) || \
		 $(shields_list_contains,grove_led_d25) || \
		 $(shields_list_contains,grove_led_d26) || \
		 $(shields_list_contains,grove_led_d27) || \
		 $(shields_list_contains,grove_led_d28) || \
		 $(shields_list_contains,grove_led_d29) || \
		 $(shields_list_contains,grove_led_d30) || \
		 $(shields_list_contains,grove_led_d31)

config SHIELD_GROVE_PWM_LED
	def_bool $(shields_list_contains,grove_pwm_led_d0) || \
		 $(shields_list_contains,grove_pwm_led_d1) || \
		 $(shields_list_contains,grove_pwm_led_d2) || \
		 $(shields_list_contains,grove_pwm_led_d3) || \
		 $(shields_list_contains,grove_pwm_led_d4) || \
		 $(shields_list_contains,grove_pwm_led_d5) || \
		 $(shields_list_contains,grove_pwm_led_d6) || \
		 $(shields_list_contains,grove_pwm_led_d7) || \
		 $(shields_list_contains,grove_pwm_led_d8) || \
		 $(shields_list_contains,grove_pwm_led_d9) || \
		 $(shields_list_contains,grove_pwm_led_d10) || \
		 $(shields_list_contains,grove_pwm_led_d11) || \
		 $(shields_list_contains,grove_pwm_led_d12) || \
		 $(shields_list_contains,grove_pwm_led_d13) || \
		 $(shields_list_contains,grove_pwm_led_d14) || \
		 $(shields_list_contains,grove_pwm_led_d15) || \
		 $(shields_list_contains,grove_pwm_led_d16) || \
		 $(shields_list_contains,grove_pwm_led_d17) || \
		 $(shields_list_contains,grove_pwm_led_d18) || \
		 $(shields_list_contains,grove_pwm_led_d19) || \
		 $(shields_list_contains,grove_pwm_led_d20) || \
		 $(shields_list_contains,grove_pwm_led_d21) || \
		 $(shields_list_contains,grove_pwm_led_d22) || \
		 $(shields_list_contains,grove_pwm_led_d23) || \
		 $(shields_list_contains,grove_pwm_led_d24) || \
		 $(shields_list_contains,grove_pwm_led_d25) || \
		 $(shields_list_contains,grove_pwm_led_d26) || \
		 $(shields_list_contains,grove_pwm_led_d27) || \
		 $(shields_list_contains,grove_pwm_led_d28) || \
		 $(shields_list_contains,grove_pwm_led_d29) || \
		 $(shields_list_contains,grove_pwm_led_d30) || \
		 $(shields_list_contains,grove_pwm_led_d31)
```
