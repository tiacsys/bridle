## boards/shields/grove_sens/Kconfig.defconfig
```kconfig
# Copyright (c) 2024 TiaC Systems
# SPDX-License-Identifier: Apache-2.0

if SHIELD_GROVE_SENS

config I2C
	default y

config SHIELD_GROVE_SENS_BME280
	def_bool $(dt_nodelabel_enabled,grove_sens_bme280)

config SHIELD_GROVE_SENS_BMP280
	def_bool $(dt_nodelabel_enabled,grove_sens_bmp280)

config SHIELD_GROVE_SENS_DPS310
	def_bool $(dt_nodelabel_enabled,grove_sens_dps310)

endif # SHIELD_GROVE_SENS
```

## boards/shields/grove_sens/Kconfig.shield
```kconfig
# Copyright (c) 2024 TiaC Systems
# SPDX-License-Identifier: Apache-2.0

config SHIELD_GROVE_SENS
	def_bool $(shields_list_contains,grove_sens_bme280) || \
		 $(shields_list_contains,grove_sens_bmp280) || \
		 $(shields_list_contains,grove_sens_dps310)
```

## boards/shields/loopback_test/Kconfig.defconfig
```kconfig
# Copyright (c) 2021 Li-Pro.Net
# SPDX-License-Identifier: Apache-2.0

if SHIELD_LOOPBACK_TEST || \
   SHIELD_LOOPBACK_TEST_TMPH

menu "Loopback Test Shield"

# workaround to be configurable with different test cases
orsource "tests/*.defconfig"

# board specific options
orsource "boards/*.defconfig"

endmenu # Loopback Test Shield

endif # SHIELD_LOOPBACK_TEST || \
      # SHIELD_LOOPBACK_TEST_TMPH
```

## boards/shields/loopback_test/Kconfig.shield
```kconfig
# Copyright (c) 2021 Li-Pro.Net
# SPDX-License-Identifier: Apache-2.0

# Loopback test shield configuration

config SHIELD_LOOPBACK_TEST
	def_bool $(shields_list_contains,loopback_test)

config SHIELD_LOOPBACK_TEST_TMPH
	def_bool $(shields_list_contains,loopback_test_tmph)
```

## boards/shields/loopback_test/boards/magpie_f777ni.conf
```kconfig
# Copyright (c) 2021-2026 TiaC Systems
# Copyright (c) 2021 Li-Pro.Net
# SPDX-License-Identifier: Apache-2.0

# Loopback test shield configuration for
# TiaC Magpie F777NI board

CONFIG_SPI_LOOPBACK_MODE_LOOP=n
CONFIG_SPI_STM32_DMA=n
CONFIG_SPI_STM32_INTERRUPT=y

CONFIG_I2C_STM32_INTERRUPT=y
```

## boards/shields/loopback_test/boards/tiac_magpie.conf
```kconfig
# Copyright (c) 2021 TiaC Systems
# Copyright (c) 2021 Li-Pro.Net
# SPDX-License-Identifier: Apache-2.0

# Loopback test shield configuration for
# TiaC STM32F777NIHx Magpie board

CONFIG_SPI_LOOPBACK_MODE_LOOP=n
CONFIG_SPI_STM32_USE_HW_SS=y
CONFIG_SPI_STM32_DMA=n
CONFIG_SPI_STM32_INTERRUPT=y

CONFIG_I2C_VIRTUAL=n
CONFIG_APP_DUAL_ROLE_I2C=n
CONFIG_I2C_STM32_INTERRUPT=y
```

## boards/shields/mikroe_led_matrix_click/Kconfig.shield
```kconfig
# SPDX-FileCopyrightText: Copyright (c) 2026 Navimatix GmbH
# SPDX-FileCopyrightText: Copyright (c) 2026 TiaC Systems
# SPDX-License-Identifier: Apache-2.0

config SHIELD_MIKROE_4X4_RGB_CLICK
	def_bool $(shields_list_contains,mikroe_4x4_rgb_click)
```

## boards/shields/nxp_sc18is604_evb/Kconfig.defconfig
```kconfig
# Copyright (c) 2024 TiaC Systems
# SPDX-License-Identifier: Apache-2.0

config MFD
	default y
	depends on SHIELD_NXP_SC18IS604_EVB

config SPI
	default y
	depends on SHIELD_NXP_SC18IS604_EVB

config I2C
	default y if DT_HAS_NXP_SC18IS604_I2C_ENABLED
	depends on SHIELD_NXP_SC18IS604_EVB

config GPIO
	default y if DT_HAS_NXP_SC18IS604_GPIO_ENABLED
	depends on SHIELD_NXP_SC18IS604_EVB

config DYNAMIC_THREAD_POOL_SIZE
	default 1 if MFD_SC18IS604_ASYNC && !DYNAMIC_THREAD_ALLOC
	depends on SHIELD_NXP_SC18IS604_EVB && MFD_SC18IS604

# observation: set to half size to avoid "Verify failed" error
config EEPROM_SHELL_BUFFER_SIZE
	default 128 if DT_HAS_NXP_SC18IS604_I2C_ENABLED
	depends on SHIELD_NXP_SC18IS604_EVB && EEPROM_SHELL
```

## boards/shields/nxp_sc18is604_evb/Kconfig.shield
```kconfig
# Copyright (c) 2024 TiaC Systems
# SPDX-License-Identifier: Apache-2.0

config SHIELD_NXP_SC18IS604_EVB
	def_bool $(shields_list_contains,nxp_sc18is604_evb)

config X_ARDUINO_HEADER_TO_NXP_SC18IS604_EVB
	def_bool $(shields_list_contains,x_arduino_header_to_nxp_sc18is604_evb)
	
```

## boards/shields/rpi_pico_bb/Kconfig.shield
```kconfig
# Copyright (c) 2024 TiaC Systems
# SPDX-License-Identifier: Apache-2.0

config SHIELD_GEEEKPI_PICO_BB_PLUS
	def_bool $(shields_list_contains,geeekpi_pico_bb_plus)
```

## boards/shields/rpi_pico_clock/Kconfig.defconfig
```kconfig
# Copyright (c) 2023-2025 TiaC Systems
# SPDX-License-Identifier: Apache-2.0

config SHIELD_RPI_PICO_CLOCK
	bool
	default y if SHIELD_WAVESHARE_PICO_CLOCK_GREEN
	default n

config SHIELD_RPI_PICO_CLOCK_HIYOU
	bool
	default y if SHIELD_WAVESHARE_PICO_CLOCK_GREEN
	default n

config RTC_ALARM
	default y if DT_HAS_MAXIM_DS3231_RTC_ENABLED
	depends on RTC

config RTC_UPDATE
	default y if DT_HAS_MAXIM_DS3231_RTC_ENABLED
	depends on RTC

config SPI
	default y if DT_HAS_SIPO_MUX_GP_SPI_ENABLED
	depends on SHIELD_RPI_PICO_CLOCK

config GPIO_HOGS
	default y if DT_HAS_SIPO_MUX_GPIO_ENABLED
	depends on SHIELD_RPI_PICO_CLOCK_HIYOU && GPIO

config GPIO_HOGS_INIT_PRIORITY
	default 85 if DT_HAS_SIPO_MUX_GPIO_ENABLED
	depends on SHIELD_RPI_PICO_CLOCK_HIYOU && GPIO_HOGS
```
