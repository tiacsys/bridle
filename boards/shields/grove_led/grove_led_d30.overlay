/*
 * Copyright (c) 2023 TiaC Systems
 * SPDX-License-Identifier: Apache-2.0
 */

#include <zephyr/dt-bindings/gpio/gpio.h>

/ {
	grove_leds {
		status = "okay";

		compatible = "gpio-leds";

		grove_led_d30: grove-led-d30 {
			label = "Grove LED D30";
			gpios = <&grove_gpios 30 (GPIO_ACTIVE_HIGH)>;
		};
	};
};
