/*
 * Copyright (c) 2023 TiaC Systems
 * SPDX-License-Identifier: Apache-2.0
 */

#include <zephyr/dt-bindings/gpio/gpio.h>

/ {
	grove_leds {
		status = "okay";

		compatible = "gpio-leds";

		grove_led_d13: grove-led-d13 {
			label = "Grove LED D13";
			gpios = <&grove_gpios 13 (GPIO_ACTIVE_HIGH)>;
		};
	};
};
