/*
 * Copyright (c) 2023 TiaC Systems
 * SPDX-License-Identifier: Apache-2.0
 */

#include <zephyr/dt-bindings/gpio/gpio.h>

/ {
	grove_leds {
		status = "okay";

		compatible = "gpio-leds";

		grove_led_d19: grove-led-d19 {
			label = "Grove LED D19";
			gpios = <&grove_gpios 19 (GPIO_ACTIVE_HIGH)>;
		};
	};
};
