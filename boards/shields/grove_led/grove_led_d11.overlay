/*
 * Copyright (c) 2023 TiaC Systems
 * SPDX-License-Identifier: Apache-2.0
 */

#include <zephyr/dt-bindings/gpio/gpio.h>

/ {
	grove_leds {
		status = "okay";

		compatible = "gpio-leds";

		grove_led_d11: grove-led-d11 {
			label = "Grove LED D11";
			gpios = <&grove_gpios 11 (GPIO_ACTIVE_HIGH)>;
		};
	};
};
