/*
 * Copyright (c) 2023 TiaC Systems
 * SPDX-License-Identifier: Apache-2.0
 */

#include <zephyr/dt-bindings/pwm/pwm.h>

GROVE_PWMS_SETUP_AND_ENABLE(D5,SLOW)

/ {
	grove_pwm_leds {
		status = "okay";

		compatible = "pwm-leds";

		grove_pwm_led_d5: grove-pwm-led-d5 {
			label = "Grove LED D5";
			pwms = <&grove_pwms 5 PWM_MSEC(20) (PWM_POLARITY_NORMAL)>;
		};
	};
};
