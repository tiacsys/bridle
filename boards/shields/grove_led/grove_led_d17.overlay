/*
 * Copyright (c) 2023 TiaC Systems
 * SPDX-License-Identifier: Apache-2.0
 */

#include <zephyr/dt-bindings/gpio/gpio.h>

/ {
	grove_leds {
		status = "okay";

		compatible = "gpio-leds";

		grove_led_d17: grove-led-d17 {
			label = "Grove LED D17";
			gpios = <&grove_gpios 17 (GPIO_ACTIVE_HIGH)>;
		};
	};
};
