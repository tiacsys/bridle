/*
 * Copyright (c) 2024 TiaC Systems
 * SPDX-License-Identifier: Apache-2.0
 */


&cjmcu_750_spi_in {

    sc16is750: sc16is750@0 {
        
        status = "okay";
        compatible = "nxp,sc16is75x";

        reg = < 0 >;
        spi-max-frequency = < 4000000 >;
    };
};

#include "cjmcu_750_common.dtsi"
