/*
 * SPDX-FileCopyrightText: Copyright (c) 2024-2026 TiaC Systems
 * SPDX-License-Identifier: Apache-2.0
 */

/ {
	chosen {
		zephyr,display = &led_strip_matrix;
	};

	aliases {
		led-strip = &led_strip;
	};
};
