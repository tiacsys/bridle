/*
 * SPDX-FileCopyrightText: Copyright (c) 2024-2026 TiaC Systems
 * SPDX-License-Identifier: Apache-2.0
 */

#include "rpipico_r3-connect.dtsi"

#include "led_matrix.dtsi"

#include <zephyr/dt-bindings/gpio/gpio.h>

#include <zephyr/dt-bindings/gpio/raspberrypi-pico-header-r3.h>

&led_strip_matrix {
	status = "okay";
};

&led_strip {
	status = "okay";
	gpios = <&rpipico_header RPIPICO_HEADER_R3_D6 GPIO_ACTIVE_HIGH>; /* PIO0:OUT @ GP6 */
};

&pio_led_strip {
	status = "okay";
};

&rpipico_pio {
	status = "okay";
};
