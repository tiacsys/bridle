/*
 * SPDX-FileCopyrightText: Copyright (c) 2024-2026 TiaC Systems
 * SPDX-License-Identifier: Apache-2.0
 */

&pinctrl {
	pio0_ws2812_leds: pio0_ws2812_leds {
		group6_pio {
			pinmux = <PIO0_P6>; /* GP6: PIO0 */
		};
	};
};
