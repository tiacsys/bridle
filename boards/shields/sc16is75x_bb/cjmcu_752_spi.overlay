/*
 * SPDX-FileCopyrightText: Copyright (c) 2024-2026 TiaC Systems
 * SPDX-License-Identifier: Apache-2.0
 */

#include "cjmcu_752_spi_noirq.overlay"

#include <zephyr/dt-bindings/gpio/cjmcu-75x-hif-header.h>

&cjmcu_75x {
	interrupt-gpios = <&cjmcu_hif_spi CJMCU_75X_HIF_HEADER_IRQ
				(GPIO_PULL_UP | GPIO_ACTIVE_LOW)>;
};
