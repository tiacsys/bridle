/*
 * Copyright (c) 2024 TiaC Systems
 * SPDX-License-Identifier: Apache-2.0
 */

#include "cjmcu_750_i2c_noirq.overlay"

&cjmcu_75x {
	interrupt-gpios = <&cjmcu_hif_i2c 3 (GPIO_PULL_UP | GPIO_ACTIVE_LOW)>;
};
