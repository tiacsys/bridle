/*
 * Copyright (c) 2024-2026 TiaC Systems
 * SPDX-License-Identifier: Apache-2.0
 */

#include <zephyr/dt-bindings/input/input-event-codes.h>
#include <zephyr/dt-bindings/gpio/gpio.h>

/ {
	grove_btns {
		status = "okay";

		compatible = "gpio-keys";

		grove_btn_d25: grove-btn-d25-inv {
			label = "Grove Button D25 (inverted)";
			zephyr,code = <INPUT_KEY_P>;
			gpios = <&grove_gpios 25 (GPIO_PULL_DOWN | GPIO_ACTIVE_LOW)>;
		};
	};
};
