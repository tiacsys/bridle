/*
 * Copyright (c) 2024 TiaC Systems
 * SPDX-License-Identifier: Apache-2.0
 */

#include <zephyr/dt-bindings/gpio/gpio.h>

/ {
	grove_btns {
		status = "okay";

		compatible = "gpio-keys";

		grove_btn_d4: grove-btn-d4-inv {
			label = "Grove Button D4 (inverted)";
			gpios = <&grove_gpios 4 (GPIO_PULL_DOWN | GPIO_ACTIVE_LOW)>;
		};
	};
};
