/*
 * Copyright (c) 2023 TiaC Systems
 * SPDX-License-Identifier: Apache-2.0
 */

#include <zephyr/dt-bindings/gpio/gpio.h>

/ {
	grove_btns {
		status = "okay";

		compatible = "gpio-keys";

		grove_btn_d8: grove-btn-d8 {
			label = "Grove Button D8";
			gpios = <&grove_gpios 8 (GPIO_PULL_DOWN | GPIO_ACTIVE_HIGH)>;
		};
	};
};
