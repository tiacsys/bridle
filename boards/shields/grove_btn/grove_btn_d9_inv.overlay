/*
 * Copyright (c) 2024 TiaC Systems
 * SPDX-License-Identifier: Apache-2.0
 */

#include <zephyr/dt-bindings/gpio/gpio.h>

/ {
	grove_btns {
		status = "okay";

		compatible = "gpio-keys";

		grove_btn_d9: grove-btn-d9-inv {
			label = "Grove Button D9 (inverted)";
			gpios = <&grove_gpios 9 (GPIO_PULL_DOWN | GPIO_ACTIVE_LOW)>;
		};
	};
};
