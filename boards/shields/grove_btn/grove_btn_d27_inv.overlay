/*
 * Copyright (c) 2024 TiaC Systems
 * SPDX-License-Identifier: Apache-2.0
 */

#include <zephyr/dt-bindings/gpio/gpio.h>

/ {
	grove_btns {
		status = "okay";

		compatible = "gpio-keys";

		grove_btn_d27: grove-btn-d27-inv {
			label = "Grove Button D27 (inverted)";
			gpios = <&grove_gpios 27 (GPIO_PULL_DOWN | GPIO_ACTIVE_LOW)>;
		};
	};
};
