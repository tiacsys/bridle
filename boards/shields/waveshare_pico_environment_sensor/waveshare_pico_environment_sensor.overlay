/*
 * Copyright (c) 2024 TiaC Systems
 * SPDX-License-Identifier: Apache-2.0
 */

#include <zephyr/sensing/sensing_sensor_types.h>

/ {
	wspes_sensing: wspes-sensing {
		compatible = "zephyr,sensing";
		status = "disabled";

		wspes_accel: wspes-accel {
			compatible = "zephyr,sensing-phy-3d-sensor";
			status = "disabled";
			sensor-types = <SENSING_SENSOR_TYPE_MOTION_ACCELEROMETER_3D
					SENSING_SENSOR_TYPE_MOTION_GYROMETER_3D
					SENSING_SENSOR_TYPE_MOTION_MOTION_DETECTOR>;
			friendly-name = "WSP Environment Shield Accelerometer";
			minimal-interval = <625>;
			underlying-device = <&wspes_sens_dof>;
		};
	};
};
