/*
 * Copyright (c) 2024 TiaC Systems
 * SPDX-License-Identifier: Apache-2.0
 */

#include <zephyr/dt-bindings/gpio/gpio.h>

&rpipico_i2c0 {
	compatible = "gpio-i2c";	/* I2C0_SDA_P20 and I2C0_SCL_P21 */
	sda-gpios = <&rpipico_header 20 (GPIO_OPEN_DRAIN | GPIO_PULL_UP)>;
	scl-gpios = <&rpipico_header 21 (GPIO_OPEN_DRAIN | GPIO_PULL_UP)>;
	/delete-property/ resets;
	/delete-property/ clocks;
	/delete-property/ interrupts;
	/delete-property/ interrupt-names;
	/delete-property/ pinctrl-0;
	/delete-property/ pinctrl-names;
};

&gpio0 {
	status = "okay";
};
