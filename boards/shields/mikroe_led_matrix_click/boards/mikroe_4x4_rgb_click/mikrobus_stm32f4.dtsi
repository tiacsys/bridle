/*
 * SPDX-FileCopyrightText: Copyright (c) 2026 Navimatix GmbH
 * SPDX-FileCopyrightText: Copyright (c) 2026 TiaC Systems
 * SPDX-License-Identifier: Apache-2.0
 */

rgb_led_chain: &mikrobus_stm32f4_leds {};

#include "led_matrix.dtsi"

&led_strip_matrix {
	status = "okay";
};

&led_strip {
	status = "okay";
};
