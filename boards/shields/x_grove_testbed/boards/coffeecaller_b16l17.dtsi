/*
 * Copyright (c) 2025 TiaC Systems
 * SPDX-License-Identifier: Apache-2.0
 */

/ {
	aliases {
		/* not yet: pwm-led0 = &grove_pwm_led_d17; */
		led0 = &grove_led_d17;
		sw0 = &grove_btn_d16;
	};
};
