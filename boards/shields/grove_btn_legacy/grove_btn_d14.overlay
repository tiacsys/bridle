/*
 * SPDX-FileCopyrightText: Copyright (c) 2023-2026 TiaC Systems
 * SPDX-License-Identifier: Apache-2.0
 */

#include <zephyr/dt-bindings/input/input-event-codes.h>
#include <zephyr/dt-bindings/gpio/gpio.h>
#include <zephyr/dt-bindings/gpio/grove-laced-if.h>

/ {
	grove_btns {
		compatible = "gpio-keys";

		grove_btn_d14: grove-btn-d14 {
			label = "Grove Button D14";
			zephyr,code = <INPUT_KEY_E>;
			gpios = <&grove_gpios GROVE_LIF_L14 (GPIO_PULL_DOWN | GPIO_ACTIVE_HIGH)>;
		};
	};
};
