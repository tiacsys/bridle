/*
 * Copyright (c) 2024-2026 TiaC Systems
 * SPDX-License-Identifier: Apache-2.0
 */

#include <zephyr/dt-bindings/gpio/gpio.h>
#include <zephyr/dt-bindings/input/input-event-codes.h>

/ {
	grove_btns {
		status = "okay";

		compatible = "gpio-keys";

		grove_btn_d18: grove-btn-d18-inv {
			label = "Grove Button D18 (inverted)";
			zephyr,code = <INPUT_KEY_I>;
			gpios = <&grove_gpios 18 (GPIO_PULL_DOWN | GPIO_ACTIVE_LOW)>;
		};
	};
};
