/*
 * SPDX-FileCopyrightText: Copyright (c) 2024-2026 TiaC Systems
 * SPDX-License-Identifier: Apache-2.0
 */

#include <zephyr/dt-bindings/input/input-event-codes.h>
#include <zephyr/dt-bindings/gpio/gpio.h>
#include <zephyr/dt-bindings/gpio/grove-laced-if.h>

/ {
	grove_btns {
		compatible = "gpio-keys";

		grove_btn_d31: grove-btn-d31-inv {
			label = "Grove Button D31 (inverted)";
			zephyr,code = <INPUT_KEY_V>;
			gpios = <&grove_gpios GROVE_LIF_L31 (GPIO_PULL_DOWN | GPIO_ACTIVE_LOW)>;
		};
	};
};
