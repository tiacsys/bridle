/*
 * SPDX-FileCopyrightText: Copyright (c) 2023-2026 TiaC Systems
 * SPDX-License-Identifier: Apache-2.0
 */

#include <zephyr/dt-bindings/input/input-event-codes.h>
#include <zephyr/dt-bindings/gpio/gpio.h>
#include <zephyr/dt-bindings/gpio/grove-laced-if.h>

/ {
	grove_btns {
		compatible = "gpio-keys";

		grove_btn_d26: grove-btn-d26 {
			label = "Grove Button D26";
			zephyr,code = <INPUT_KEY_Q>;
			gpios = <&grove_gpios GROVE_LIF_L26 (GPIO_PULL_DOWN | GPIO_ACTIVE_HIGH)>;
		};
	};
};
