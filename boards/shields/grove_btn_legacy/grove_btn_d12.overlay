/*
 * Copyright (c) 2023-2026 TiaC Systems
 * SPDX-License-Identifier: Apache-2.0
 */

#include <zephyr/dt-bindings/input/input-event-codes.h>
#include <zephyr/dt-bindings/gpio/gpio.h>

/ {
	grove_btns {
		status = "okay";

		compatible = "gpio-keys";

		grove_btn_d12: grove-btn-d12 {
			label = "Grove Button D12";
			zephyr,code = <INPUT_KEY_C>;
			gpios = <&grove_gpios 12 (GPIO_PULL_DOWN | GPIO_ACTIVE_HIGH)>;
		};
	};
};
