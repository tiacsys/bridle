/*
 * SPDX-FileCopyrightText: Copyright (c) 2023-2026 TiaC Systems
 * SPDX-License-Identifier: Apache-2.0
 */

#include <zephyr/dt-bindings/input/input-event-codes.h>
#include <zephyr/dt-bindings/gpio/gpio.h>
#include <zephyr/dt-bindings/gpio/grove-laced-if.h>

/ {
	grove_btns {
		compatible = "gpio-keys";

		grove_btn_d18: grove-btn-d18 {
			label = "Grove Button D18";
			zephyr,code = <INPUT_KEY_I>;
			gpios = <&grove_gpios GROVE_LIF_L18 (GPIO_PULL_DOWN | GPIO_ACTIVE_HIGH)>;
		};
	};
};
