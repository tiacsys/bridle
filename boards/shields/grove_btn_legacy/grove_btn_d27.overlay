/*
 * Copyright (c) 2023-2026 TiaC Systems
 * SPDX-License-Identifier: Apache-2.0
 */

#include <zephyr/dt-bindings/input/input-event-codes.h>
#include <zephyr/dt-bindings/gpio/gpio.h>

/ {
	grove_btns {
		status = "okay";

		compatible = "gpio-keys";

		grove_btn_d27: grove-btn-d27 {
			label = "Grove Button D27";
			zephyr,code = <INPUT_KEY_R>;
			gpios = <&grove_gpios 27 (GPIO_PULL_DOWN | GPIO_ACTIVE_HIGH)>;
		};
	};
};
