/*
 * SPDX-FileCopyrightText: Copyright (c) 2023-2026 TiaC Systems
 * SPDX-License-Identifier: Apache-2.0
 */

#include <zephyr/dt-bindings/input/input-event-codes.h>
#include <zephyr/dt-bindings/gpio/gpio.h>
#include <zephyr/dt-bindings/gpio/grove-laced-if.h>

/ {
	grove_btns {
		compatible = "gpio-keys";

		grove_btn_d21: grove-btn-d21 {
			label = "Grove Button D21";
			zephyr,code = <INPUT_KEY_L>;
			gpios = <&grove_gpios GROVE_LIF_L21 (GPIO_PULL_DOWN | GPIO_ACTIVE_HIGH)>;
		};
	};
};
