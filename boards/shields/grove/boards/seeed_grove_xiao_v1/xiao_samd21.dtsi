/*
 * SPDX-FileCopyrightText: Copyright (c) 2023-2026 TiaC Systems
 * SPDX-License-Identifier: Apache-2.0
 */

#include <zephyr/dt-bindings/gpio/grove-laced-if.h>

/ {
	grove_laced_if_v1: grove-laced-if-v1 {
		compatible = "seeed,grove-laced-if";

		#pwm-cells = <2>;
		pwm-map-mask = <0xffffffff 0>;
		pwm-map-pass-thru = <0 0xffffffff>;
		pwm-map =
			/*  0 - D0: not possible */
			<GROVE_LIF_L1 0 &tcc0 0 0>,  /* D1: TCC0CH0 (WO0) & D4 */
			<GROVE_LIF_L2 0 &tcc0 2 0>,  /* D2: TCC0CH2 (WO2) */
			<GROVE_LIF_L3 0 &tcc0 3 0>,  /* D3: TCC0CH3 (WO3) */
			<GROVE_LIF_L4 0 &tcc0 0 0>,  /* D4: TCC0CH0 (WO0) & D1 */
			<GROVE_LIF_L5 0 &tcc0 1 0>,  /* D5: TCC0CH1 (WO1) & D9 */
			/*  6 - D6: not possible */
			/*  7 - D7: not possible */
			<GROVE_LIF_L8 0 &tcc1 1 0>,  /* D8: TCC1CH1 (WO1) */
			<GROVE_LIF_L9 0 &tcc0 1 0>,  /* D9: TCC0CH1 (WO1) & D5 */
			<GROVE_LIF_L10 0 &tcc1 0 0>; /* D10: TCC1CH0 (WO0) */
	};
};

grove_pwms: &grove_laced_if_v1 {};

grove_pwm_d1: &tcc0 {};
grove_pwm_d2: &tcc0 {};
grove_pwm_d3: &tcc0 {};
grove_pwm_d4: &tcc0 {};
grove_pwm_d5: &tcc0 {};
grove_pwm_d8: &tcc1 {};
grove_pwm_d9: &tcc0 {};
grove_pwm_d10: &tcc1 {};
