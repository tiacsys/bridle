/*
 * Copyright (c) 2026 TiaC Systems
 * SPDX-License-Identifier: Apache-2.0
 */


/ {
	grove_laced_if_v1: grove-laced-if-v1 {

		compatible = "seeed,grove-laced-if";

		#pwm-cells = <3>;
		pwm-map-mask = <0xffffffff 0 0xffffffc0>;
		pwm-map-pass-thru = <0 0xffffffff 0x3f>;
		pwm-map =
			<0 0 0 &pwm 10 0 0>,	/* D0: PWM5CHA (10), pin header */
			<1 0 0 &pwm 11 0 0>,	/* D1: PWM5CHB (11), pin header */
			<2 0 0 &pwm 12 0 0>,	/* D2: PWM6CHA (12), pin header */
			<3 0 0 &pwm 5 0 0>,	/* D3: PWM2CHB (5), pin header */
			<4 0 0 &pwm 6 0 0>,	/* D4: PWM3CHA (6), pin header */
			<5 0 0 &pwm 7 0 0>,	/* D5: PWM3CHB (7), pin header */
			<6 0 0 &pwm 0 0 0>,	/* D6: PWM0CHA (0), pin header */
			<7 0 0 &pwm 1 0 0>,	/* D7: PWM0CHB (1), pin header */
			<8 0 0 &pwm 2 0 0>,	/* D8: PWM1CHA (2), pin header */
			<9 0 0 &pwm 4 0 0>,	/* D9: PWM2CHA (4), pin header */
			<10 0 0 &pwm 3 0 0>;	/* D10: PWM1CHB (3), pin header */
	};
};

grove_pwms: &grove_laced_if_v1 {};

grove_pwm_d0: &pwm {};
grove_pwm_d1: &pwm {};
grove_pwm_d2: &pwm {};
grove_pwm_d3: &pwm {};
grove_pwm_d4: &pwm {};
grove_pwm_d5: &pwm {};
grove_pwm_d6: &pwm {};
grove_pwm_d7: &pwm {};
grove_pwm_d8: &pwm {};
grove_pwm_d9: &pwm {};
grove_pwm_d10: &pwm {};
