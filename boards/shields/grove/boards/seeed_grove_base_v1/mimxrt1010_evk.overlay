/*
 * Copyright (c) 2023 TiaC Systems
 * SPDX-License-Identifier: Apache-2.0
 */

/ {
	grove_laced_if_v1: grove-laced-if-v1 {

		compatible = "seeed,grove-laced-if";

		#pwm-cells = <3>;
		pwm-map-mask = <0xffffffff 0 0xffffffc0>;
		pwm-map-pass-thru = <0 0xffffffff 0x3f>;
		pwm-map =
			/*  0 - D0: not possible */
			/*  1 - D1: not possible */
			/*  2 - D2: not possible */
			/*  3 - D3: not possible */
			/*  4 - D4: not possible */
			/*  5 - D5: not possible */
			/*  6 - D6: not possible */
			/*  7 - D7: not possible */
			<8 0 0 &flexpwm1_pwm0 0 0 0>,	/* D8: PWM1A0 */
			<9 0 0 &flexpwm1_pwm1 1 0 0>;	/* D9: PWM1B1 */
			/* 10 - D10: not possible */
			/* 11 - D11: not possible */
			/* 12 - D12: not possible */
			/* 13 - D13: not possible */
			/* 14 - D14: not possible */
			/* 15 - D15: not possible */
			/* 16 - D16: not possible */
			/* 17 - D17: not possible */
			/* 18 - D18: not possible */
			/* 19 - D19: not possible */
	};
};

grove_pwms: &grove_laced_if_v1 {};

grove_pwm_d8: &flexpwm1_pwm0 {};
grove_pwm_d9: &flexpwm1_pwm1 {};
