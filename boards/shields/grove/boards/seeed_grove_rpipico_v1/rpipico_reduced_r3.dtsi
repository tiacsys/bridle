/*
 * SPDX-FileCopyrightText: Copyright (c) 2024-2026 TiaC Systems
 * SPDX-License-Identifier: Apache-2.0
 */

#include <zephyr/dt-bindings/gpio/grove-laced-if.h>

/ {
	grove_laced_if_v1: grove-laced-if-v1 {
		compatible = "seeed,grove-laced-if";

		#pwm-cells = <3>;
		pwm-map-mask = <0xffffffff 0 0xffffffc0>;
		pwm-map-pass-thru = <0 0xffffffff 0x3f>;
		pwm-map =
			/*  0 - D0: not possible */
			/*  1 - D1: not possible */
			/*  2 - D2: not possible */
			/*  3 - D3: not possible */
			/*  4 - D4: not possible */
			/*  5 - D5: not possible */
			/*  6 - D6: not possible */
			/*  7 - D7: not possible */
			/*  8 - D8: not possible */
			/*  9 - D9: not possible */
			/* 10 - D10: not wired */
			/* 11 - D11: not wired */
			/* 12 - D12: not wired */
			/* 13 - D13: not wired */
			/* 14 - D14: not wired */
			/* 15 - D15: not wired */
			/* 16 - D16: not wired */
			/* 17 - D17: internal wired to Ethernet */
			/* 18 - D18: internal wired to Ethernet */
			/* 19 - D19: internal wired to Ethernet */
			/* 20 - D20: internal wired to Ethernet */
			/* 21 - D21: internal wired to Ethernet */
			<GROVE_LIF_L22 0 0 &pwm 6 0 0>,  /* D22: PWM3CHA (6), pin header */
			/* 23 - D23: not possible */
			/* 24 - D24: not possible */
			<GROVE_LIF_L25 0 0 &pwm 9 0 0>;  /* D25: PWM4CHB (9), on-board LED */
			/* 26 - D26: not possible */
			/* 27 - D27: not possible */
			/* 28 - D28: not possible */
	};
};

grove_pwms: &grove_laced_if_v1 {};

grove_pwm_d22: &pwm {};
grove_pwm_d25: &pwm {};
