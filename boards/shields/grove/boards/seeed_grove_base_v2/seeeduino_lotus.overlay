/*
 * Copyright (c) 2023 TiaC Systems
 * SPDX-License-Identifier: Apache-2.0
 */

/ {
	grove_laced_if_v2: grove-laced-if-v2 {

		compatible = "seeed,grove-laced-if";

		#pwm-cells = <2>;
		pwm-map-mask = <0xffffffff 0>;
		pwm-map-pass-thru = <0 0xffffffff>;
		pwm-map =
			/*  0 - D0: not possible */
			/*  1 - D1: not possible */
			<2 0 &tcc0 0 0>,	/* D2: TCC0CH0 (WO4) */
			<3 0 &tcc0 1 0>,	/* D3: TCC0CH1 (WO1) */
			<4 0 &tcc0 0 0>,	/* D4: TCC0CH0 (WO0) */
			<5 0 &tcc0 1 0>,	/* D5: TCC0CH1 (WO5) */
			<6 0 &tcc0 2 0>,	/* D6: TCC0CH2 (WO6) */
			<7 0 &tcc0 3 0>;	/* D7: TCC0CH3 (WO7) */
			/*  8 - D8:  not possible */
			/*  9 - D9:  not possible */
			/* 10 - D10: not possible */
			/* 11 - D11: not possible */
			/* 12 - D12: not possible */
			/* 13 - D13: not possible */
			/* 14 - D14: not possible */
			/* 15 - D15: not possible */
			/* 16 - D16: not possible */
			/* 17 - D17: not possible */
			/* 18 - D18: not possible */
			/* 19 - D19: not possible */
	};
};

grove_pwms: &grove_laced_if_v2 {};

grove_pwm_d2: &tcc0 {};
grove_pwm_d3: &tcc0 {};
grove_pwm_d4: &tcc0 {};
grove_pwm_d5: &tcc0 {};
grove_pwm_d6: &tcc0 {};
grove_pwm_d7: &tcc0 {};
