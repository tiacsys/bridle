/*
 * Copyright (c) 2023 TiaC Systems
 * SPDX-License-Identifier: Apache-2.0
 */

#include "rpi_pico.dtsi"

/*
 * With the Grove Shield for Pi Pico, some interface pins for the
 * Raspberry Pi Pico have to be changed and will no longer comply
 * with the board default settings.
 */

#include "waveshare_rp2040_pico-pinctrl.dtsi"
