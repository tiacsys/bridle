/*
 * Copyright (c) 2023 TiaC Systems
 * SPDX-License-Identifier: Apache-2.0
 */

/* remove interconnection conflicts from board level */

/delete-node/ &grove_laced_if_lotus;
/delete-node/ &grove_uart_header;

/* remove Grove serial from board level, not usable anymore */

/{aliases{/delete-property/ sercom-5;};};
/delete-node/ &grove_serial;

/* final Arduino Zero to Grove interface mapping */

#include "arduino_zero.dtsi"
