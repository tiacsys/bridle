/*
 * SPDX-FileCopyrightText: Copyright (c) 2023-2026 TiaC Systems
 * SPDX-License-Identifier: Apache-2.0
 */

#include <zephyr/dt-bindings/gpio/grove-connector.h>
#include <zephyr/dt-bindings/gpio/raspberrypi-pico-header-r3.h>

/ {
	grove_a1_header: grove-a1-connector {
		compatible = "seeed,grove-connector";
		#gpio-cells = <2>;
		gpio-map-mask = <0xffffffff 0xffffffc0>;
		gpio-map-pass-thru = <0 0x3f>;
		gpio-map = <GROVE_A0 0 &rpipico_header RPIPICO_HEADER_R3_A1 0>, /* ADC1 */
			   <GROVE_A1 0 &rpipico_header RPIPICO_HEADER_R3_A0 0>; /* ADC0 */
	};
};
