/*
 * SPDX-FileCopyrightText: Copyright (c) 2023-2026 TiaC Systems
 * SPDX-License-Identifier: Apache-2.0
 */

#include <zephyr/dt-bindings/gpio/grove-connector.h>
#include <zephyr/dt-bindings/gpio/raspberrypi-pico-header-r3.h>

/ {
	grove_d7_header: grove-d7-connector {
		compatible = "seeed,grove-connector";
		#gpio-cells = <2>;
		gpio-map-mask = <0xffffffff 0xffffffc0>;
		gpio-map-pass-thru = <0 0x3f>;
		gpio-map = <GROVE_SCL 0 &rpipico_header RPIPICO_HEADER_R3_D7 0>, /* I2C1-SCL */
			   <GROVE_SDA 0 &rpipico_header RPIPICO_HEADER_R3_D6 0>; /* I2C1-SDA */
	};
};

grove_i2c1_header: &grove_d7_header {};
