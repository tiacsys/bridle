/*
 * SPDX-FileCopyrightText: Copyright (c) 2023-2026 TiaC Systems
 * SPDX-License-Identifier: Apache-2.0
 */

#include <zephyr/dt-bindings/gpio/grove-connector.h>
#include <zephyr/dt-bindings/gpio/raspberrypi-pico-header-r3.h>

/ {
	grove_d5_header: grove-d5-connector {
		compatible = "seeed,grove-connector";
		#gpio-cells = <2>;
		gpio-map-mask = <0xffffffff 0xffffffc0>;
		gpio-map-pass-thru = <0 0x3f>;
		gpio-map = <GROVE_RX 0 &rpipico_header RPIPICO_HEADER_R3_D5 0>, /* UART1-RX */
			   <GROVE_TX 0 &rpipico_header RPIPICO_HEADER_R3_D4 0>; /* UART1-TX */
	};
};

grove_uart1_header: &grove_d5_header {};
