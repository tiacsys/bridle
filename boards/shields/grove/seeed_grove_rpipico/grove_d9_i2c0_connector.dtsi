/*
 * SPDX-FileCopyrightText: Copyright (c) 2023-2026 TiaC Systems
 * SPDX-License-Identifier: Apache-2.0
 */

#include <zephyr/dt-bindings/gpio/grove-connector.h>
#include <zephyr/dt-bindings/gpio/raspberrypi-pico-header-r3.h>

/ {
	grove_d9_header: grove-d9-connector {
		compatible = "seeed,grove-connector";
		#gpio-cells = <2>;
		gpio-map-mask = <0xffffffff 0xffffffc0>;
		gpio-map-pass-thru = <0 0x3f>;
		gpio-map = <GROVE_SCL 0 &rpipico_header RPIPICO_HEADER_R3_D9 0>, /* I2C0-SCL */
			   <GROVE_SDA 0 &rpipico_header RPIPICO_HEADER_R3_D8 0>; /* I2C0-SDA */
	};
};

grove_i2c0_header: &grove_d9_header {};
