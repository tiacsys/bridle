/*
 * SPDX-FileCopyrightText: Copyright (c) 2023-2026 TiaC Systems
 * SPDX-License-Identifier: Apache-2.0
 */

#include <zephyr/dt-bindings/gpio/grove-connector.h>
#include <zephyr/dt-bindings/gpio/raspberrypi-pico-header-r3.h>

/ {
	grove_d18_header: grove-d18-connector {
		compatible = "seeed,grove-connector";
		#gpio-cells = <2>;
		gpio-map-mask = <0xffffffff 0xffffffc0>;
		gpio-map-pass-thru = <0 0x3f>;
		gpio-map = <GROVE_D0 0 &rpipico_header RPIPICO_HEADER_R3_D18 0>, /* GP18 */
			   <GROVE_D1 0 &rpipico_header RPIPICO_HEADER_R3_D19 0>; /* GP19 */
	};
};
