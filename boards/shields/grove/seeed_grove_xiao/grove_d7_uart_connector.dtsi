/*
 * SPDX-FileCopyrightText: Copyright (c) 2023-2026 TiaC Systems
 * SPDX-License-Identifier: Apache-2.0
 */

#include <zephyr/dt-bindings/gpio/grove-connector.h>

/ {
	grove_d7_header: grove-d7-connector {
		compatible = "seeed,grove-connector";
		#gpio-cells = <2>;
		gpio-map-mask = <0xffffffff 0xffffffc0>;
		gpio-map-pass-thru = <0 0x3f>;
		gpio-map = <GROVE_RX 0 &xiao_d 7 0>, /* D7 / A7 / UART-RX */
			   <GROVE_TX 0 &xiao_d 6 0>; /* D6 / A6 / UART-TX */
	};
};

grove_uart_header: &grove_d7_header {};
