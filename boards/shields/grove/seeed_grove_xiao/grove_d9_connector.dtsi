/*
 * SPDX-FileCopyrightText: Copyright (c) 2023-2026 TiaC Systems
 * SPDX-License-Identifier: Apache-2.0
 */

#include <zephyr/dt-bindings/gpio/grove-connector.h>

/ {
	grove_d9_header: grove-d9-connector {
		compatible = "seeed,grove-connector";
		#gpio-cells = <2>;
		gpio-map-mask = <0xffffffff 0xffffffc0>;
		gpio-map-pass-thru = <0 0x3f>;
		gpio-map = <GROVE_D0 0 &xiao_d 9 0>,  /* A9 / D9 / SPI-MISO */
			   <GROVE_D1 0 &xiao_d 10 0>; /* A10 / D10 / SPI-MOSI */
	};
};
