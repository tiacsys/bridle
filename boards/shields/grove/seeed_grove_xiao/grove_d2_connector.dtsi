/*
 * Copyright (c) 2023 TiaC Systems
 * SPDX-License-Identifier: Apache-2.0
 */

/ {
	grove_d2_header: grove-d2-connector {
		compatible = "seeed,grove-connector";
		#gpio-cells = <2>;
		gpio-map-mask = <0xffffffff 0xffffffc0>;
		gpio-map-pass-thru = <0 0x3f>;
		gpio-map = <0 0 &xiao_d 2 0>,	/* A2 / D2 / SPI-CS */
			   <1 0 &xiao_d 3 0>;	/* A3 / D3 */
	};
};
