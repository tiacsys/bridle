/*
 * SPDX-FileCopyrightText: Copyright (c) 2023-2026 TiaC Systems
 * SPDX-License-Identifier: Apache-2.0
 */

#include <zephyr/dt-bindings/gpio/grove-connector.h>

/ {
	grove_d5_header: grove-d5-connector {
		compatible = "seeed,grove-connector";
		#gpio-cells = <2>;
		gpio-map-mask = <0xffffffff 0xffffffc0>;
		gpio-map-pass-thru = <0 0x3f>;
		gpio-map = <GROVE_SCL 0 &xiao_d 5 0>, /* D5 / A5 / I2C-SCL */
			   <GROVE_SDA 0 &xiao_d 4 0>; /* D4 / A4 / I2C-SDA */
	};
};

grove_i2c_header: &grove_d5_header {};
