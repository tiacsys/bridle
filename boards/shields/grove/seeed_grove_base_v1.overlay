/*
 * SPDX-FileCopyrightText: Copyright (c) 2023-2026 TiaC Systems
 * SPDX-License-Identifier: Apache-2.0
 */

#include <bridle/dt-bindings/seeed_grove_pwms_defaults.h>

#include "seeed_grove_base/grove_spi_connector.dtsi"

#include "seeed_grove_base/grove_i2c_connector.dtsi"

#include "seeed_grove_base/grove_a0_connector.dtsi"
#include "seeed_grove_base/grove_a1_connector.dtsi"
#include "seeed_grove_base/grove_a2_connector.dtsi"
#include "seeed_grove_base/grove_a3_connector.dtsi"
#include "seeed_grove_base/grove_a4_connector.dtsi"

#include "seeed_grove_base/grove_d0_uart_connector.dtsi"
#include "seeed_grove_base/grove_d1_connector.dtsi"
#include "seeed_grove_base/grove_d2_connector.dtsi"
#include "seeed_grove_base/grove_d3_connector.dtsi"
#include "seeed_grove_base/grove_d4_connector.dtsi"
#include "seeed_grove_base/grove_d5_connector.dtsi"
#include "seeed_grove_base/grove_d6_connector.dtsi"
#include "seeed_grove_base/grove_d7_connector.dtsi"
#include "seeed_grove_base/grove_d8_connector.dtsi"
#include "seeed_grove_base/grove_d9_connector.dtsi"
#include "seeed_grove_base/grove_d10_connector.dtsi"
#include "seeed_grove_base/grove_d11_connector.dtsi"
#include "seeed_grove_base/grove_d12_connector.dtsi"
#include "seeed_grove_base/grove_d13_connector.dtsi"

#include <zephyr/dt-bindings/gpio/grove-connector.h>
#include <zephyr/dt-bindings/gpio/grove-laced-if.h>

/ {
	grove_laced_if_v1: grove-laced-if-v1 {
		compatible = "seeed,grove-laced-if";

		#gpio-cells = <2>;
		gpio-map-mask = <0xffffffff 0xffffffc0>;
		gpio-map-pass-thru = <0 0x3f>;
		gpio-map =
			<GROVE_LIF_L0 0 &grove_d0_header GROVE_D0 0>,   /* D0: UART-RX as GPIO */
			<GROVE_LIF_L1 0 &grove_d1_header GROVE_D0 0>,   /* D1: UART-TX as GPIO */
			<GROVE_LIF_L2 0 &grove_d2_header GROVE_D0 0>,   /* D2: GPIO */
			<GROVE_LIF_L3 0 &grove_d3_header GROVE_D0 0>,   /* D3: GPIO */
			<GROVE_LIF_L4 0 &grove_d4_header GROVE_D0 0>,   /* D4: GPIO */
			<GROVE_LIF_L5 0 &grove_d5_header GROVE_D0 0>,   /* D5: GPIO */
			<GROVE_LIF_L6 0 &grove_d6_header GROVE_D0 0>,   /* D6: GPIO */
			<GROVE_LIF_L7 0 &grove_d7_header GROVE_D0 0>,   /* D7: GPIO */
			<GROVE_LIF_L8 0 &grove_d8_header GROVE_D0 0>,   /* D8: GPIO */
			<GROVE_LIF_L9 0 &grove_d9_header GROVE_D0 0>,   /* D9: GPIO */
			<GROVE_LIF_L10 0 &grove_d10_header GROVE_D0 0>, /* D10: SPI-CS as GPIO */
			<GROVE_LIF_L11 0 &grove_d11_header GROVE_D0 0>, /* D11: SPI-MOSI as GPIO */
			<GROVE_LIF_L12 0 &grove_d12_header GROVE_D0 0>, /* D12: SPI-MISO as GPIO */
			<GROVE_LIF_L13 0 &grove_d13_header GROVE_D0 0>, /* D13: SPI-CLK as GPIO */
			<GROVE_LIF_L14 0 &grove_a0_header GROVE_D0 0>,  /* D14: A0 as GPIO */
			<GROVE_LIF_L15 0 &grove_a1_header GROVE_D0 0>,  /* D15: A1 as GPIO */
			<GROVE_LIF_L16 0 &grove_a2_header GROVE_D0 0>,  /* D16: A2 as GPIO */
			<GROVE_LIF_L17 0 &grove_a3_header GROVE_D0 0>,  /* D17: A3 as GPIO */
			<GROVE_LIF_L18 0 &grove_i2c_header GROVE_D1 0>, /* D18: I2C-SDA as GPIO */
			<GROVE_LIF_L19 0 &grove_i2c_header GROVE_D0 0>; /* D19: I2C-SCL as GPIO */

		#pwm-cells = <3>;
		pwm-map-mask = <0xffffffff 0 0>;
		pwm-map-pass-thru = <0 0xffffffff 0xffffffff>;
		pwm-map;	/* default an empty map */
	};
};

grove_gpios: &grove_laced_if_v1 {};
