/*
 * Copyright (c) 2023 TiaC Systems
 * SPDX-License-Identifier: Apache-2.0
 */

/ {
	grove_d0_header: grove-d0-connector {
		compatible = "seeed,grove-connector";
		#gpio-cells = <2>;
		gpio-map-mask = <0xffffffff 0xffffffc0>;
		gpio-map-pass-thru = <0 0x3f>;
		gpio-map = <0 0 &arduino_header 6 0>,	/* D0 / UART-RX */
			   <1 0 &arduino_header 7 0>;	/* D1 / UART-TX */
	};
};

grove_uart_header: &grove_d0_header {};
