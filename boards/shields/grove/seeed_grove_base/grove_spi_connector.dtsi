/*
 * SPDX-FileCopyrightText: Copyright (c) 2023-2026 TiaC Systems
 * SPDX-License-Identifier: Apache-2.0
 */

#include <zephyr/dt-bindings/gpio/grove-connector.h>
#include <zephyr/dt-bindings/gpio/arduino-header-r3.h>

/ {
	grove_spi_header: grove-spi-connector {
		compatible = "seeed,grove-connector";
		#gpio-cells = <2>;
		gpio-map-mask = <0xffffffff 0xffffffc0>;
		gpio-map-pass-thru = <0 0x3f>;
		gpio-map = <GROVE_SCK 0 &arduino_header ARDUINO_HEADER_R3_D13 0>,  /* SPI-CLK */
			   <GROVE_MISO 0 &arduino_header ARDUINO_HEADER_R3_D12 0>, /* SPI-MISO */
			   <GROVE_MOSI 0 &arduino_header ARDUINO_HEADER_R3_D11 0>, /* SPI-MOSI */
			   <GROVE_SS 0 &arduino_header ARDUINO_HEADER_R3_D10 0>;   /* SPI-CS */
	};
};
