/*
 * SPDX-FileCopyrightText: Copyright (c) 2023-2026 TiaC Systems
 * SPDX-License-Identifier: Apache-2.0
 */

#include <zephyr/dt-bindings/gpio/grove-connector.h>
#include <zephyr/dt-bindings/gpio/arduino-header-r3.h>

/ {
	grove_d6_header: grove-d6-connector {
		compatible = "seeed,grove-connector";
		#gpio-cells = <2>;
		gpio-map-mask = <0xffffffff 0xffffffc0>;
		gpio-map-pass-thru = <0 0x3f>;
		gpio-map = <GROVE_D0 0 &arduino_header ARDUINO_HEADER_R3_D6 0>, /* GPIO */
			   <GROVE_D1 0 &arduino_header ARDUINO_HEADER_R3_D7 0>; /* GPIO */
	};
};
