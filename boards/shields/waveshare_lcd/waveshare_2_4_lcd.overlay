/*
 * SPDX-FileCopyrightText: Copyright (c) 2023-2026 TiaC Systems
 * SPDX-License-Identifier: Apache-2.0
 */

/ {
	chosen {
		zephyr,display = &lcd_panel;
	};

	mipi_dbi: mipi-dbi {
		compatible = "zephyr,mipi-dbi-spi";
		write-only;
	};

	lcd_backlight_en: lcd-backlight-en {
		compatible = "regulator-gpio";
		regulator-name = "lcd_backlight_en";
		regulator-always-on;
	};
};
