/*
 * SPDX-FileCopyrightText: Copyright (c) 2023-2026 TiaC Systems
 * SPDX-License-Identifier: Apache-2.0
 */

&ili9341_240x320 {
	rotation = <180>;		/* portrait */
	/delete-property/ h-mirror;	/* mirrored */
};
