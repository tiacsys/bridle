/*
 * Copyright (c) 2023-2024 TiaC Systems
 * SPDX-License-Identifier: Apache-2.0
 */

#include "ili9341_320x240.dtsi"
#include "ili9341_rgb565.dtsi"

&board_spi_lcd {
	cs-gpios = <&grove_gpios 5 GPIO_ACTIVE_LOW>;		/* D5 */
};

&mipi_dbi {
	status = "okay";
	reset-gpios = <&grove_gpios 28 GPIO_ACTIVE_LOW>;	/* D28 */
	dc-gpios = <&grove_gpios 6 GPIO_ACTIVE_HIGH>;		/* D6 */
	spi-dev = <&board_spi_lcd>;
	#address-cells = <1>;
	#size-cells = <0>;
};

&lcd_panel {
	status = "okay";
};

&lcd_backlight_en {
	status = "okay";
	enable-gpios = <&grove_gpios 7 GPIO_ACTIVE_HIGH>;	/* D7 */
};
