/*
 * SPDX-FileCopyrightText: Copyright (c) 2023-2026 TiaC Systems
 * SPDX-License-Identifier: Apache-2.0
 */

&ili9341_320x240 {
	rotation = <270>;		/* landscape */
	/delete-property/ h-mirror;	/* mirrored */
};
