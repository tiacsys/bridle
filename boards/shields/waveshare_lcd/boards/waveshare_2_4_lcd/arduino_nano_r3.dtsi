/*
 * SPDX-FileCopyrightText: Copyright (c) 2023-2026 TiaC Systems
 * SPDX-License-Identifier: Apache-2.0
 */

#include "ili9341_320x240.dtsi"
#include "ili9341_bgr565.dtsi"

#include <zephyr/dt-bindings/gpio/gpio.h>

#include <zephyr/dt-bindings/gpio/arduino-nano-header.h>

&board_spi_lcd {
	cs-gpios = <&arduino_nano_header ARDUINO_NANO_HEADER_D10 GPIO_ACTIVE_LOW>;	/* D10 */
};

&mipi_dbi {
	status = "okay";
	reset-gpios = <&arduino_nano_header ARDUINO_NANO_HEADER_D8 GPIO_ACTIVE_LOW>;	/* D8 */
	dc-gpios = <&arduino_nano_header ARDUINO_NANO_HEADER_D7 GPIO_ACTIVE_HIGH>;	/* D7 */
	spi-dev = <&board_spi_lcd>;
	#address-cells = <1>;
	#size-cells = <0>;
};

&lcd_panel {
	status = "okay";
};

&lcd_backlight_en {
	status = "okay";
	gpios = <&arduino_nano_header ARDUINO_NANO_HEADER_D9 GPIO_ACTIVE_HIGH>;		/* D9 */
	states = <3300000 1>, <0 0>;
	regulator-min-microvolt = <0>;
	regulator-max-microvolt = <3300000>;
	regulator-init-microvolt = <3300000>;
};
