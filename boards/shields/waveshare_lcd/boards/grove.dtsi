/*
 * Copyright (c) 2023 TiaC Systems
 * SPDX-License-Identifier: Apache-2.0
 */

#include <freq.h>

&grove_spi {
	status = "okay";
	clock-frequency = <DT_FREQ_M(25)>;
};

board_spi_lcd: &grove_spi {};
