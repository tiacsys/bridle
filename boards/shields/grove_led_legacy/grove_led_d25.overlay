/*
 * SPDX-FileCopyrightText: Copyright (c) 2023-2026 TiaC Systems
 * SPDX-License-Identifier: Apache-2.0
 */

#include <zephyr/dt-bindings/gpio/gpio.h>
#include <zephyr/dt-bindings/gpio/grove-laced-if.h>

/ {
	grove_leds {
		compatible = "gpio-leds";

		grove_led_d25: grove-led-d25 {
			label = "Grove LED D25";
			gpios = <&grove_gpios GROVE_LIF_L25 (GPIO_ACTIVE_HIGH)>;
		};
	};
};
