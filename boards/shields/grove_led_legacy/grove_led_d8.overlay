/*
 * Copyright (c) 2023 TiaC Systems
 * SPDX-License-Identifier: Apache-2.0
 */

#include <zephyr/dt-bindings/gpio/gpio.h>

/ {
	grove_leds {
		status = "okay";

		compatible = "gpio-leds";

		grove_led_d8: grove-led-d8 {
			label = "Grove LED D8";
			gpios = <&grove_gpios 8 (GPIO_ACTIVE_HIGH)>;
		};
	};
};
