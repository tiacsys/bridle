/*
 * Copyright (c) 2023 TiaC Systems
 * SPDX-License-Identifier: Apache-2.0
 */

#include <zephyr/dt-bindings/gpio/gpio.h>

/ {
	grove_leds {
		status = "okay";

		compatible = "gpio-leds";

		grove_led_d7: grove-led-d7 {
			label = "Grove LED D7";
			gpios = <&grove_gpios 7 (GPIO_ACTIVE_HIGH)>;
		};
	};
};
