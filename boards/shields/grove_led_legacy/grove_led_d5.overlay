/*
 * Copyright (c) 2023 TiaC Systems
 * SPDX-License-Identifier: Apache-2.0
 */

#include <zephyr/dt-bindings/gpio/gpio.h>

/ {
	grove_leds {
		status = "okay";

		compatible = "gpio-leds";

		grove_led_d5: grove-led-d5 {
			label = "Grove LED D5";
			gpios = <&grove_gpios 5 (GPIO_ACTIVE_HIGH)>;
		};
	};
};
