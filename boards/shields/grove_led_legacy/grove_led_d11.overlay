/*
 * SPDX-FileCopyrightText: Copyright (c) 2023-2026 TiaC Systems
 * SPDX-License-Identifier: Apache-2.0
 */

#include <zephyr/dt-bindings/gpio/gpio.h>
#include <zephyr/dt-bindings/gpio/grove-laced-if.h>

/ {
	grove_leds {
		compatible = "gpio-leds";

		grove_led_d11: grove-led-d11 {
			label = "Grove LED D11";
			gpios = <&grove_gpios GROVE_LIF_L11 (GPIO_ACTIVE_HIGH)>;
		};
	};
};
