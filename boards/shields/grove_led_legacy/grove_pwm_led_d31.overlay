/*
 * SPDX-FileCopyrightText: Copyright (c) 2023-2026 TiaC Systems
 * SPDX-License-Identifier: Apache-2.0
 */

#include <zephyr/dt-bindings/gpio/grove-laced-if.h>
#include <zephyr/dt-bindings/pwm/pwm.h>

GROVE_PWMS_SETUP_AND_ENABLE(D31,SLOW)

/ {
	grove_pwm_leds {
		compatible = "pwm-leds";

		grove_pwm_led_d31: grove-pwm-led-d31 {
			label = "Grove LED D31";
			pwms = <&grove_pwms GROVE_LIF_L31 PWM_MSEC(20) (PWM_POLARITY_NORMAL)>;
		};
	};
};
