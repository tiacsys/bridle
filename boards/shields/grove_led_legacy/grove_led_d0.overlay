/*
 * Copyright (c) 2023 TiaC Systems
 * SPDX-License-Identifier: Apache-2.0
 */

#include <zephyr/dt-bindings/gpio/gpio.h>

/ {
	grove_leds {
		status = "okay";

		compatible = "gpio-leds";

		grove_led_d0: grove-led-d0 {
			label = "Grove LED D0";
			gpios = <&grove_gpios 0 (GPIO_ACTIVE_HIGH)>;
		};
	};
};
