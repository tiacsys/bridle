/*
 * Copyright (c) 2023 TiaC Systems
 * SPDX-License-Identifier: Apache-2.0
 */

#include <zephyr/dt-bindings/pwm/pwm.h>

GROVE_PWMS_SETUP_AND_ENABLE(D26,SLOW)

/ {
	grove_pwm_leds {
		status = "okay";

		compatible = "pwm-leds";

		grove_pwm_led_d26: grove-pwm-led-d26 {
			label = "Grove LED D26";
			pwms = <&grove_pwms 26 PWM_MSEC(20) (PWM_POLARITY_NORMAL)>;
		};
	};
};
