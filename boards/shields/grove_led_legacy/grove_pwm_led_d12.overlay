/*
 * Copyright (c) 2023 TiaC Systems
 * SPDX-License-Identifier: Apache-2.0
 */

#include <zephyr/dt-bindings/pwm/pwm.h>

GROVE_PWMS_SETUP_AND_ENABLE(D12,SLOW)

/ {
	grove_pwm_leds {
		status = "okay";

		compatible = "pwm-leds";

		grove_pwm_led_d12: grove-pwm-led-d12 {
			label = "Grove LED D12";
			pwms = <&grove_pwms 12 PWM_MSEC(20) (PWM_POLARITY_NORMAL)>;
		};
	};
};
