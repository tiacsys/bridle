/*
 * SPDX-FileCopyrightText: Copyright (c) 2023-2026 TiaC Systems
 * SPDX-License-Identifier: Apache-2.0
 */

#include <zephyr/dt-bindings/gpio/grove-laced-if.h>
#include <zephyr/dt-bindings/pwm/pwm.h>

GROVE_PWMS_SETUP_AND_ENABLE(D28,SLOW)

/ {
	grove_pwm_leds {
		compatible = "pwm-leds";

		grove_pwm_led_d28: grove-pwm-led-d28 {
			label = "Grove LED D28";
			pwms = <&grove_pwms GROVE_LIF_L28 PWM_MSEC(20) (PWM_POLARITY_NORMAL)>;
		};
	};
};
