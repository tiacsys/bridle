/*
 * SPDX-FileCopyrightText: Copyright (c) 2023-2026 TiaC Systems
 * SPDX-License-Identifier: Apache-2.0
 */

#include <zephyr/dt-bindings/gpio/gpio.h>
#include <zephyr/dt-bindings/gpio/grove-laced-if.h>

/ {
	grove_leds {
		compatible = "gpio-leds";

		grove_led_d29: grove-led-d29 {
			label = "Grove LED D29";
			gpios = <&grove_gpios GROVE_LIF_L29 (GPIO_ACTIVE_HIGH)>;
		};
	};
};
