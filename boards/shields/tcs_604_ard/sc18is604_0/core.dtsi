/*
 * SPDX-FileCopyrightText: Copyright (c) 2024-2026 TiaC Systems
 * SPDX-License-Identifier: Apache-2.0
 */

#include <freq.h>
#include <zephyr/dt-bindings/gpio/gpio.h>

#include <zephyr/dt-bindings/gpio/arduino-header-r3.h>

&sc18is604_0 {
	compatible = "nxp,sc18is604";
	status = "okay";

	spi-max-frequency = <DT_FREQ_K(1200)>;

	/* RESET_B @ D8 */
	reset-gpios = <&arduino_header ARDUINO_HEADER_R3_D8 GPIO_ACTIVE_LOW>;

	/* INT_B @ D9 */
	interrupt-gpios = <&arduino_header ARDUINO_HEADER_R3_D9 GPIO_ACTIVE_LOW>;
};
