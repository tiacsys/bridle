/*
 * SPDX-FileCopyrightText: Copyright (c) 2024-2026 TiaC Systems
 * SPDX-License-Identifier: Apache-2.0
 */

#include <zephyr/dt-bindings/gpio/tiac-604-gpio-header.h>

/ {
	tcs_604_gpio: tcs-604-gpio-pins {
		compatible = "tiac,604-gpio-header";
		#gpio-cells = <2>;
		gpio-map-mask = <0xffffffff 0xffffffc0>;
		gpio-map-pass-thru = <0 0x3f>;
		gpio-map = <TCS_604_GPIO_HEADER_D0 0 &sc18is604_0_gpio 0 0>, /* IO0 */
			   <TCS_604_GPIO_HEADER_D1 0 &sc18is604_0_gpio 1 0>, /* IO1 */
			   <TCS_604_GPIO_HEADER_D2 0 &sc18is604_0_gpio 2 0>, /* IO2 */
			   <TCS_604_GPIO_HEADER_D3 0 &sc18is604_0_gpio 3 0>, /* IO3 */
			   <TCS_604_GPIO_HEADER_D4 0 &sc18is604_0_gpio 4 0>; /* IO4 (input only) */
	};
};
