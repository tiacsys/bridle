/*
 * SPDX-FileCopyrightText: Copyright (c) 2026 TiaC Systems
 * SPDX-License-Identifier: Apache-2.0
 */

rgb_led_chain: &arduino_mcxn94x_leds {};

#include "led_matrix.dtsi"

&led_strip_matrix {
	status = "okay";
};

&led_strip {
	status = "okay";
};
