/*
 * Copyright (c) 2023-2024 TiaC Systems
 * SPDX-License-Identifier: Apache-2.0
 */

#include <freq.h>
#include <zephyr/dt-bindings/i2c/i2c.h>

&rpipico_i2c1 {
	status = "okay";
	clock-frequency = <I2C_BITRATE_STANDARD>;
};

rpipico_i2c_rtc: &rpipico_i2c1 {};

&spi1 {
	status = "okay";
	clock-frequency = <DT_FREQ_M(30)>;
};

rpipico_spi_leds: &spi1 {};

&pwm {
	status = "okay";
};

rpipico_pwm_buzzers: &pwm {};

&gpio0 {
	status = "okay";
};

rpipico_gpio_keys: &gpio0 {};
