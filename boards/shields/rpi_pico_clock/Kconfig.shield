## boards/shields/rpi_pico_clock/Kconfig.shield
```kconfig
# Copyright (c) 2023-2024 TiaC Systems
# SPDX-License-Identifier: Apache-2.0

config SHIELD_WAVESHARE_PICO_CLOCK_GREEN
	def_bool $(shields_list_contains,waveshare_pico_clock_green)
```

## boards/shields/rpi_pico_clock/boards/rpi_pico.conf
```kconfig
# Copyright (c) 2023-2024 TiaC Systems
# SPDX-License-Identifier: Apache-2.0

CONFIG_USB_SELF_POWERED=n
CONFIG_USB_MAX_POWER=50
```

## boards/shields/rpi_pico_lcd/Kconfig.shield
```kconfig
# Copyright (c) 2023-2024 TiaC Systems
# SPDX-License-Identifier: Apache-2.0

config SHIELD_PIMORONI_PICO_LCD_1_44
	def_bool $(shields_list_contains,pimoroni_pico_lcd_1_44)

config SHIELD_WAVESHARE_PICO_LCD_0_96
	def_bool $(shields_list_contains,waveshare_pico_lcd_0_96)

config SHIELD_WAVESHARE_PICO_LCD_1_14
	def_bool $(shields_list_contains,waveshare_pico_lcd_1_14)

config SHIELD_WAVESHARE_PICO_LCD_1_3
	def_bool $(shields_list_contains,waveshare_pico_lcd_1_3)

config SHIELD_WAVESHARE_PICO_LCD_1_44
	def_bool $(shields_list_contains,waveshare_pico_lcd_1_44)

config SHIELD_WAVESHARE_PICO_LCD_1_8
	def_bool $(shields_list_contains,waveshare_pico_lcd_1_8)

config SHIELD_WAVESHARE_PICO_LCD_2
	def_bool $(shields_list_contains,waveshare_pico_lcd_2)

config SHIELD_WAVESHARE_PICO_RESTOUCH_LCD_2_8
	def_bool $(shields_list_contains,waveshare_pico_restouch_lcd_2_8)

config SHIELD_WAVESHARE_PICO_RESTOUCH_LCD_3_5
	def_bool $(shields_list_contains,waveshare_pico_restouch_lcd_3_5)
```

## boards/shields/rpi_pico_led/Kconfig.defconfig
```kconfig
# Copyright (c) 2024 TiaC Systems
# SPDX-License-Identifier: Apache-2.0

config SHIELD_RPI_PICO_LED
	bool
	default y if SHIELD_WAVESHARE_PICO_RGB_LED
	default n
```

## boards/shields/sc16is75x_bb/Kconfig.defconfig
```kconfig
# Copyright (c) 2024 TiaC Systems
# SPDX-License-Identifier: Apache-2.0

config SHIELD_CJMCU_750
	bool
	default y if SHIELD_CJMCU_750_I2C
	default y if SHIELD_CJMCU_750_I2C_NOIRQ
	default y if SHIELD_CJMCU_750_SPI
	default y if SHIELD_CJMCU_750_SPI_NOIRQ
	default n

config SHIELD_CJMCU_752
	bool
	default y if SHIELD_CJMCU_752_I2C
	default y if SHIELD_CJMCU_752_I2C_NOIRQ
	default y if SHIELD_CJMCU_752_SPI
	default y if SHIELD_CJMCU_752_SPI_NOIRQ
	default n

config MFD
	default y
	depends on SHIELD_CJMCU_750 || SHIELD_CJMCU_752

config I2C
	default y if SHIELD_CJMCU_750_I2C || SHIELD_CJMCU_750_I2C_NOIRQ
	default y if SHIELD_CJMCU_752_I2C || SHIELD_CJMCU_752_I2C_NOIRQ
	depends on SHIELD_CJMCU_750 || SHIELD_CJMCU_752

config SPI
	default y if SHIELD_CJMCU_750_SPI || SHIELD_CJMCU_750_SPI_NOIRQ
	default y if SHIELD_CJMCU_752_SPI || SHIELD_CJMCU_752_SPI_NOIRQ
	depends on SHIELD_CJMCU_750 || SHIELD_CJMCU_752

config SERIAL
	default y if DT_HAS_NXP_SC16IS75X_UART_ENABLED
	depends on SHIELD_CJMCU_750 || SHIELD_CJMCU_752

config GPIO
	default y if DT_HAS_NXP_SC16IS75X_GPIO_ENABLED
	depends on SHIELD_CJMCU_750 || SHIELD_CJMCU_752

config DYNAMIC_THREAD_POOL_SIZE
	default 1 if MFD_SC16IS75X_ASYNC && !DYNAMIC_THREAD_ALLOC
	depends on (SHIELD_CJMCU_750 || SHIELD_CJMCU_752) && MFD_SC16IS75X
```

## boards/shields/sc16is75x_bb/Kconfig.shield
```kconfig
# Copyright (c) 2024 TiaC Systems
# SPDX-License-Identifier: Apache-2.0

config SHIELD_CJMCU_750_I2C
	def_bool $(shields_list_contains,cjmcu_750_i2c)

config SHIELD_CJMCU_750_I2C_NOIRQ
	def_bool $(shields_list_contains,cjmcu_750_i2c_noirq)

config SHIELD_CJMCU_750_SPI
	def_bool $(shields_list_contains,cjmcu_750_spi)

config SHIELD_CJMCU_750_SPI_NOIRQ
	def_bool $(shields_list_contains,cjmcu_750_spi_noirq)

config SHIELD_CJMCU_752_I2C
	def_bool $(shields_list_contains,cjmcu_752_i2c)

config SHIELD_CJMCU_752_I2C_NOIRQ
	def_bool $(shields_list_contains,cjmcu_752_i2c_noirq)

config SHIELD_CJMCU_752_SPI
	def_bool $(shields_list_contains,cjmcu_752_spi)

config SHIELD_CJMCU_752_SPI_NOIRQ
	def_bool $(shields_list_contains,cjmcu_752_spi_noirq)
```

## boards/shields/tcs_604_ard/Kconfig.defconfig
```kconfig
# Copyright (c) 2024 TiaC Systems
# SPDX-License-Identifier: Apache-2.0

config MFD
	default y
	depends on SHIELD_TCS_604_ARD

config SPI
	default y
	depends on SHIELD_TCS_604_ARD

config I2C
	default y if DT_HAS_NXP_SC18IS604_I2C_ENABLED
	depends on SHIELD_TCS_604_ARD

config GPIO
	default y if DT_HAS_NXP_SC18IS604_GPIO_ENABLED
	depends on SHIELD_TCS_604_ARD

config DYNAMIC_THREAD_POOL_SIZE
	default 1 if MFD_SC18IS604_ASYNC && !DYNAMIC_THREAD_ALLOC
	depends on SHIELD_TCS_604_ARD && MFD_SC18IS604
```

## boards/shields/tcs_604_ard/Kconfig.shield
```kconfig
# Copyright (c) 2024 TiaC Systems
# SPDX-License-Identifier: Apache-2.0

config SHIELD_TCS_604_ARD
	def_bool $(shields_list_contains,tcs_604_ard)
```

## boards/shields/waveshare_lcd/Kconfig.shield
```kconfig
# Copyright (c) 2023 TiaC Systems
# SPDX-License-Identifier: Apache-2.0

config SHIELD_WAVESHARE_2_4_LCD
	def_bool $(shields_list_contains,waveshare_2_4_lcd)
```

## boards/shields/waveshare_pico_environment_sensor/Kconfig.shield
```kconfig
# Copyright (c) 2024 TiaC Systems
# SPDX-License-Identifier: Apache-2.0

config SHIELD_WAVESHARE_PICO_ENVIRONMENT_SENSOR
	def_bool $(shields_list_contains,waveshare_pico_environment_sensor)

config MPU9250_MAGN_EN
	default y if DT_HAS_INVENSENSE_MPU9250_ENABLED
	depends on SHIELD_WAVESHARE_PICO_ENVIRONMENT_SENSOR && SENSOR
```

## boards/shields/wcmcu_752/Kconfig.shield
```kconfig
# Copyright (c) 2024 TiaC Systems
# SPDX-License-Identifier: Apache-2.0

config SHIELD_WCMCU_752
	def_bool $(shields_list_contains,wcmcu_752_spi) || \
		$(shields_list_contains,wcmcu_752_i2c)

config X_ARDUINO_HEADER_TO_WCMCU_752
	def_bool $(shields_list_contains,x_arduino_header_to_wcmcu_752)
```

## boards/shields/x_cjmcu_75x/Kconfig.shield
```kconfig
# Copyright (c) 2024 TiaC Systems
# SPDX-License-Identifier: Apache-2.0

config SHIELD_X_CJMCU_75X
	def_bool $(shields_list_contains,x_cjmcu_75x)
```

## boards/shields/x_grove_testbed/Kconfig.defconfig
```kconfig
# Copyright (c) 2023 TiaC Systems
# SPDX-License-Identifier: Apache-2.0

if SHIELD_X_GROVE_TESTBED

config SHIELD_X_GROVE_TESTBED_SINGLE_BOARD
	bool
	default y if BOARD_COFFEECALLER_NRF52
	default y if BOARD_CYTRON_MAKER_NANO_RP2040
	default y if BOARD_CYTRON_MAKER_PI_RP2040
	default y if BOARD_CYTRON_MOTION_2350_PRO
	default y if BOARD_MINI_USB_RP2040
	default y if BOARD_MINI_USB_RP2350
	default y if BOARD_SEEEDUINO_LOTUS
	default n

endif # SHIELD_X_GROVE_TESTBED
```

## boards/shields/x_grove_testbed/Kconfig.shield
```kconfig
# Copyright (c) 2023 TiaC Systems
# SPDX-License-Identifier: Apache-2.0

config SHIELD_X_GROVE_TESTBED
	def_bool $(shields_list_contains,x_grove_testbed)
```

## boards/shields/x_nxp_sc18is604_evb/Kconfig.shield
```kconfig
# Copyright (c) 2024 TiaC Systems
# SPDX-License-Identifier: Apache-2.0

config SHIELD_X_NXP_SC18IS604_EVB
	def_bool $(shields_list_contains,x_nxp_sc18is604_evb)
```

## boards/st/nucleo_f303re/Kconfig.nucleo_f303re
```kconfig
# Copyright (c) 2026 TiaC Systems
# SPDX-License-Identifier: Apache-2.0

config BOARD_NUCLEO_F303RE_STM32F303XE
	bool

config BOARD_NUCLEO_F303RE_STM32F303XE_BBE
	bool
	select BOARD_NUCLEO_F303RE_STM32F303XE
```

## boards/st/nucleo_f303re/board.yml
```yaml
# Copyright (c) 2026 TiaC Systems
# SPDX-License-Identifier: Apache-2.0

board:
  extend: nucleo_f303re
  variants:
    - name: bbe
      qualifier: stm32f303xe
```

## boards/st/nucleo_f303re/nucleo_f303re_bbe_defconfig
```kconfig
# Copyright (c) 2026 TiaC Systems
# SPDX-License-Identifier: Apache-2.0
#
# NOTE: copy and own from original default configuration in
# "zephyr/boards/st/nucleo_f303re/nucleo_f303re_defconfig"

CONFIG_SERIAL=y

# Enable MPU
CONFIG_ARM_MPU=y

# Enable HW stack protection
CONFIG_HW_STACK_PROTECTION=y

# console
CONFIG_CONSOLE=y
CONFIG_UART_CONSOLE=y

# enable GPIO
CONFIG_GPIO=y
```

## boards/st/nucleo_f401re/Kconfig.nucleo_f401re
```kconfig
# Copyright (c) 2026 TiaC Systems
# SPDX-License-Identifier: Apache-2.0

config BOARD_NUCLEO_F401RE_STM32F401XE
	bool

config BOARD_NUCLEO_F401RE_STM32F401XE_BBE
	bool
	select BOARD_NUCLEO_F401RE_STM32F401XE
```

## boards/st/nucleo_f401re/board.yml
```yaml
# Copyright (c) 2026 TiaC Systems
# SPDX-License-Identifier: Apache-2.0

board:
  extend: nucleo_f401re
  variants:
    - name: bbe
      qualifier: stm32f401xe
```

## boards/st/nucleo_f401re/nucleo_f401re_bbe_defconfig
```kconfig
# Copyright (c) 2026 TiaC Systems
# SPDX-License-Identifier: Apache-2.0
#
# NOTE: copy and own from original default configuration in
# "zephyr/boards/st/nucleo_f401re/nucleo_f401re_defconfig"

# Enable MPU
CONFIG_ARM_MPU=y

# Enable HW stack protection
CONFIG_HW_STACK_PROTECTION=y

CONFIG_SERIAL=y

# console
CONFIG_CONSOLE=y
CONFIG_UART_CONSOLE=y

# enable GPIO
CONFIG_GPIO=y
```

## boards/st/nucleo_f413zh/board.yml
```yaml
# Copyright (c) 2026 TiaC Systems
# SPDX-License-Identifier: Apache-2.0

board:
  extend: nucleo_f413zh
  variants:
    - name: bbe
      qualifier: stm32f413xx
```

## boards/st/nucleo_f746zg/Kconfig.nucleo_f746zg
```kconfig
# Copyright (c) 2026 TiaC Systems
# SPDX-License-Identifier: Apache-2.0

config BOARD_NUCLEO_F746ZG_STM32F746XX
	bool

config BOARD_NUCLEO_F746ZG_STM32F746XX_BBE
	bool
	select BOARD_NUCLEO_F746ZG_STM32F746XX
```

## boards/st/nucleo_f746zg/board.yml
```yaml
# Copyright (c) 2026 TiaC Systems
# SPDX-License-Identifier: Apache-2.0

board:
  extend: nucleo_f746zg
  variants:
    - name: bbe
      qualifier: stm32f746xx
```

## boards/st/nucleo_f767zi/Kconfig.nucleo_f767zi
```kconfig
# Copyright (c) 2026 TiaC Systems
# SPDX-License-Identifier: Apache-2.0

config BOARD_NUCLEO_F767ZI_STM32F767XX
	bool

config BOARD_NUCLEO_F767ZI_STM32F767XX_BBE
	bool
	select BOARD_NUCLEO_F767ZI_STM32F767XX
```
