/*
 * Copyright (c) 2024 TiaC Systems
 * SPDX-License-Identifier: Apache-2.0
 */

nxp_sc18is604_evb_spi: &arduino_spi {};

/ {
	nxp_sc18is604_evb_header: nxp-sc18is604-evb-connector {
		compatible = "gpio-nexus"; /* FIXME: nxp,sc18is604-evb */
		#gpio-cells = < 2 >;
		gpio-map-mask = < 0xffffffff 0xffffffc0 >;
		gpio-map-pass-thru = < 0 0x3f >;
		gpio-map =
			< 0 0 &arduino_header 14 0 >, /* Reset pin on D8 */
			< 1 0 &arduino_header 15 0 >; /* Interrupt pin on D9 */
	};
};
