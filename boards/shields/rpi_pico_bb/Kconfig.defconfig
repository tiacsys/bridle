## boards/shields/rpi_pico_bb/Kconfig.defconfig
```kconfig
# SPDX-FileCopyrightText: Copyright (c) 2024-2026 TiaC Systems
# SPDX-License-Identifier: Apache-2.0

choice LV_COLOR_DEPTH
	default LV_COLOR_DEPTH_16 if SHIELD_GEEEKPI_PICO_BB
	default LV_COLOR_DEPTH_16 if SHIELD_GEEEKPI_PICO_BB_PLUS
	depends on DISPLAY && LVGL
endchoice

config INPUT
	default y if SHIELD_GEEEKPI_PICO_BB
	default y if SHIELD_GEEEKPI_PICO_BB_PLUS
	depends on DISPLAY && LVGL && ( \
		   DT_HAS_ZEPHYR_LVGL_BUTTON_INPUT_ENABLED || \
		   DT_HAS_ZEPHYR_LVGL_KEYPAD_INPUT_ENABLED || \
		   DT_HAS_ZEPHYR_LVGL_POINTER_INPUT_ENABLED)

config INPUT_GT911_INTERRUPT
	default y if SHIELD_GEEEKPI_PICO_BB_PLUS
	depends on INPUT && LVGL

config ADC
	default y if SHIELD_GEEEKPI_PICO_BB_PLUS
	depends on INPUT && LVGL && DT_HAS_ADC_KEYS_ENABLED
```

## boards/shields/rpi_pico_lcd/Kconfig.defconfig
```kconfig
# SPDX-FileCopyrightText: Copyright (c) 2023-2026 TiaC Systems
# SPDX-License-Identifier: Apache-2.0

choice LV_COLOR_DEPTH
	default LV_COLOR_DEPTH_16 if SHIELD_PIMORONI_PICO_LCD_1_44
	default LV_COLOR_DEPTH_16 if SHIELD_PIMORONI_PICO_LCD_2
	default LV_COLOR_DEPTH_16 if SHIELD_SPOTPEAR_PICO_LCD_1_54
	default LV_COLOR_DEPTH_16 if SHIELD_WAVESHARE_PICO_LCD_0_96
	default LV_COLOR_DEPTH_16 if SHIELD_WAVESHARE_PICO_LCD_1_14
	default LV_COLOR_DEPTH_16 if SHIELD_WAVESHARE_PICO_LCD_1_3
	default LV_COLOR_DEPTH_16 if SHIELD_WAVESHARE_PICO_LCD_1_44
	default LV_COLOR_DEPTH_16 if SHIELD_WAVESHARE_PICO_LCD_1_8
	default LV_COLOR_DEPTH_16 if SHIELD_WAVESHARE_PICO_LCD_2
	default LV_COLOR_DEPTH_16 if SHIELD_WAVESHARE_PICO_RESTOUCH_LCD_2_8
	default LV_COLOR_DEPTH_16 if SHIELD_WAVESHARE_PICO_RESTOUCH_LCD_3_5
	depends on DISPLAY && LVGL
endchoice

config INPUT
	default y if SHIELD_PIMORONI_PICO_LCD_1_44
	default y if SHIELD_PIMORONI_PICO_LCD_2
	default y if SHIELD_SPOTPEAR_PICO_LCD_1_54
	default y if SHIELD_WAVESHARE_PICO_LCD_0_96
	default y if SHIELD_WAVESHARE_PICO_LCD_1_14
	default y if SHIELD_WAVESHARE_PICO_LCD_1_3
	default y if SHIELD_WAVESHARE_PICO_LCD_1_44
	default y if SHIELD_WAVESHARE_PICO_LCD_1_8
	default y if SHIELD_WAVESHARE_PICO_LCD_2
	default y if SHIELD_WAVESHARE_PICO_RESTOUCH_LCD_2_8
	default y if SHIELD_WAVESHARE_PICO_RESTOUCH_LCD_3_5
	depends on DISPLAY && LVGL && ( \
		   DT_HAS_ZEPHYR_LVGL_BUTTON_INPUT_ENABLED || \
		   DT_HAS_ZEPHYR_LVGL_KEYPAD_INPUT_ENABLED || \
		   DT_HAS_ZEPHYR_LVGL_POINTER_INPUT_ENABLED)

config REGULATOR
	default y
	depends on DT_HAS_REGULATOR_GPIO_ENABLED
```

## boards/shields/rpi_pico_led/Kconfig.shield
```kconfig
# SPDX-FileCopyrightText: Copyright (c) 2024-2026 TiaC Systems
# SPDX-License-Identifier: Apache-2.0

config SHIELD_SEENGREAT_PICO_RGB_MATRIX_PES1
	def_bool $(shields_list_contains,seengreat_pico_rgb_matrix_pes1)

config SHIELD_WAVESHARE_PICO_RGB_LED
	def_bool $(shields_list_contains,waveshare_pico_rgb_led)
```

## boards/shields/rpi_pico_test/Kconfig.defconfig
```kconfig
# SPDX-FileCopyrightText: Copyright (c) 2023-2026 TiaC Systems
# SPDX-License-Identifier: Apache-2.0

config INPUT
	default y if SHIELD_SPOTPEAR_PICO_TEST
	depends on DISPLAY && LVGL && DT_HAS_ZEPHYR_LVGL_KEYPAD_INPUT_ENABLED
```

## boards/shields/rpi_pico_test/Kconfig.shield
```kconfig
# SPDX-FileCopyrightText: Copyright (c) 2023-2026 TiaC Systems
# SPDX-License-Identifier: Apache-2.0

config SHIELD_SPOTPEAR_PICO_TEST
	def_bool $(shields_list_contains,spotpear_pico_test)
```

## boards/shields/seeed_xiao_led/Kconfig.shield
```kconfig
# SPDX-FileCopyrightText: Copyright (c) 2026 TiaC Systems
# SPDX-License-Identifier: Apache-2.0

config SHIELD_SEEED_XIAO_6X10_RGB_MATRIX
	def_bool $(shields_list_contains,seeed_xiao_6x10_rgb_matrix)
```

## boards/shields/waveshare_lcd/Kconfig.defconfig
```kconfig
# SPDX-FileCopyrightText: Copyright (c) 2023-2026 TiaC Systems
# SPDX-License-Identifier: Apache-2.0

choice LV_COLOR_DEPTH
	default LV_COLOR_DEPTH_16 if SHIELD_WAVESHARE_2_4_LCD
	depends on DISPLAY && LVGL
endchoice

config REGULATOR
	default y
	depends on DT_HAS_REGULATOR_GPIO_ENABLED
```

## boards/shields/waveshare_pico_10dof_imu_sensor/Kconfig.defconfig
```kconfig
# SPDX-FileCopyrightText: Copyright (c) 2024-2026 TiaC Systems
# SPDX-License-Identifier: Apache-2.0

config SHIELD_WAVESHARE_PICO_10DOF_IMU_SENSOR
	bool
	default y if SHIELD_WAVESHARE_PICO_10DOF_IMU_SENSOR_R2
	default y if SHIELD_WAVESHARE_PICO_10DOF_IMU_SENSOR_R1
	default n

config MPU9250_MAGN_EN
	default y if DT_HAS_INVENSENSE_MPU9250_ENABLED
	depends on SHIELD_WAVESHARE_PICO_10DOF_IMU_SENSOR && SENSOR
```

## boards/shields/waveshare_pico_10dof_imu_sensor/Kconfig.shield
```kconfig
# SPDX-FileCopyrightText: Copyright (c) 2024-2026 TiaC Systems
# SPDX-License-Identifier: Apache-2.0

config SHIELD_WAVESHARE_PICO_10DOF_IMU_SENSOR_R2
	def_bool $(shields_list_contains,waveshare_pico_10dof_imu_sensor_r2)

config SHIELD_WAVESHARE_PICO_10DOF_IMU_SENSOR_R1
	def_bool $(shields_list_contains,waveshare_pico_10dof_imu_sensor_r1)
```

## boards/shields/waveshare_pico_environment_sensor/Kconfig.defconfig
```kconfig
# SPDX-FileCopyrightText: Copyright (c) 2024-2026 TiaC Systems
# SPDX-License-Identifier: Apache-2.0

config MPU9250_MAGN_EN
	default y if DT_HAS_INVENSENSE_MPU9250_ENABLED
	depends on SHIELD_WAVESHARE_PICO_ENVIRONMENT_SENSOR && SENSOR
```

## boards/shields/xiao_led/Kconfig.shield
```kconfig
# SPDX-FileCopyrightText: Copyright (c) 2026 TiaC Systems
# SPDX-License-Identifier: Apache-2.0

config SHIELD_XIAO_6X10_RGB_MATRIX
	def_bool $(shields_list_contains,xiao_6x10_rgb_matrix)
```

## boards/tiac/coffeecaller/board.yml
```yaml
# SPDX-FileCopyrightText: Copyright (c) 2025-2026 TiaC Systems
# SPDX-License-Identifier: Apache-2.0

board:
  name: coffeecaller_nrf52
  full_name: TiaC CoffeeCaller nRF52
  vendor: tiac
  socs:
    - name: nrf52840
```

## boards/tiac/magpie_f777ni/Kconfig.magpie_f777ni
```kconfig
# SPDX-FileCopyrightText: Copyright (c) 2021-2026 TiaC Systems
# SPDX-FileCopyrightText: Copyright (c) 2021 Li-Pro.Net
# SPDX-License-Identifier: Apache-2.0

# TiaC Magpie F777NI board configuration

config BOARD_MAGPIE_F777NI
	select SOC_STM32F777XX
```

## boards/tiac/magpie_f777ni/board.yml
```yaml
# SPDX-FileCopyrightText: Copyright (c) 2021-2026 TiaC Systems
# SPDX-FileCopyrightText: Copyright (c) 2021 Li-Pro.Net
# SPDX-License-Identifier: Apache-2.0

board:
  name: magpie_f777ni
  full_name: TiaC Magpie F777NI
  vendor: tiac
  socs:
    - name: stm32f777xx
```

## boards/tiac/magpie_f777ni/magpie_f777ni_defconfig
```kconfig
# SPDX-FileCopyrightText: Copyright (c) 2021-2026 TiaC Systems
# SPDX-FileCopyrightText: Copyright (c) 2021 Li-Pro.Net
# SPDX-License-Identifier: Apache-2.0

# Enable MPU
CONFIG_ARM_MPU=y

# Enable HW stack protection
CONFIG_HW_STACK_PROTECTION=y

# Enable UART
CONFIG_SERIAL=y

# Console
CONFIG_CONSOLE=y
CONFIG_UART_CONSOLE=y
```

## boards/waveshare/rp2040/board.yml
```yaml
boards:
  - name: waveshare_rp2040_geek
    full_name: Waveshare RP2040-Geek
    vendor: waveshare
    socs:
      - name: rp2040
```

## boards/waveshare/rp2040_eth/Kconfig.waveshare_rp2040_eth
```kconfig
# SPDX-FileCopyrightText: Copyright (c) 2023-2026 TiaC Systems
# SPDX-License-Identifier: Apache-2.0

config BOARD_WAVESHARE_RP2040_ETH
	select SOC_RP2040
```

## boards/waveshare/rp2040_eth/board.yml
```yaml
# SPDX-FileCopyrightText: Copyright (c) 2023-2026 TiaC Systems
# SPDX-License-Identifier: Apache-2.0

board:
  name: waveshare_rp2040_eth
  full_name: Waveshare RP2040-ETH
  vendor: waveshare
  socs:
    - name: rp2040
```

## boards/waveshare/rp2040_lcd_0_96/board.yml
```yaml
# SPDX-FileCopyrightText: Copyright (c) 2023-2026 TiaC Systems
# SPDX-License-Identifier: Apache-2.0

board:
  name: waveshare_rp2040_lcd_0_96
  full_name: Waveshare RP2040-LCD-0.96
  vendor: waveshare
  socs:
    - name: rp2040
```

## boards/waveshare/rp2040_matrix/Kconfig.waveshare_rp2040_matrix
```kconfig
# SPDX-FileCopyrightText: Copyright (c) 2023-2026 TiaC Systems
# SPDX-License-Identifier: Apache-2.0

config BOARD_WAVESHARE_RP2040_MATRIX
	select SOC_RP2040
```

## boards/waveshare/rp2040_matrix/board.yml
```yaml
# SPDX-FileCopyrightText: Copyright (c) 2023-2026 TiaC Systems
# SPDX-License-Identifier: Apache-2.0

board:
  name: waveshare_rp2040_matrix
  full_name: Waveshare RP2040-Matrix
  vendor: waveshare
  socs:
    - name: rp2040
```

## boards/waveshare/rp2040_plus/board.yml
```yaml
# SPDX-FileCopyrightText: Copyright (c) 2023-2026 TiaC Systems
# SPDX-License-Identifier: Apache-2.0

board:
  name: waveshare_rp2040_plus
  full_name: Waveshare RP2040-Plus
  vendor: waveshare
  socs:
    - name: rp2040
  revision:
    format: "custom"
    default: "4mb"
    revisions:
      - name: "4mb"
      - name: "16mb"
```
