/*
 * Copyright (c) 2024 TiaC Systems
 * SPDX-License-Identifier: Apache-2.0
 */

&pico_i2c0 {
	compatible = "gpio-i2c";	/* I2C0_SDA_P8 and I2C0_SCL_P9 */
	sda-gpios = <&rpipico_header 8 (GPIO_OPEN_DRAIN | GPIO_PULL_UP)>;
	scl-gpios = <&rpipico_header 9 (GPIO_OPEN_DRAIN | GPIO_PULL_UP)>;
	/delete-property/ resets;
	/delete-property/ clocks;
	/delete-property/ interrupts;
	/delete-property/ interrupt-names;
	/delete-property/ pinctrl-0;
	/delete-property/ pinctrl-names;
};
