/*
 * Copyright (c) 2024 TiaC Systems
 * SPDX-License-Identifier: Apache-2.0
 */

#include <freq.h>
#include <zephyr/dt-bindings/mipi_dbi/mipi_dbi.h>

&mipi_dbi {
	st7796s_480x320: st7796s@0 {
		compatible = "sitronix,st7796s";
		mipi-max-frequency = <DT_FREQ_M(62)>;
		mipi-mode = "MIPI_DBI_MODE_SPI_4WIRE";
		reg = <0>;

		status = "disabled";

		width = <480>;		/* landscape */
		height = <320>;		/* landscape */

		color-invert;
		rgb-is-inverted;

		vcmpctl = <0x09>;
		madctl = <0x28>;	/* landscape */
		frmctl1 = [80 10];
		bpc = [1F 50 00 20];
		dfc = [8A 07 3B];
		pwr1 = [80 64];
		pwr2 = <0x13>;
		pwr3 = <0xA7>;
		doca = [40 8A 00 00 29 19 A5 38];
		pgc = [F0 06 0B 07 06 05 2E 33 47 3A 17 16 2E 31];
		ngc = [F0 09 0D 09 08 23 2E 33 46 38 13 13 2C 32];
	};
};

lcd_panel: &st7796s_480x320 {};
