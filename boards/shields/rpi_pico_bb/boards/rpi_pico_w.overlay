/*
 * Copyright (c) 2024 TiaC Systems
 * SPDX-License-Identifier: Apache-2.0
 */

#include "rpipico_r3.dtsi"

/* link to pinctrl node from board for rpi_pico/rp2040/w */
spi0_pico: &spi0_default {};

/* link to pinctrl node from board for rpi_pico/rp2040/w */
i2c0_pico: &i2c0_default {};

/* link to pinctrl node from board for rpi_pico/rp2040/w */
pwm_pico: &pwm_ch4b_default {};

/* link to pinctrl node from board for rpi_pico/rp2040/w */
adc_pico: &adc_default {};
