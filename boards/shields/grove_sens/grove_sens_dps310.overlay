/*
 * Copyright (c) 2024-2025 TiaC Systems
 * SPDX-License-Identifier: Apache-2.0
 */

/*
 * Device address 0x77 is assumed per default. Your device may have
 * a different address; check solder bridge on your device if unsure.
 */

&grove_i2c {
	dps310@77 {
		compatible = "infineon,dps310";
		friendly-name = "Grove High Precision TP Sensor V1.0 (DPS310)";
		status = "okay";
		reg = <0x77>;
	};
};
