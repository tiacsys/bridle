/*
 * Copyright (c) 2024 TiaC Systems
 * SPDX-License-Identifier: Apache-2.0
 */

/*
 * Device address 0x76 is assumed per default. Your device may have
 * a different address; check solder bridge on your device if unsure.
 */

&grove_i2c {
	bme280@76 {
		compatible = "bosch,bme280";
		status = "okay";
		reg = <0x76>;
	};
};
