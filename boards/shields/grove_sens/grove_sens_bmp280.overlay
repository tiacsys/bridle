/*
 * Copyright (c) 2024-2025 TiaC Systems
 * SPDX-License-Identifier: Apache-2.0
 */

/*
 * Device address 0x77 is assumed per default. Your device may have
 * a different address; check solder bridge on your device if unsure.
 */

&grove_i2c {
	bmp280@77 {
		compatible = "bosch,bme280";
		friendly-name = "Grove TP Sensor V1.0 (BMP280)";
		status = "okay";
		reg = <0x77>;
	};
};
