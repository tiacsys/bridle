/*
 * Copyright (c) 2024 TiaC Systems
 * SPDX-License-Identifier: Apache-2.0
 */

#include <zephyr/dt-bindings/i2c/i2c.h>

&tcs_604_i2c {
	compatible = "nxp,sc18is604-i2c";
	status = "okay";

	#address-cells = <1>;
	#size-cells = <0>;

	clock-frequency = <I2C_BITRATE_STANDARD>;
};
