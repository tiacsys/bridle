/*
 * Copyright (c) 2023 TiaC Systems
 * SPDX-License-Identifier: Apache-2.0
 */

#include <freq.h>

&rpipico_spi_lcd {
	st7789v_240x320: st7789v@0 {
		compatible = "sitronix,st7789v";
		spi-max-frequency = <DT_FREQ_M(20)>;
		reg = <0>;

		status = "disabled";

		width = <240>;		/* portrait */
		height = <320>;		/* portrait */
		x-offset = <0>;		/* portrait */
		y-offset = <0>;		/* portrait */

		vcom = <0x1f>;
		gctrl = <0x35>;
		vrhs = <0x12>;
		vdvs = <0x20>;
		mdac = <0x00>;		/* portrait */
		gamma = <0x01>;
		colmod = <0x06>;	/* 18-bit, RGB666 */
		lcm = <0x2c>;
		porch-param = [0C 0C 00 33 33];
		cmd2en-param = [5A 69 02 01];
		pwctrl1-param = [A4 A1];
		pvgam-param = [D0 08 11 08 0C 15 39 33 50 36 13 14 29 2D];
		nvgam-param = [D0 08 10 08 06 06 39 44 51 0B 16 14 2F 31];
		ram-param = [00 F0];
		rgb-param = [CD 08 14];
	};
};
