/*
 * Copyright (c) 2024 TiaC Systems
 * SPDX-License-Identifier: Apache-2.0
 */

#include <freq.h>
#include <zephyr/dt-bindings/mipi_dbi/mipi_dbi.h>

&mipi_dbi {
	st7789v_240x240pt: st7789v@0 {
		compatible = "sitronix,st7789v";
		mipi-max-frequency = <DT_FREQ_M(20)>;
		mipi-mode = "MIPI_DBI_MODE_SPI_4WIRE";
		reg = <0>;

		status = "disabled";

		width = <240>;		/* portrait */
		height = <240>;		/* portrait */
		x-offset = <0>;		/* portrait */
		y-offset = <0>;		/* portrait */

		vcom = <0x1f>;
		gctrl = <0x35>;
		vrhs = <0x12>;
		vdvs = <0x20>;
		mdac = <0x00>;		/* portrait */
		gamma = <0x01>;
		lcm = <0x2c>;
		porch-param = [0C 0C 00 33 33];
		cmd2en-param = [5A 69 02 01];
		pwctrl1-param = [A4 A1];
		pvgam-param = [D0 08 11 08 0C 15 39 33 50 36 13 14 29 2D];
		nvgam-param = [D0 08 10 08 06 06 39 44 51 0B 16 14 2F 31];
		ram-param = [00 F0];
		rgb-param = [CD 08 14];
	};
};

lcd_panel: &st7789v_240x240pt {};
