/*
 * SPDX-FileCopyrightText: Copyright (c) 2023-2026 TiaC Systems
 * SPDX-License-Identifier: Apache-2.0
 */

&ili9488_480x320 {
	rotation = <270>;		/* landscape */
	/delete-property/ h-mirror;	/* mirrored */
};
