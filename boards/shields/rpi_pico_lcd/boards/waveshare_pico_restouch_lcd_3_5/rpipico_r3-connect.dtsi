/*
 * Copyright (c) 2024 TiaC Systems
 * SPDX-License-Identifier: Apache-2.0
 */

#include <freq.h>

&pico_spi1 {
	pinctrl-0 = <&spi1_pico>;
	pinctrl-names = "default";
	clock-frequency = <DT_FREQ_M(60)>;
};

rpipico_spi_lcd: &pico_spi1 {};
rpipico_spi_tsc: &pico_spi1 {};
rpipico_spi_sdc: &pico_spi1 {};
