/*
 * Copyright (c) 2023 TiaC Systems
 * SPDX-License-Identifier: Apache-2.0
 */

#include <freq.h>
#include <zephyr/dt-bindings/display/ili9xxx.h>

&rpipico_spi_tsc {
	xpt2046_320x480: xpt2046@1 {
		compatible = "xptek,xpt2046";
		spi-max-frequency = <DT_FREQ_M(3)>;
		reg = <1>;

		status = "disabled";

		touchscreen-size-x = <320>;	/* portrait */
		min-x = <1536>;
		max-x = <4095>;

		touchscreen-size-y = <480>;	/* portrait */
		min-y = <768>;
		max-y = <3712>;

		z-threshold = <50>;
		reads = <1>;
	};
};

tsc_panel: &xpt2046_320x480 {};
