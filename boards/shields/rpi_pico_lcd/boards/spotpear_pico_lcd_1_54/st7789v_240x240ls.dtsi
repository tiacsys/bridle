/*
 * Copyright (c) 2024 TiaC Systems
 * SPDX-License-Identifier: Apache-2.0
 */

#include <freq.h>
#include <zephyr/dt-bindings/mipi_dbi/mipi_dbi.h>

&mipi_dbi {
	st7789v_240x240ls: st7789v@0 {
		compatible = "sitronix,st7789v";
		mipi-max-frequency = <DT_FREQ_M(20)>;
		mipi-mode = <MIPI_DBI_MODE_SPI_4WIRE>;
		reg = <0>;

		status = "disabled";

		width = <240>;		/* landscape */
		height = <240>;		/* landscape */
		x-offset = <0>;		/* landscape */
		y-offset = <0>;		/* landscape */

		vcom = <0x19>;
		gctrl = <0x35>;
		vrhs = <0x12>;
		vdvs = <0x20>;
		mdac = <0x60>;		/* landscape */
		gamma = <0x01>;
		lcm = <0x2c>;
		porch-param = [0C 0C 00 33 33];
		cmd2en-param = [5A 69 02 01];
		pwctrl1-param = [A4 A1];
		pvgam-param = [D0 04 0D 11 13 2B 3F 54 4C 18 0D 0B 1F 23];
		nvgam-param = [D0 04 0C 11 13 2C 3F 44 51 2F 1F 1F 20 23];
		ram-param = [00 F0];
		rgb-param = [CD 08 14];
	};
};

lcd_panel: &st7789v_240x240ls {};
