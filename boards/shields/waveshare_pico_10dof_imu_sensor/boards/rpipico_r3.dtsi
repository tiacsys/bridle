/*
 * Copyright (c) 2024-2025 TiaC Systems
 * SPDX-License-Identifier: Apache-2.0
 */

#include <zephyr/dt-bindings/i2c/i2c.h>

&rpipico_i2c1 {
	status = "okay";
	clock-frequency = <I2C_BITRATE_FAST>;

	wsptdis_sens_dof: mpu9250@68 {
		status = "disabled";
		compatible = "invensense,mpu9250";
		friendly-name = "WSP 10-DOF IMU: accelerometer, gyroscope, magnetometer (9-DOF)";
		reg = <0x68>;
		accel-fs = <2>;
		accel-dlpf = "5.05";
		gyro-fs = <250>;
		gyro-dlpf = <5>;
		gyro-sr-div = <9>;
	};

	wsptdis_sens_tp: lps22hb@5c {
		status = "disabled";
		compatible = "st,lps22hb-press";
		friendly-name = "WSP 10-DOF IMU: absolute air pressure with ambient temperature";
		reg = <0x5c>;
	};
};
