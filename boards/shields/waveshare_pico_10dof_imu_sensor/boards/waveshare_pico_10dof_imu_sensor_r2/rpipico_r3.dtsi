/*
 * SPDX-FileCopyrightText: Copyright (c) 2024-2026 TiaC Systems
 * SPDX-License-Identifier: Apache-2.0
 */

#include <zephyr/dt-bindings/gpio/gpio.h>

#include <zephyr/dt-bindings/gpio/raspberrypi-pico-header-r3.h>

&rpipico_i2c0 {
	/*
	 * The default I2C0 signals conflict with default interrupts
	 * on the shield for GP4 @ MPU9250 and GP5 @ LPS22HB.
	 */
	status = "disabled";
};

&wsptdis_sens_dof {
	status = "okay";
	irq-gpios = <&rpipico_header RPIPICO_HEADER_R3_D4 GPIO_ACTIVE_HIGH>;	/* GP4 */
	/*
	 * Frame synchronize connected at GP22 but not supported by driver:
	 * fsync-gpios = <&rpipico_header RPIPICO_HEADER_R3_D22 GPIO_ACTIVE_HIGH>;
	 */
};

&wsptdis_sens_tp {
	status = "okay";
	/*
	 * Interrupt request connected at GP5 but not supported by driver:
	 * irq-gpios = <&rpipico_header RPIPICO_HEADER_R3_D5 GPIO_ACTIVE_HIGH>;
	 */
};
