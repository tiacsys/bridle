/*
 * Copyright (c) 2024 TiaC Systems
 * SPDX-License-Identifier: Apache-2.0
 */

#include <zephyr/sensing/sensing_sensor_types.h>

/ {
	wsptdis_sensing: wsptdis-sensing {
		compatible = "zephyr,sensing";
		status = "disabled";

		wsptdis_accel: wsptdis-accel {
			compatible = "zephyr,sensing-phy-3d-sensor";
			status = "disabled";
			sensor-types = <SENSING_SENSOR_TYPE_MOTION_ACCELEROMETER_3D
					SENSING_SENSOR_TYPE_MOTION_GYROMETER_3D
					SENSING_SENSOR_TYPE_MOTION_MOTION_DETECTOR>;
			friendly-name = "WSP 10-DOF IMU Shield Accelerometer";
			minimal-interval = <625>;
			underlying-device = <&wsptdis_sens_dof>;
		};
	};
};
