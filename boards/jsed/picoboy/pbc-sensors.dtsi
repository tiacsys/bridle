/*
 * Copyright (c) 2023-2025 TiaC Systems
 * SPDX-License-Identifier: Apache-2.0
 */

&i2c0 {
	status = "okay";	/* default sensor/io */
};

&uart1 {
	status = "disabled";	/* alternative sensor/io */
};

&adc {
	status = "okay";
};

&die_temp {
	status = "okay";
};
