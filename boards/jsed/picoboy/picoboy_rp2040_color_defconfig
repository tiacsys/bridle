## boards/jsed/picoboy/picoboy_rp2040_color_defconfig
```kconfig
# Copyright (c) 2023-2025 TiaC Systems
# SPDX-License-Identifier: Apache-2.0

CONFIG_SYS_CLOCK_HW_CYCLES_PER_SEC=125000000
CONFIG_CONSOLE=y
CONFIG_UART_CONSOLE=y
CONFIG_UART_LINE_CTRL=y
CONFIG_UART_INTERRUPT_DRIVEN=y
CONFIG_SERIAL=y
CONFIG_USB_DEVICE_STACK=y
CONFIG_USB_DEVICE_VID=0x2E8A
CONFIG_USB_DEVICE_PID=0x000A
CONFIG_USB_DEVICE_MANUFACTURER="JSED (Raspberry Pi)"
CONFIG_USB_DEVICE_PRODUCT="PicoBoy Color (CDC ACM)"
CONFIG_USB_DEVICE_INITIALIZE_AT_BOOT=y
CONFIG_USE_DT_CODE_PARTITION=y
CONFIG_BUILD_OUTPUT_UF2=y
CONFIG_BUILD_OUTPUT_HEX=y
```

## boards/nios2/intel_dk_dev_10m50/Kconfig.board
```kconfig
# SPDX-License-Identifier: Apache-2.0

config BOARD_INTEL_DK_DEV_10M50
	bool "Intel MAX 10 FPGA Development Kit"
	depends on SOC_NIOS2F_ZEPHYR
```

## boards/nios2/intel_dk_dev_10m50/intel_dk_dev_10m50_defconfig
```kconfig
# SPDX-License-Identifier: Apache-2.0

CONFIG_SOC_NIOS2F_ZEPHYR=y
CONFIG_BOARD_INTEL_DK_DEV_10M50=y
CONFIG_HAS_ALTERA_HAL=y
CONFIG_CONSOLE=y
CONFIG_PRINTK=y
CONFIG_SERIAL=y
CONFIG_UART_NS16550=y
CONFIG_UART_CONSOLE=y
```

## boards/nologo/mini_usb_rp2350/Kconfig.defconfig
```kconfig
# Copyright (c) 2025 TiaC Systems
# SPDX-License-Identifier: Apache-2.0

config CLOCK_CONTROL
	default y
	depends on DT_HAS_RASPBERRYPI_PICO_CLOCK_ENABLED && \
		   DT_HAS_RASPBERRYPI_PICO_CLOCK_CONTROLLER_ENABLED

config REGULATOR
	default y
	depends on DT_HAS_RASPBERRYPI_CORE_SUPPLY_REGULATOR_ENABLED

config RESET
	default y
	depends on DT_HAS_RASPBERRYPI_PICO_RESET_ENABLED

config WATCHDOG
	default y
	depends on DT_HAS_RASPBERRYPI_PICO_WATCHDOG_ENABLED

config WDT_DISABLE_AT_BOOT
	default y if BOARD_MINI_USB_RP2350
	depends on WATCHDOG && HAS_WDT_DISABLE_AT_BOOT

config COUNTER
	default y
	depends on DT_HAS_RASPBERRYPI_PICO_TIMER_ENABLED

config DMA
	default y
	depends on DT_HAS_RASPBERRYPI_PICO_DMA_ENABLED

config GPIO
	default y
	depends on DT_HAS_RASPBERRYPI_PICO_GPIO_ENABLED

config PWM
	default y
	depends on DT_HAS_RASPBERRYPI_PICO_PWM_ENABLED

# Workaround for not being able to have commas in macro arguments
DT_CHOSEN_Z_CONSOLE := zephyr,console
DT_COMPAT_Z_CDC_ACM_UART := zephyr,cdc-acm-uart
DT_COMPAT_RPIPICO_USB := raspberrypi,pico-usbd

# Macros to shorten Kconfig expressions
DT_CHOSEN_CONSOLE_NODE := $(dt_chosen_path,$(DT_CHOSEN_Z_CONSOLE))
DT_CHOSEN_CONSOLE_PARENT := $(dt_node_parent,$(DT_CHOSEN_CONSOLE_NODE))

if BOARD_MINI_USB_RP2350 && \
	$(dt_chosen_enabled,$(DT_CHOSEN_Z_CONSOLE)) && \
	$(dt_compat_on_bus,$(DT_COMPAT_Z_CDC_ACM_UART),usb) && \
	$(dt_node_has_compat,$(DT_CHOSEN_CONSOLE_PARENT),$(DT_COMPAT_RPIPICO_USB))

config CDC_ACM_SERIAL_SELF_POWERED
	default n
	depends on USB_DEVICE_STACK_NEXT && USBD_CDC_ACM_CLASS

config CDC_ACM_SERIAL_MAX_POWER
	default 125 if BOARD_MINI_USB_RP2350	# 250mA
	depends on USB_DEVICE_STACK_NEXT && USBD_CDC_ACM_CLASS

# Logger cannot use itself to log
choice USBD_CDC_ACM_LOG_LEVEL_CHOICE
	default USBD_CDC_ACM_LOG_LEVEL_OFF
	depends on LOG && USB_DEVICE_STACK_NEXT && USBD_CDC_ACM_CLASS
endchoice

# Set USB log level to error only
choice USBD_LOG_LEVEL_CHOICE
	default USBD_LOG_LEVEL_ERR
	depends on LOG && USB_DEVICE_STACK_NEXT && USBD_CDC_ACM_CLASS
endchoice

# Set UDC driver log level to error only
choice UDC_DRIVER_LOG_LEVEL_CHOICE
	default UDC_DRIVER_LOG_LEVEL_ERR
	depends on LOG && USB_DEVICE_STACK_NEXT && USBD_CDC_ACM_CLASS
endchoice

endif # zephyr,cdc-acm-uart
```

## boards/nologo/mini_usb_rp2350/mini_usb_rp2350_rp2350a_m33_defconfig
```kconfig
# Copyright (c) 2025 TiaC Systems
# SPDX-License-Identifier: Apache-2.0

CONFIG_BUILD_OUTPUT_UF2=y
CONFIG_BUILD_OUTPUT_HEX=y

CONFIG_RESET=y
CONFIG_CLOCK_CONTROL=y
CONFIG_USE_DT_CODE_PARTITION=y

CONFIG_CONSOLE=y
CONFIG_SERIAL=y
CONFIG_UART_CONSOLE=y
CONFIG_UART_LINE_CTRL=y
CONFIG_UART_INTERRUPT_DRIVEN=y

CONFIG_USB_DEVICE_STACK=y
CONFIG_USB_DEVICE_VID=0x2E8A
CONFIG_USB_DEVICE_PID=0x000A
CONFIG_USB_DEVICE_MANUFACTURER="Nologo (Raspberry Pi)"
CONFIG_USB_DEVICE_PRODUCT="Mini USB RP2350 (CDC ACM)"
CONFIG_USB_DEVICE_INITIALIZE_AT_BOOT=y
```

## boards/nxp/mimxrt1010_evk/Kconfig.mimxrt1010_evk
```kconfig
# Copyright (c) 2026 TiaC Systems
# SPDX-License-Identifier: Apache-2.0

config BOARD_MIMXRT1010_EVK_MIMXRT1011
	bool

config BOARD_MIMXRT1010_EVK_MIMXRT1011_BBE
	bool
	select BOARD_MIMXRT1010_EVK_MIMXRT1011
```

## boards/nxp/mimxrt1010_evk/board.yml
```yaml
# Copyright (c) 2026 TiaC Systems
# SPDX-License-Identifier: Apache-2.0

board:
  extend: mimxrt1010_evk
  variants:
    - name: bbe
      qualifier: mimxrt1011
```

## boards/nxp/mimxrt1010_evk/mimxrt1010_evk_bbe_defconfig
```kconfig
# Copyright (c) 2026 TiaC Systems
# SPDX-License-Identifier: Apache-2.0
#
# NOTE: copy and own from original default configuration in
# "zephyr/boards/st/mimxrt1010_evk/mimxrt1010_evk_defconfig"

CONFIG_CONSOLE=y
CONFIG_UART_CONSOLE=y
CONFIG_SERIAL=y
CONFIG_GPIO=y
CONFIG_ARM_MPU=y
CONFIG_HW_STACK_PROTECTION=y
```

## boards/nxp/mimxrt1060_evk/Kconfig.mimxrt1060_evk
```kconfig
# Copyright (c) 2026 TiaC Systems
# SPDX-License-Identifier: Apache-2.0

config BOARD_MIMXRT1060_EVK_MIMXRT1062_HYPERFLASH
	bool

config BOARD_MIMXRT1060_EVK_MIMXRT1062_HYPERFLASH_BBE
	bool
	select BOARD_MIMXRT1060_EVK_MIMXRT1062_HYPERFLASH

config BOARD_MIMXRT1060_EVK_MIMXRT1062_QSPI
	bool

config BOARD_MIMXRT1060_EVK_MIMXRT1062_QSPI_BBE
	bool
	select BOARD_MIMXRT1060_EVK_MIMXRT1062_QSPI
```

## boards/nxp/mimxrt1060_evk/board.yml
```yaml
# Copyright (c) 2026 TiaC Systems
# SPDX-License-Identifier: Apache-2.0

board:
  extend: mimxrt1060_evk
  variants:
    - name: bbe
      qualifier: mimxrt1062/qspi
    - name: bbe
      qualifier: mimxrt1062/hyperflash
```

## boards/nxp/mimxrt1060_evk/mimxrt1060_evk_mimxrt1062_qspi_bbe_defconfig
```kconfig
# Copyright (c) 2026 TiaC Systems
# SPDX-License-Identifier: Apache-2.0
#
# NOTE: copy and own from original default configuration in
# "zephyr/boards/st/mimxrt1060_evk/mimxrt1060_evk_mimxrt1062_qspi_defconfig"

CONFIG_CONSOLE=y
CONFIG_UART_CONSOLE=y
CONFIG_SERIAL=y
CONFIG_GPIO=y
CONFIG_ARM_MPU=y
CONFIG_HW_STACK_PROTECTION=y
```

## boards/nxp/mimxrt1170_evk/Kconfig.mimxrt1170_evk
```kconfig
# Copyright (c) 2026 TiaC Systems
# SPDX-License-Identifier: Apache-2.0

config BOARD_MIMXRT1170_EVK_MIMXRT1176_CM4
	bool
	select BOARD_MIMXRT1170_EVK_MIMXRT1176_CM4_BBE

config BOARD_MIMXRT1170_EVK_MIMXRT1176_CM4_BBE
	bool

config BOARD_MIMXRT1170_EVK_MIMXRT1176_CM7
	bool
	select BOARD_MIMXRT1170_EVK_MIMXRT1176_CM7_BBE

config BOARD_MIMXRT1170_EVK_MIMXRT1176_CM7_BBE
	bool
```

## boards/raspberrypi/rpi_pico/Kconfig.rpi_pico
```kconfig
# Copyright (c) 2026 TiaC Systems
# SPDX-License-Identifier: Apache-2.0

config BOARD_RPI_PICO_RP2040
	bool

config BOARD_RPI_PICO_RP2040_BBE
	bool
	select BOARD_RPI_PICO_RP2040

config BOARD_RPI_PICO_RP2040_W
	bool

config BOARD_RPI_PICO_RP2040_W_BBE
	bool
	select BOARD_RPI_PICO_RP2040_W

config BOARD_RPI_PICO_RP2040_MCUBOOT
	bool

config BOARD_RPI_PICO_RP2040_MCUBOOT_BBE
	bool
	select BOARD_RPI_PICO_RP2040_MCUBOOT

config BOARD_RPI_PICO_RP2040_W_MCUBOOT
	bool

config BOARD_RPI_PICO_RP2040_W_MCUBOOT_BBE
	bool
	select BOARD_RPI_PICO_RP2040_W_MCUBOOT
```

## boards/raspberrypi/rpi_pico/board.yml
```yaml
# Copyright (c) 2026 TiaC Systems
# SPDX-License-Identifier: Apache-2.0

board:
  extend: rpi_pico
  variants:
    - name: bbe
      qualifier: rp2040
    - name: bbe
      qualifier: rp2040/mcuboot
    - name: bbe
      qualifier: rp2040/w
    - name: bbe
      qualifier: rp2040/w/mcuboot
```

## boards/raspberrypi/rpi_pico/rpi_pico_rp2040_bbe_defconfig
```kconfig
# Copyright (c) 2024-2026 TiaC Systems
# SPDX-License-Identifier: Apache-2.0
#
# NOTE: copy and own from original default configuration in
# "zephyr/boards/raspberrypi/rpi_pico/rpi_pico_defconfig"

CONFIG_SERIAL=y
CONFIG_CONSOLE=y
CONFIG_UART_CONSOLE=y
CONFIG_GPIO=y
CONFIG_USE_DT_CODE_PARTITION=y
CONFIG_BUILD_OUTPUT_UF2=y
CONFIG_BUILD_OUTPUT_HEX=y
CONFIG_UART_INTERRUPT_DRIVEN=y
CONFIG_RESET=y
CONFIG_CLOCK_CONTROL=y
```

## boards/raspberrypi/rpi_pico2/rpi_pico2_rp2350a_m33_w_mcuboot_bbe_defconfig
```kconfig
# Copyright (c) 2025-2026 TiaC Systems
# SPDX-License-Identifier: Apache-2.0
#
# NOTE: copy and own from original default configuration in
# "zephyr/boards/raspberrypi/rpi_pico2/rpi_pico2_rp2350a_m33_w_mcuboot_defconfig"

# This configuration is orthogonal to whether the Cortex-M33 or Hazard3 cores
# are in use, but Zephyr does not support providing a qualifier-agnostic
# _defconfig file.
CONFIG_BUILD_OUTPUT_HEX=y
CONFIG_BUILD_OUTPUT_UF2=y
CONFIG_CLOCK_CONTROL=y
CONFIG_CONSOLE=y
CONFIG_GPIO=y
CONFIG_RESET=y
CONFIG_SERIAL=y
CONFIG_UART_CONSOLE=y
CONFIG_UART_INTERRUPT_DRIVEN=y
CONFIG_USE_DT_CODE_PARTITION=y
```

## boards/seeed/seeeduino_cm0/Kconfig.seeeduino_cm0
```kconfig
# Seeeduino Cortex-M0+ board configuration

# Copyright (c) 2023-2024 TiaC Systems
# SPDX-License-Identifier: Apache-2.0

config BOARD_SEEEDUINO_CM0
	select SOC_SAMD21G18A
```

## boards/seeed/seeeduino_lotus/board.yml
```yaml
board:
  name: seeeduino_lotus
  full_name: Seeeduino Lotus Cortex-M0+
  vendor: seeed
  socs:
    - name: samd21g18a
```

## boards/seeed/seeeduino_xiao/Kconfig.seeeduino_xiao
```kconfig
# Copyright (c) 2026 TiaC Systems
# SPDX-License-Identifier: Apache-2.0

config BOARD_SEEEDUINO_XIAO_SAMD21G18A
	bool

config BOARD_SEEEDUINO_XIAO_SAMD21G18A_BBE
	bool
	select BOARD_SEEEDUINO_XIAO_SAMD21G18A
```

## boards/seeed/seeeduino_xiao/board.yml
```yaml
# Copyright (c) 2026 TiaC Systems
# SPDX-License-Identifier: Apache-2.0

board:
  extend: seeeduino_xiao
  variants:
    - name: bbe
      qualifier: samd21g18a
```

## boards/seeed/xiao_rp2040/Kconfig.xiao_rp2040
```kconfig
# Copyright (c) 2026 TiaC Systems
# SPDX-License-Identifier: Apache-2.0

config BOARD_XIAO_RP2040_RP2040
	bool

config BOARD_XIAO_RP2040_RP2040_BBE
	bool
	select BOARD_XIAO_RP2040_RP2040
```

## boards/seeed/xiao_rp2040/board.yml
```yaml
# Copyright (c) 2026 TiaC Systems
# SPDX-License-Identifier: Apache-2.0

board:
  extend: xiao_rp2040
  variants:
    - name: bbe
      qualifier: rp2040
```

## boards/seeed/xiao_samd21/Kconfig.defconfig
```kconfig
# XIAO SAMD21 (Seeeduino XIAO) board configuration

# Copyright (c) 2023-2025 TiaC Systems
# Copyright (c) 2020 Google LLC.
# SPDX-License-Identifier: Apache-2.0

# Workaround for not being able to have commas in macro arguments
DT_CHOSEN_Z_CONSOLE := zephyr,console
DT_COMPAT_Z_CDC_ACM_UART := zephyr,cdc-acm-uart
DT_COMPAT_ATMEL_USB := atmel,sam0-usb

# Macros to shorten Kconfig expressions
DT_CHOSEN_CONSOLE_NODE := $(dt_chosen_path,$(DT_CHOSEN_Z_CONSOLE))
DT_CHOSEN_CONSOLE_PARENT := $(dt_node_parent,$(DT_CHOSEN_CONSOLE_NODE))

if BOARD_XIAO_SAMD21 && \
	$(dt_chosen_enabled,$(DT_CHOSEN_Z_CONSOLE)) && \
	$(dt_compat_on_bus,$(DT_COMPAT_Z_CDC_ACM_UART),usb) && \
	$(dt_node_has_compat,$(DT_CHOSEN_CONSOLE_PARENT),$(DT_COMPAT_ATMEL_USB))

config BOOTLOADER_BOSSA_DEVICE_NAME
	default "$(dt_chosen_label,$(DT_CHOSEN_Z_CONSOLE))"
	depends on USB_CDC_ACM

config CDC_ACM_SERIAL_SELF_POWERED
	default n
	depends on USB_DEVICE_STACK_NEXT && USBD_CDC_ACM_CLASS

config CDC_ACM_SERIAL_MAX_POWER
	default 250 if BOARD_XIAO_SAMD21	# 500mA
	depends on USB_DEVICE_STACK_NEXT && USBD_CDC_ACM_CLASS

# Logger cannot use itself to log
choice USBD_CDC_ACM_LOG_LEVEL_CHOICE
	default USBD_CDC_ACM_LOG_LEVEL_OFF
	depends on LOG && USB_DEVICE_STACK_NEXT && USBD_CDC_ACM_CLASS
endchoice

# Set USB log level to error only
choice USBD_LOG_LEVEL_CHOICE
	default USBD_LOG_LEVEL_ERR
	depends on LOG && USB_DEVICE_STACK_NEXT && USBD_CDC_ACM_CLASS
endchoice

# Set UDC driver log level to error only
choice UDC_DRIVER_LOG_LEVEL_CHOICE
	default UDC_DRIVER_LOG_LEVEL_ERR
	depends on LOG && USB_DEVICE_STACK_NEXT && USBD_CDC_ACM_CLASS
endchoice

endif # zephyr,cdc-acm-uart
```

## boards/seeed/xiao_samd21/Kconfig.seeed_xiao_samd21
```kconfig
# Seeed Studio XIAO SAMD21 (Seeeduino XIAO) board configuration

# Copyright (c) 2023-2024 TiaC Systems
# Copyright (c) 2024 Gerson Fernando Budke <nandojve@gmail.com>
# Copyright (c) 2020 Google LLC.
# SPDX-License-Identifier: Apache-2.0

config BOARD_SEEED_XIAO_SAMD21
	select SOC_SAMD21G18A
```

## boards/seeed/xiao_samd21/board.yml
```yaml
# Copyright (c) 2023-2026 TiaC Systems
# SPDX-License-Identifier: Apache-2.0

board:
  name: xiao_samd21
  full_name: XIAO SAMD21
  vendor: seeed
  socs:
    - name: samd21g18a
```
