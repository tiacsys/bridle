/*
 * Copyright (c) 2023-2025 TiaC Systems
 * SPDX-License-Identifier: Apache-2.0
 */

#include "pb-sensors.dtsi"

&stk8ba58 {
	/* GP22 as INT1 from STK8BA58 accelerometer sensor. */
	irq-gpios = <&gpio0 22 GPIO_ACTIVE_HIGH>;
};

&die_temp {
        status = "okay";
        friendly-name = "RP2350 chip temperature";
};
