/*
 * Copyright (c) 2023-2025 TiaC Systems
 * SPDX-License-Identifier: Apache-2.0
 */

/dts-v1/;

/ {
	model = "JSED PicoBoy @ USB-CDC/ACM Concole";
	compatible = "jsed,picoboy", "jsed,picoboy-usbcons";

	chosen {
		zephyr,console = &cdc_acm_console_uart;
		zephyr,shell-uart = &cdc_acm_console_uart;
	};
};

#include "picoboy_rp2040.dtsi"

#include "picoboy-core.dtsi"
#include "picoboy-2mb.dtsi"

#include "picoboy-joystick.dtsi"
#include "picoboy-sensors.dtsi"
#include "picoboy-speaker.dtsi"
#include "picoboy-leds.dtsi"
#include "picoboy-oled.dtsi"
