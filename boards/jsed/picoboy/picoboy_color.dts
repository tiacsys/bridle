/*
 * Copyright (c) 2023-2025 TiaC Systems
 * SPDX-License-Identifier: Apache-2.0
 */

/dts-v1/;

/ {
	model = "JSED PicoBoy Color @ USB-CDC/ACM Concole";
	compatible = "jsed,picoboy-color", "jsed,picoboy-color-usbcons";

	chosen {
		zephyr,console = &cdc_acm_console_uart;
		zephyr,shell-uart = &cdc_acm_console_uart;
	};
};

#include "picoboy_color.dtsi"

#include "picoboy-core.dtsi"

#include "pbc-2mb.dtsi"
#include "pbc-joystick.dtsi"
#include "pbc-sensors.dtsi"
#include "pbc-speaker.dtsi"
#include "pbc-leds.dtsi"
#include "pbc-lcd.dtsi"
