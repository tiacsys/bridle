/*
 * Copyright (c) 2025 TiaC Systems
 * SPDX-License-Identifier: Apache-2.0
 */

#include <mem.h>

#include "mini_usb_rp2040-flash.dtsi"

&flash0 {
	status = "okay";
	reg = <0x10000000 DT_SIZE_M(4)>;
};

/*
 * Usable flash. Starts after the RP2040 second stage bootloader. The
 * partition size is 4MB minus the 0x100 bytes taken by the RP2040
 * second stage bootloader.
 */
&code_partition {
	reg = <0x00000100 (DT_SIZE_M(4) - 0x100)>;
};
