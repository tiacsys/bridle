/*
 * Copyright (c) 2025 TiaC Systems
 * SPDX-License-Identifier: Apache-2.0
 */

#include <mem.h>

#include "mini_usb_rp2040-flash.dtsi"
#include <raspberrypi/partitions_2M_default.dtsi>

&flash0 {
	reg = <0x10000000 DT_SIZE_M(16)>;
};

&storage_partition {
	reg = <0x100000 DT_SIZE_M(15)>;
};
