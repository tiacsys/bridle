/*
 * SPDX-FileCopyrightText: Copyright (c) 2025-2026 TiaC Systems
 * SPDX-License-Identifier: Apache-2.0
 */

#include <mem.h>

#include <raspberrypi/partitions_2M_default.dtsi>

#include "mini_usb_rp2040-chipled.dtsi"

/ {
	model = "Nologo Mini USB RP2040 (4MB with Chip-LED) @ USB-CDC/ACM Concole";
	compatible = "nologo,mini-usb-rp2040",
		     "nologo,mini-usb-rp2040-usbcons",
		     "nologo,mini-usb-rp2040-4mb-chipled",
		     "nologo,mini-usb-rp2040-4mb-chipled-usbcons";

	chosen {
		zephyr,flash = &flash0;
		zephyr,flash-controller = &ssi;
		zephyr,code-partition = &code_partition;
	};
};

&flash0 {
	status = "okay";
	reg = <0x10000000 DT_SIZE_M(4)>;
	ranges = <0x0 0x10000000 DT_SIZE_M(4)>;
};

&storage_partition {
	reg = <0x100000 DT_SIZE_M(3)>;
};
