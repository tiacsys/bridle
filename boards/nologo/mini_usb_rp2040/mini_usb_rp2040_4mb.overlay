/*
 * Copyright (c) 2025 TiaC Systems
 * SPDX-License-Identifier: Apache-2.0
 */

#include "mini_usb_rp2040-4mb.dtsi"
#include "mini_usb_rp2040-neopixel.dtsi"

/ {
	model = "Nologo Mini USB RP2040 (4MB) @ USB-CDC/ACM Concole";
	compatible = "nologo,mini-usb-rp2040",
		     "nologo,mini-usb-rp2040-usbcons",
		     "nologo,mini-usb-rp2040-4mb",
		     "nologo,mini-usb-rp2040-4mb-usbcons";

	aliases {
		led-strip = &ws2812_single;
	};
};
