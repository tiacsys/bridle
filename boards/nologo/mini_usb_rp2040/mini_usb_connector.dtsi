/*
 * Copyright (c) 2025 TiaC Systems
 * SPDX-License-Identifier: Apache-2.0
 */

/ {
	miniusb_header: connector {
		compatible = "waveshare,miniusb-header";
		#gpio-cells = <2>;
		gpio-map-mask = <0xffffffff 0xffffffc0>;
		gpio-map-pass-thru = <0 0x3f>;
		gpio-map = <0 0 &gpio0 0 0>,	/* UART0 / GP0 */
			   <1 0 &gpio0 1 0>,	/* UART0 / GP1 */
			   <2 0 &gpio0 2 0>,	/* GP2 (UART0) */
			   <3 0 &gpio0 3 0>,	/* GP3 (UART0) */
			   <4 0 &gpio0 4 0>,	/* SPI0 / GP4 */
			   <5 0 &gpio0 5 0>,	/* SPI0 / GP5 */
			   <6 0 &gpio0 6 0>,	/* SPI0 / GP6 */
			   <7 0 &gpio0 7 0>,	/* SPI0 / GP7 */
			   <8 0 &gpio0 8 0>,	/* GP8 */
			   <9 0 &gpio0 14 0>,	/* I2C1 / GP14 */
			   <10 0 &gpio0 15 0>,	/* I2C1 / GP15 */
			   <11 0 &gpio0 26 0>,	/* ADC0 / GP26 */
			   <12 0 &gpio0 27 0>,	/* ADC1 / GP27 */
			   <13 0 &gpio0 28 0>,	/* ADC2 / GP28 */
			   <14 0 &gpio0 29 0>;	/* ADC3 / GP28 */
	};
};

&gpio0 {
	status = "okay";
};
