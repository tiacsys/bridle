/*
 * Copyright (c) 2025 TiaC Systems
 * SPDX-License-Identifier: Apache-2.0
 */

/ {
	miniusb_pcbpads: solder-pads {
		compatible = "nologo,miniusb-pcbpads";
		#gpio-cells = <2>;
		gpio-map-mask = <0xffffffff 0xffffffc0>;
		gpio-map-pass-thru = <0 0x3f>;
		gpio-map = <0 0 &gpio0 9 0>,	/* GP9 */
			   <1 0 &gpio0 10 0>,	/* GP10 */
			   <2 0 &gpio0 11 0>,	/* GP11 */
			   <3 0 &gpio0 12 0>,	/* GP12 */
			   <4 0 &gpio0 13 0>,	/* GP13 */
			   <5 0 &gpio0 18 0>,	/* GP18 */
			   <6 0 &gpio0 19 0>,	/* GP19 */
			   <7 0 &gpio0 20 0>,	/* GP20 */
			   <8 0 &gpio0 21 0>,	/* GP21 */
			   <9 0 &gpio0 22 0>,	/* GP22 */
			   <10 0 &gpio0 23 0>,	/* GP23 */
			   <11 0 &gpio0 24 0>,	/* GP24 */
			   <12 0 &gpio0 25 0>;	/* GP25 */
	};
};

&gpio0 {
	status = "okay";
};
