/*
 * Copyright (c) 2025 TiaC Systems
 * SPDX-License-Identifier: Apache-2.0
 */

#include <mem.h>

#include "mini_usb_rp2350-flash.dtsi"

&flash0 {
	status = "okay";
	reg = <0x10000000 DT_SIZE_M(16)>;
};

&code_partition {
	reg = <0x00000000 DT_SIZE_M(16)>;
};
