/*
 * Copyright (c) 2025-2026 TiaC Systems
 * SPDX-License-Identifier: Apache-2.0
 */

#include <mem.h>

&spi1 {
	status = "disabled";
	pinctrl-0 = <&spi1_default>;
	pinctrl-names = "default";
	clock-frequency = <DT_FREQ_M(8)>;
};

pico_spi1: &spi1 {};
