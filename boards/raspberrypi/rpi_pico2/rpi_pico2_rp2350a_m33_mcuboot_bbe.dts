/*
 * Copyright (c) 2025-2026 TiaC Systems
 * SPDX-License-Identifier: Apache-2.0
 */

#include "../../zephyr/boards/raspberrypi/rpi_pico2/rpi_pico2_rp2350a_m33_mcuboot.dts"

/ {
	model = "Raspberry Pi Pico 2 (Cortex-M33) - MCUboot @ UART Concole (BBE)";
	compatible = "raspberrypi,rpi-pico2-mcuboot",
		     "raspberrypi,rpi-pico2-mcuboot-bbe",
		     "raspberrypi,rpi-pico2-mcuboot-uartcons",
		     "raspberrypi,rpi-pico2-mcuboot-uartcons-bbe";

	chosen {
		zephyr,console = &uart0;
		zephyr,shell-uart = &uart0;
	};
};

#include "rpipico_r3.dtsi"
