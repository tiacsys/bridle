/*
 * Copyright (c) 2024-2026 TiaC Systems
 * SPDX-License-Identifier: Apache-2.0
 */

#include "../../zephyr/boards/raspberrypi/rpi_pico/rpi_pico_rp2040_w.dts"

/ {
	model = "Raspberry Pi Pico W @ UART Concole (BBE)";
	compatible = "raspberrypi,rpi-pico-w",
		     "raspberrypi,rpi-pico-w-bbe",
		     "raspberrypi,rpi-pico-w-uartcons",
		     "raspberrypi,rpi-pico-w-uartcons-bbe";

	chosen {
		zephyr,console = &uart0;
		zephyr,shell-uart = &uart0;
	};
};

#include "rpipico_r3.dtsi"
