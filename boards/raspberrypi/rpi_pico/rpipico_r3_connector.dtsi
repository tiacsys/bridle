/*
 * SPDX-FileCopyrightText: Copyright (c) 2025-2026 TiaC Systems
 * SPDX-License-Identifier: Apache-2.0
 */

#include <zephyr/dt-bindings/gpio/raspberrypi-pico-header-r3.h>

/ {
	rpipico_header: pico-connector-r3 {
		compatible = "raspberrypi,pico-header-r3";
		#gpio-cells = <2>;
		gpio-map-mask = <0xffffffff 0xffffffc0>;
		gpio-map-pass-thru = <0 0x3f>;
		gpio-map = <RPIPICO_HEADER_R3_D0 0 &gpio0 0 0>,		/* GP0 */
			   <RPIPICO_HEADER_R3_D1 0 &gpio0 1 0>,		/* GP1 */
			   <RPIPICO_HEADER_R3_D2 0 &gpio0 2 0>,		/* GP2 */
			   <RPIPICO_HEADER_R3_D3 0 &gpio0 3 0>,		/* GP3 */
			   <RPIPICO_HEADER_R3_D4 0 &gpio0 4 0>,		/* GP4 */
			   <RPIPICO_HEADER_R3_D5 0 &gpio0 5 0>,		/* GP5 */
			   <RPIPICO_HEADER_R3_D6 0 &gpio0 6 0>,		/* GP6 */
			   <RPIPICO_HEADER_R3_D7 0 &gpio0 7 0>,		/* GP7 */
			   <RPIPICO_HEADER_R3_D8 0 &gpio0 8 0>,		/* GP8 */
			   <RPIPICO_HEADER_R3_D9 0 &gpio0 9 0>,		/* GP9 */
			   <RPIPICO_HEADER_R3_D10 0 &gpio0 10 0>,	/* GP10 */
			   <RPIPICO_HEADER_R3_D11 0 &gpio0 11 0>,	/* GP11 */
			   <RPIPICO_HEADER_R3_D12 0 &gpio0 12 0>,	/* GP12 */
			   <RPIPICO_HEADER_R3_D13 0 &gpio0 13 0>,	/* GP13 */
			   <RPIPICO_HEADER_R3_D14 0 &gpio0 14 0>,	/* GP14 */
			   <RPIPICO_HEADER_R3_D15 0 &gpio0 15 0>,	/* GP15 */
			   <RPIPICO_HEADER_R3_D16 0 &gpio0 16 0>,	/* GP16 */
			   <RPIPICO_HEADER_R3_D17 0 &gpio0 17 0>,	/* GP17 */
			   <RPIPICO_HEADER_R3_D18 0 &gpio0 18 0>,	/* GP18 */
			   <RPIPICO_HEADER_R3_D19 0 &gpio0 19 0>,	/* GP19 */
			   <RPIPICO_HEADER_R3_D20 0 &gpio0 20 0>,	/* GP20 */
			   <RPIPICO_HEADER_R3_D21 0 &gpio0 21 0>,	/* GP21 */
			   <RPIPICO_HEADER_R3_D22 0 &gpio0 22 0>,	/* GP22 */
			   <RPIPICO_HEADER_R3_A0 0 &gpio0 26 0>,	/* ADC0 / GP26 */
			   <RPIPICO_HEADER_R3_A1 0 &gpio0 27 0>,	/* ADC1 / GP27 */
			   <RPIPICO_HEADER_R3_A2 0 &gpio0 28 0>;	/* ADC2 / GP28 */
	};
};
