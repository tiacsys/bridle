/*
 * Copyright (c) 2024-2026 TiaC Systems
 * SPDX-License-Identifier: Apache-2.0
 */

#include "../../zephyr/boards/raspberrypi/rpi_pico/rpi_pico_rp2040_w_mcuboot.dts"

/ {
	model = "Raspberry Pi Pico W - MCUboot @ UART Concole (BBE)";
	compatible = "raspberrypi,rpi-pico-w-mcuboot",
		     "raspberrypi,rpi-pico-w-mcuboot-bbe",
		     "raspberrypi,rpi-pico-w-mcuboot-uartcons",
		     "raspberrypi,rpi-pico-w-mcuboot-uartcons-bbe";

	chosen {
		zephyr,console = &uart0;
		zephyr,shell-uart = &uart0;
	};
};

#include "rpipico_r3.dtsi"
