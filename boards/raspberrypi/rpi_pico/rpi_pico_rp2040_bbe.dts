/*
 * Copyright (c) 2024-2026 TiaC Systems
 * SPDX-License-Identifier: Apache-2.0
 */

#include "../../zephyr/boards/raspberrypi/rpi_pico/rpi_pico.dts"

/ {
	model = "Raspberry Pi Pico @ UART Concole (BBE)";
	compatible = "raspberrypi,rpi-pico",
		     "raspberrypi,rpi-pico-bbe",
		     "raspberrypi,rpi-pico-uartcons",
		     "raspberrypi,rpi-pico-uartcons-bbe";

	chosen {
		zephyr,console = &uart0;
		zephyr,shell-uart = &uart0;
	};
};

#include "rpipico_r3.dtsi"
