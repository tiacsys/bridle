/*
 * Copyright (c) 2023-2026 TiaC Systems
 * SPDX-License-Identifier: Apache-2.0
 */

#include "../../zephyr/boards/nxp/mimxrt1060_evk/mimxrt1060_evk_mimxrt1062_qspi_C.overlay"

/*
 * FLEXPWM not routed to LED on this EVK revision, thus why board DTS
 * disables &flexpwm2_pwm3 but neither related &pwmleds node nor alias.
 */

/ {
	aliases {
		/delete-property/ pwm-led0;
	};

	/delete-node/ pwmleds;
};
