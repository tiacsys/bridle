/*
 * Copyright (c) 2023-2026 TiaC Systems
 * SPDX-License-Identifier: Apache-2.0
 */

#include "../../zephyr/boards/nxp/mimxrt1010_evk/mimxrt1010_evk.dts"
#include "arduino_r3_connector.dtsi"

/ {
	model = "NXP MIMXRT1010-EVK board @ UART Concole (BBE)";
	compatible = "nxp,mimxrt1010",
		     "nxp,mimxrt1010-bbe",
		     "nxp,mimxrt1010-uartcons",
		     "nxp,mimxrt1010-uartcons-bbe";

	chosen {
		zephyr,console = &lpuart1;
		zephyr,shell-uart = &lpuart1;
	};

	msc_disk0 {
		compatible = "zephyr,flash-disk";
		partition = <&storage_partition>;
		disk-name = "NAND";
		cache-size = <4096>;
		status = "disabled";
	};
};

&green_led {
	gpios = <&gpio1 11 GPIO_ACTIVE_HIGH>;
};
