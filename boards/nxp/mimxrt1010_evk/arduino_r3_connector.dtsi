/*
 * Copyright (c) 2023-2026 TiaC Systems
 * SPDX-License-Identifier: Apache-2.0
 */

#include <zephyr/dt-bindings/gpio/arduino-header-r3.h>

/*
 * On NXP MIMXRT1010-EVK pin D4 (GPIO), D5 (GPIO/PWM), and D9 (GPIO/PWM)
 * are disconnected in default and can be closed optionally. But keep in
 * mind that the signals are already connected to a on-board header for
 * the NXP special motor driver add-on bard.
 *
 * The following GPIO map overwrites the default settings of the board,
 * as the resistors R793, R795 and R800 must be fitted for proper use.
 */

&arduino_header {
	gpio-map = <ARDUINO_HEADER_R3_A0 0 &gpio1 21 0>,
		   <ARDUINO_HEADER_R3_A1 0 &gpio1 23 0>,
		   <ARDUINO_HEADER_R3_A2 0 &gpio1 24 0>,
		   <ARDUINO_HEADER_R3_A3 0 &gpio1 28 0>,
		   <ARDUINO_HEADER_R3_A4 0 &gpio1 15 0>,	/* shared with D6 */
		   <ARDUINO_HEADER_R3_A5 0 &gpio1 16 0>,	/* shared with D7 */
		   <ARDUINO_HEADER_R3_D0 0 &gpio1 9 0>,
		   <ARDUINO_HEADER_R3_D1 0 &gpio1 10 0>,
		   <ARDUINO_HEADER_R3_D2 0 &gpio1 19 0>,	/* shared with D10 */
		   <ARDUINO_HEADER_R3_D3 0 &gpio1 20 0>,	/* shared with D13 */
		   <ARDUINO_HEADER_R3_D4 0 &gpio1 8 0>,		/* R800 & R793 populated */
		   <ARDUINO_HEADER_R3_D5 0 &gpio1 1 0>,		/* shared with D14 */
		   <ARDUINO_HEADER_R3_D6 0 &gpio1 15 0>,	/* shared with A4 */
		   <ARDUINO_HEADER_R3_D7 0 &gpio1 16 0>,	/* shared with A5 */
		   <ARDUINO_HEADER_R3_D8 0 &gpio2 2 0>,
		   <ARDUINO_HEADER_R3_D9 0 &gpio1 3 0>,		/* R795 populated */
		   <ARDUINO_HEADER_R3_D10 0 &gpio1 19 0>,	/* shared with D2 */
		   <ARDUINO_HEADER_R3_D11 0 &gpio1 18 0>,
		   <ARDUINO_HEADER_R3_D12 0 &gpio1 17 0>,
		   <ARDUINO_HEADER_R3_D13 0 &gpio1 20 0>,	/* shared with D3 */
		   <ARDUINO_HEADER_R3_D14 0 &gpio1 1 0>,	/* shared with D5 */
		   <ARDUINO_HEADER_R3_D15 0 &gpio1 2 0>;
};
