/*
 * SPDX-FileCopyrightText: Copyright (c) 2023-2026 TiaC Systems
 * SPDX-License-Identifier: Apache-2.0
 */

#include <zephyr/dt-bindings/gpio/grove-connector.h>

/ {
	grove_uart_header: grove-uart-connector {
		compatible = "seeed,grove-connector";
		#gpio-cells = <2>;
		gpio-map-mask = <0xffffffff 0xffffffc0>;
		gpio-map-pass-thru = <0 0x3f>;
		gpio-map = <GROVE_RX 0 &portb 23 0>, /* UART-RX */
			   <GROVE_TX 0 &portb 22 0>; /* UART-TX */
	};
};

grove_serial: &sercom5 {};
