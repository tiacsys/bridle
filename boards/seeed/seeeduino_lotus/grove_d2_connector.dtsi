/*
 * SPDX-FileCopyrightText: Copyright (c) 2023-2026 TiaC Systems
 * SPDX-License-Identifier: Apache-2.0
 */

#include <zephyr/dt-bindings/gpio/grove-connector.h>

/ {
	grove_d2_header: grove-d2-connector {
		compatible = "seeed,grove-connector";
		#gpio-cells = <2>;
		gpio-map-mask = <0xffffffff 0xffffffc0>;
		gpio-map-pass-thru = <0 0x3f>;
		gpio-map = <GROVE_D0 0 &porta 14 0>, /* D2 */
			   <GROVE_D1 0 &porta 9 0>;  /* D3 */
	};
};

#undef GROVE_PWM_D2_FAST
#define GROVE_PWM_D2_FAST				\
	&tcc0 {						\
		prescaler = <1>;			\
	};

#undef GROVE_PWM_D2_SLOW
#define GROVE_PWM_D2_SLOW				\
	&tcc0 {						\
		prescaler = <1024>;			\
	};

#undef GROVE_PWM_D2_ENABLE
#define GROVE_PWM_D2_ENABLE				\
	&tcc0 {						\
		status = "okay";			\
	};

#undef GROVE_PWM_D2_PINCTRL
#define GROVE_PWM_D2_PINCTRL				\
	&tcc0_pwm_default {				\
		group4 {				\
			pinmux = <PA14F_TCC0_WO4>;	\
		};					\
	};
