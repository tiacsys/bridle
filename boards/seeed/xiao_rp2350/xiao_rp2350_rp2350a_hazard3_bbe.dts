/*
 * Copyright (c) 2026 TiaC Systems
 * SPDX-License-Identifier: Apache-2.0
 */

#include "../../zephyr/boards/seeed/xiao_rp2350/xiao_rp2350_rp2350a_hazard3.dts"

/ {
	model = "Seeed Studio XIAO RP2350 (Hazard3) @ UART Concole (BBE)";
	compatible = "seeed,xiao-rp2350",
		     "seeed,xiao-rp2350-bbe",
		     "seeed,xiao-rp2350-uartcons",
		     "seeed,xiao-rp2350-uartcons-bbe";

	chosen {
		zephyr,console = &uart0;
		zephyr,shell-uart = &uart0;
	};
};
