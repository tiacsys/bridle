/*
 * Copyright (c) 2024-2026 TiaC Systems
 * SPDX-License-Identifier: Apache-2.0
 */

#include "../../zephyr/boards/seeed/seeeduino_xiao/seeeduino_xiao.dts"

/ {
	model = "Seeeduino XIAO @ UART Concole (BBE)";
	compatible = "seeed,seeeduino-xiao",
		     "seeed,seeeduino-xiao-bbe",
		     "seeed,seeeduino-xiao-uartcons",
		     "seeed,seeeduino-xiao-uartcons-bbe",
		     "atmel,samd21g18a",
		     "atmel,samd21";

	chosen {
		zephyr,console = &sercom4;
		zephyr,shell-uart = &sercom4;
	};
};
