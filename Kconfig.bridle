## Kconfig.bridle
```kconfig
# Copyright (c) 2021-2026 TiaC Systems
# Copyright (c) 2019-2021 Li-Pro.Net
# SPDX-License-Identifier: Apache-2.0

mainmenu "Bridle"

# zephyr-keep-sorted-start
rsource "drivers/Kconfig"
rsource "lib/Kconfig"
rsource "subsys/Kconfig"
# zephyr-keep-sorted-stop
```

## Kconfig.lpnb
```kconfig
# Copyright (c) 2019-2021 Li-Pro.Net
# SPDX-License-Identifier: Apache-2.0

mainmenu "Li-Pro.Net bridle (LPNB)"

rsource "modules/Kconfig"
rsource "services/Kconfig"
rsource "subsys/Kconfig"
rsource "drivers/Kconfig"
rsource "lib/Kconfig"
```

## boards/albg/pcb-ruler/Kconfig.albg_pcb_ruler_ch32x035
```kconfig
# Copyright (c) 2025 TiaC Systems
# SPDX-License-Identifier: Apache-2.0

config BOARD_ALBG_PCB_RULER_CH32X035
	select SOC_CH32X035
```

## boards/albg/pcb-ruler/albg_pcb_ruler_ch32x035_defconfig
```kconfig
# Copyright (c) 2025 TiaC Systems
# SPDX-License-Identifier: Apache-2.0

CONFIG_GPIO=y

CONFIG_SERIAL=y
CONFIG_CONSOLE=y
CONFIG_UART_CONSOLE=y

# workaround for now, see wch_ch32/common/irq.c
CONFIG_TRACING=y
CONFIG_TRACING_USER=y
```

## boards/albg/pcb-ruler/board.yml
```yaml
boards:
  - name: albg_pcb_ruler_ch32x035
    vendor: albg
    full_name: ALBG PCB Ruler CH32X035C8T6
    socs:
      - name: ch32x035
```

## boards/arduino/zero/Kconfig.arduino_zero
```kconfig
# Copyright (c) 2026 TiaC Systems
# SPDX-License-Identifier: Apache-2.0

config BOARD_ARDUINO_ZERO_SAMD21G18A
	bool

config BOARD_ARDUINO_ZERO_SAMD21G18A_BBE
	bool
	select BOARD_ARDUINO_ZERO_SAMD21G18A
```

## boards/arduino/zero/arduino_zero_bbe_defconfig
```kconfig
# Copyright (c) 2024-2026 TiaC Systems
# SPDX-License-Identifier: Apache-2.0
#
# NOTE: copy and own from original default configuration in
# "zephyr/boards/arduino/zero/arduino_zero_defconfig"

CONFIG_SOC_ATMEL_SAMD_XOSC32K=y
CONFIG_SOC_ATMEL_SAMD_XOSC32K_AS_MAIN=y

CONFIG_BUILD_OUTPUT_HEX=y
CONFIG_BUILD_OUTPUT_UF2=y

CONFIG_BOOTLOADER_BOSSA=y
CONFIG_BOOTLOADER_BOSSA_ARDUINO=y

CONFIG_CONSOLE=y
CONFIG_SERIAL=y
CONFIG_UART_CONSOLE=y
CONFIG_UART_INTERRUPT_DRIVEN=y
```

## boards/arduino/zero/board.yml
```yaml
# Copyright (c) 2026 TiaC Systems
# SPDX-License-Identifier: Apache-2.0

board:
  extend: arduino_zero
  variants:
    - name: bbe
      qualifier: samd21g18a
```

## boards/arm/arduino_zero/Kconfig.defconfig
```kconfig
# Arduino Zero board configuration

# Copyright (c) 2023 TiaC Systems
# Copyright (c) 2017 Google LLC.
# SPDX-License-Identifier: Apache-2.0

config BOARD
	default "arduino_zero"
	depends on BOARD_ARDUINO_ZERO

# Workaround for not being able to have commas in macro arguments
DT_CHOSEN_Z_CONSOLE := zephyr,console
DT_COMPAT_Z_CDC_ACM_UART := zephyr,cdc-acm-uart
DT_COMPAT_ATMEL_USB := atmel,sam0-usb

# Macros to shorten Kconfig expressions
DT_CHOSEN_CONSOLE_NODE := $(dt_chosen_path,$(DT_CHOSEN_Z_CONSOLE))
DT_CHOSEN_CONSOLE_PARENT := $(dt_node_parent,$(DT_CHOSEN_CONSOLE_NODE))

if $(dt_chosen_enabled,$(DT_CHOSEN_Z_CONSOLE)) && \
   $(dt_compat_on_bus,$(DT_COMPAT_Z_CDC_ACM_UART),usb) && \
   $(dt_node_has_compat,$(DT_CHOSEN_CONSOLE_PARENT),$(DT_COMPAT_ATMEL_USB))

config BOOTLOADER_BOSSA_DEVICE_NAME
	default "$(dt_chosen_label,$(DT_CHOSEN_Z_CONSOLE))"
	depends on USB_CDC_ACM

if LOG

# Logger cannot use itself to log
choice USB_CDC_ACM_LOG_LEVEL_CHOICE
	default USB_CDC_ACM_LOG_LEVEL_OFF
endchoice

# Set USB log level to error only
choice USB_DEVICE_LOG_LEVEL_CHOICE
	default USB_DEVICE_LOG_LEVEL_ERR
endchoice

# Wait 4000ms at startup for logging
config LOG_PROCESS_THREAD_STARTUP_DELAY_MS
	default 4000

endif # LOG

endif # @usbcons
```

## boards/arm/cytron_rp2040/Kconfig.board
```kconfig
# Copyright (c) 2023 TiaC Systems
# SPDX-License-Identifier: Apache-2.0

config BOARD_CYTRON_MAKER_NANO_RP2040
	bool "Cytron Maker Nano RP2040 Board"
	depends on SOC_RP2040

config BOARD_CYTRON_MAKER_PI_RP2040
	bool "Cytron Maker Pi RP2040 Board"
	depends on SOC_RP2040
```

## boards/arm/cytron_rp2040/Kconfig.defconfig
```kconfig
# Copyright (c) 2023 TiaC Systems
# SPDX-License-Identifier: Apache-2.0

config BOARD
	default "cytron_maker_nano_rp2040" if BOARD_CYTRON_MAKER_NANO_RP2040
	default "cytron_maker_pi_rp2040" if BOARD_CYTRON_MAKER_PI_RP2040
	depends on BOARD_CYTRON_RP2040

config BOARD_CYTRON_RP2040
	bool
	default y if BOARD_CYTRON_MAKER_NANO_RP2040
	default y if BOARD_CYTRON_MAKER_PI_RP2040
	default n

config RP2_FLASH_W25Q080
	default y
	depends on BOARD_CYTRON_RP2040

config CLOCK_CONTROL
	default y
	depends on DT_HAS_RASPBERRYPI_PICO_CLOCK_ENABLED && \
		   DT_HAS_RASPBERRYPI_PICO_CLOCK_CONTROLLER_ENABLED

config RESET
	default y
	depends on DT_HAS_RASPBERRYPI_PICO_RESET_ENABLED

config GPIO
	default y
	depends on DT_HAS_RASPBERRYPI_PICO_GPIO_ENABLED

config REGULATOR
	default y
	depends on DT_HAS_REGULATOR_FIXED_ENABLED

config I2C_DW_CLOCK_SPEED
	default 125
	depends on I2C_DW && BOARD_CYTRON_RP2040

config INPUT
	default y if DT_HAS_ZEPHYR_LVGL_KEYPAD_INPUT_ENABLED
	depends on BOARD_PICOBOY_RP2040 && DISPLAY && LVGL

config USB_SELF_POWERED
	default n
	depends on USB_DEVICE_STACK && BOARD_CYTRON_RP2040

config USB_MAX_POWER
	default 215 if BOARD_CYTRON_MAKER_NANO_RP2040	# 430mA
	default 250 if BOARD_CYTRON_MAKER_PI_RP2040	# 500mA
	depends on USB_DEVICE_STACK && BOARD_CYTRON_RP2040

# Workaround for not being able to have commas in macro arguments
DT_CHOSEN_Z_CONSOLE := zephyr,console
DT_COMPAT_Z_CDC_ACM_UART := zephyr,cdc-acm-uart
DT_COMPAT_RPIPICO_USB := raspberrypi,pico-usbd

# Macros to shorten Kconfig expressions
DT_CHOSEN_CONSOLE_NODE := $(dt_chosen_path,$(DT_CHOSEN_Z_CONSOLE))
DT_CHOSEN_CONSOLE_PARENT := $(dt_node_parent,$(DT_CHOSEN_CONSOLE_NODE))

if BOARD_CYTRON_RP2040 && \
   $(dt_chosen_enabled,$(DT_CHOSEN_Z_CONSOLE)) && \
   $(dt_compat_on_bus,$(DT_COMPAT_Z_CDC_ACM_UART),usb) && \
   $(dt_node_has_compat,$(DT_CHOSEN_CONSOLE_PARENT),$(DT_COMPAT_RPIPICO_USB))

# Logger cannot use itself to log
choice USB_CDC_ACM_LOG_LEVEL_CHOICE
	default USB_CDC_ACM_LOG_LEVEL_OFF
	depends on LOG
endchoice

# Set USB log level to error only
choice USB_DEVICE_LOG_LEVEL_CHOICE
	default USB_DEVICE_LOG_LEVEL_ERR
	depends on LOG
endchoice

# Wait 4000ms at startup for logging
config LOG_PROCESS_THREAD_STARTUP_DELAY_MS
	default 4000
	depends on LOG

# Wait 4000ms at startup for USB enumeration on host side
config BOOT_DELAY
	default 4000

endif # zephyr,cdc-acm-uart
```

## boards/arm/picoboy/Kconfig.board
```kconfig
# Copyright (c) 2023 TiaC Systems
# SPDX-License-Identifier: Apache-2.0

config BOARD_PICOBOY
	bool "PicoBoy Mini-Handheld Board"
	depends on SOC_RP2040
```

## boards/arm/seeed_xiao_samd21/Kconfig.board
```kconfig
# Seeed Studio XIAO SAMD21 (Seeeduino XIAO) board configuration

# Copyright (c) 2023 TiaC Systems
# Copyright (c) 2020 Google LLC.
# SPDX-License-Identifier: Apache-2.0

config BOARD_SEEED_XIAO_SAMD21
	bool "Seeed Studio XIAO SAMD21 (Seeeduino XIAO)"
	depends on SOC_PART_NUMBER_SAMD21G18A
```

## boards/arm/seeeduino_cm0/Kconfig.board
```kconfig
# Seeeduino Cortex-M0+ board configuration

# Copyright (c) 2023 TiaC Systems
# SPDX-License-Identifier: Apache-2.0

config BOARD_SEEEDUINO_CM0
	bool "Seeeduino Cortex-M0+"
	depends on SOC_PART_NUMBER_SAMD21G18A
```

## boards/arm/seeeduino_lotus/Kconfig.board
```kconfig
# Seeeduino Lotus Cortex-M0+ board configuration

# Copyright (c) 2023 TiaC Systems
# SPDX-License-Identifier: Apache-2.0

config BOARD_SEEEDUINO_LOTUS
	bool "Seeeduino Lotus Cortex-M0+"
	depends on SOC_PART_NUMBER_SAMD21G18A
```

## boards/arm/stm32f7308_dk/Kconfig.board
```kconfig
# Copyright (c) 2023 TiaC Systems
# SPDX-License-Identifier: Apache-2.0

# STM32F7308-DK Discovery board configuration

config BOARD_STM32F7308_DK
	bool "STM32F7308-DK Discovery Kit"
	depends on SOC_STM32F730XX
```

## boards/arm/stm32f7308_dk/Kconfig.defconfig
```kconfig
# Copyright (c) 2023 TiaC Systems
# SPDX-License-Identifier: Apache-2.0

# STM32F7308-DK Discovery board configuration

if BOARD_STM32F7308_DK

config BOARD
	default "stm32f7308_dk"

config SPI_STM32_INTERRUPT
	default y
	depends on SPI

endif # BOARD_STM32F7308_DK
```

## boards/arm/stm32f7308_dk/stm32f7308_dk_defconfig
```kconfig
# Copyright (c) 2023 TiaC Systems
# SPDX-License-Identifier: Apache-2.0

CONFIG_SOC_SERIES_STM32F7X=y
CONFIG_SOC_STM32F730XX=y

# Enable MPU
CONFIG_ARM_MPU=y

# Enable HW stack protection
CONFIG_HW_STACK_PROTECTION=y

# Clock Configuration
CONFIG_CLOCK_CONTROL=y

# RTC Counter
CONFIG_COUNTER=y

# Enable Pin-Controller
CONFIG_PINCTRL=y

# Enable GPIO
CONFIG_GPIO=y

# Enable UART
CONFIG_SERIAL=y

# Console
CONFIG_CONSOLE=y
CONFIG_UART_CONSOLE=y
```

## boards/arm/tiac_magpie/Kconfig.board
```kconfig
# Copyright (c) 2021 TiaC Systems
# Copyright (c) 2021 Li-Pro.Net
# SPDX-License-Identifier: Apache-2.0

# TiaC STM32F777NIHx Magpie board configuration

config BOARD_TIAC_MAGPIE
	bool "TiaC Magpie Board"
	depends on SOC_STM32F777XX
```

## boards/arm/tiac_magpie/Kconfig.defconfig
```kconfig
# Copyright (c) 2021 Li-Pro.Net
# SPDX-License-Identifier: Apache-2.0

# TiaC STM32F777NIHx Magpie board configuration

if BOARD_TIAC_MAGPIE

config BOARD
	default "tiac_magpie"

config SYS_CLOCK_HW_CYCLES_PER_SEC
	default 216000000

if CLOCK_CONTROL

choice CLOCK_STM32_SYSCLK_SRC
	default CLOCK_STM32_SYSCLK_SRC_PLL
endchoice

config CLOCK_STM32_HSE_BYPASS
	default y

config CLOCK_STM32_HSE_CLOCK
	default 25000000

endif # CLOCK_CONTROL

choice COUNTER_RTC_STM32_CLOCK_SRC
	default COUNTER_RTC_STM32_CLOCK_LSE
        depends on COUNTER
endchoice

choice RNG_GENERATOR_CHOICE
	default ENTROPY_DEVICE_RANDOM_GENERATOR
        depends on ENTROPY_GENERATOR
endchoice

if NETWORKING

config NET_L2_ETHERNET
	default y

config ETH_STM32_HAL_MII
	default y

config ETH_STM32_HAL_PHY_ADDRESS
	default 7

endif # NETWORKING

endif # BOARD_TIAC_MAGPIE
```

## boards/arm/tiac_magpie/tiac_magpie_defconfig
```kconfig
# Copyright (c) 2021 TiaC Systems
# Copyright (c) 2021 Li-Pro.Net
# SPDX-License-Identifier: Apache-2.0

CONFIG_SOC_SERIES_STM32F7X=y
CONFIG_SOC_STM32F777XX=y
CONFIG_SOC_STM32F767XX=y
CONFIG_SOC_STM32F767XX_STM32F777XX=y

# Clock Configuration
CONFIG_CLOCK_CONTROL=y

# RTC Counter
CONFIG_COUNTER=y

# Use LSE as RTC input
CONFIG_COUNTER_RTC_STM32_CLOCK_LSE=y
CONFIG_COUNTER_RTC_STM32_LSE_BYPASS=y

# Enable MPU
CONFIG_ARM_MPU=y

# Enable HW stack protection
CONFIG_HW_STACK_PROTECTION=y

# Enable UART
CONFIG_SERIAL=y

# Console
CONFIG_CONSOLE=y
CONFIG_UART_CONSOLE=y

# Enable Pinmux
CONFIG_PINMUX=y

# Enable GPIO, I2C, and SPI
CONFIG_GPIO=y
CONFIG_I2C=y
CONFIG_SPI=y
```

## boards/arm/trinamic_startrampe/Kconfig.board
```kconfig
# Trinamic Startrampe board configuration

# Copyright (c) 2023 TiaC Systems
# SPDX-License-Identifier: Apache-2.0

config BOARD_TRINAMIC_STARTRAMPE
	bool "Trinamic Interface and Connector Board Startrampe"
	depends on SOC_STM32F205XX
```

## boards/arm/trinamic_startrampe/Kconfig.defconfig
```kconfig
# Trinamic Startrampe board configuration

# Copyright (c) 2023 TiaC Systems
# SPDX-License-Identifier: Apache-2.0

if BOARD_TRINAMIC_STARTRAMPE

config BOARD
	default "trinamic_startrampe"

# Workaround for not being able to have commas in macro arguments
DT_CHOSEN_Z_CONSOLE := zephyr,console
DT_COMPAT_Z_CDC_ACM_UART := zephyr,cdc-acm-uart
DT_COMPAT_ST_STM32_OTGFS := st,stm32-otgfs

# Macros to shorten Kconfig expressions
DT_CHOSEN_CONSOLE_NODE := $(dt_chosen_path,$(DT_CHOSEN_Z_CONSOLE))
DT_CHOSEN_CONSOLE_PARENT := $(dt_node_parent,$(DT_CHOSEN_CONSOLE_NODE))

if $(dt_chosen_enabled,$(DT_CHOSEN_Z_CONSOLE)) && \
   $(dt_compat_on_bus,$(DT_COMPAT_Z_CDC_ACM_UART),usb) && \
   $(dt_node_has_compat,$(DT_CHOSEN_CONSOLE_PARENT),$(DT_COMPAT_ST_STM32_OTGFS))

if LOG

# Logger cannot use itself to log
choice USB_CDC_ACM_LOG_LEVEL_CHOICE
	default USB_CDC_ACM_LOG_LEVEL_OFF
endchoice

# Set USB log level to error only
choice USB_DEVICE_LOG_LEVEL_CHOICE
	default USB_DEVICE_LOG_LEVEL_ERR
endchoice

# Wait 4000ms at startup for logging
config LOG_PROCESS_THREAD_STARTUP_DELAY_MS
	default 4000

endif # LOG

endif # @usbcons

if EEPROM

config EEPROM_INIT_PRIORITY
	default SPI_INIT_PRIORITY

endif # EEPROM

endif # BOARD_TRINAMIC_STARTRAMPE
```

## boards/arm/trinamic_startrampe/trinamic_startrampe_defconfig
```kconfig
# Copyright (c) 2023 TiaC Systems
# SPDX-License-Identifier: Apache-2.0

CONFIG_SOC_SERIES_STM32F2X=y
CONFIG_SOC_STM32F205XX=y

# Enable MPU
CONFIG_ARM_MPU=y

# Enable HW stack protection
CONFIG_HW_STACK_PROTECTION=y

# Enable Clocks
CONFIG_CLOCK_CONTROL=y

# Enable pin controller
CONFIG_PINCTRL=y

# Console
CONFIG_SERIAL=y
CONFIG_CONSOLE=y
CONFIG_UART_CONSOLE=y

# Enable GPIO
CONFIG_GPIO=y

# Enable EEPROM
CONFIG_EEPROM=y
```

## boards/arm/vccgnd_bluepill/Kconfig.board
```kconfig
# Copyright (c) 2022 TiaC Systems
# Copyright (c) 2017, embedjournal.com
# SPDX-License-Identifier: Apache-2.0

config BOARD_VCCGND_BLUEPILL
	bool "VCC-GND Studio Blue Pill"
	depends on SOC_STM32F103X8
```
