/*
 * SPDX-FileCopyrightText: Copyright (c) 2025-2026 TiaC Systems
 * SPDX-License-Identifier: Apache-2.0
 */

servo: &pwm_servo1 {
	compatible = "pwm-servo";
	min-pulse = <PWM_USEC(500)>;
	max-pulse = <PWM_USEC(2500)>;
};
