/*
 * SPDX-FileCopyrightText: Copyright (c) 2023-2026 TiaC Systems
 * SPDX-License-Identifier: Apache-2.0
 */

/ {
	chosen {
		zephyr,console = &snippet_cdc_acm_console_uart;
		zephyr,shell-uart = &snippet_cdc_acm_console_uart;
		zephyr,uart-mcumgr = &snippet_cdc_acm_console_uart;
		zephyr,bt-mon-uart = &snippet_cdc_acm_console_uart;
		zephyr,bt-c2h-uart = &snippet_cdc_acm_console_uart;
	};
};

&zephyr_udc0 {
	status = "okay";
	/delete-node/ board_cdc_acm_uart;
	snippet_cdc_acm_console_uart: snippet_cdc_acm_console_uart {
		compatible = "zephyr,cdc-acm-uart";
	};
};
