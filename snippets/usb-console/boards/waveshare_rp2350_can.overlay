/*
 * Copyright (c) 2025-2026 TiaC Systems
 * SPDX-License-Identifier: Apache-2.0
 */

/ {
	model = "Waveshare RP2350-CAN @ USB-CDC/ACM Concole";
	compatible = "waveshare,rp2350-can",
		     "waveshare,rp2350-can-usbcons";

	chosen {
		zephyr,shell-uart = &snippet_cdc_acm_console_uart;
	};
};
