/*
 * Copyright (c) 2023-2026 TiaC Systems
 * SPDX-License-Identifier: Apache-2.0
 */

/ {
	model = "NXP MIMXRT1010-EVK board @ USB-CDC/ACM Concole (BBE)";
	compatible = "nxp,mimxrt1010",
		     "nxp,mimxrt1010-bbe",
		     "nxp,mimxrt1010-usbcons",
		     "nxp,mimxrt1010-usbcons-bbe";

	chosen {
		zephyr,shell-uart = &snippet_cdc_acm_console_uart;
	};
};
