/*
 * Copyright (c) 2025-2026 TiaC Systems
 * SPDX-License-Identifier: Apache-2.0
 */

/ {
	model = "WeAct Studio BluePill+ STM32F103CB @ USB-CDC/ACM Concole";
	compatible = "weact,bluepillplus-stm32f103cb",
		     "weact,bluepillplus-stm32f103cb-usbcons";

	chosen {
		zephyr,shell-uart = &snippet_cdc_acm_console_uart;
	};
};
