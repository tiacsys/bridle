/*
 * Copyright (c) 2026 TiaC Systems
 * SPDX-License-Identifier: Apache-2.0
 */

/ {
	model = "STMicroelectronics STM32L496ZG-NUCLEO board @ USB-CDC/ACM Concole";
	compatible = "st,stm32l496zg-nucleo",
		     "st,stm32l496zg-nucleo-usbcons";

	chosen {
		zephyr,shell-uart = &snippet_cdc_acm_console_uart;
	};
};
