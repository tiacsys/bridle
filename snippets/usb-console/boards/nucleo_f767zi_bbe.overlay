/*
 * Copyright (c) 2024-2026 TiaC Systems
 * SPDX-License-Identifier: Apache-2.0
 */

/ {
	model = "STMicroelectronics STM32F767ZI-NUCLEO board @ USB-CDC/ACM Concole (BBE)";
	compatible = "st,stm32f767zi-nucleo",
		     "st,stm32f767zi-nucleo-bbe",
		     "st,stm32f767zi-nucleo-usbcons",
		     "st,stm32f767zi-nucleo-usbcons-bbe";

	chosen {
		zephyr,shell-uart = &snippet_cdc_acm_console_uart;
	};
};
