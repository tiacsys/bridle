/*
 * Copyright (c) 2023-2025 TiaC Systems
 * SPDX-License-Identifier: Apache-2.0
 */

/ {
	model = "NXP MIMXRT1010-EVK board @ USB-CDC/ACM Concole";
	compatible = "nxp,mimxrt1010", "nxp,mimxrt1010-usbcons";

	chosen {
		zephyr,shell-uart = &snippet_cdc_acm_console_uart;
	};
};
