/*
 * Copyright (c) 2023-2025 TiaC Systems
 * SPDX-License-Identifier: Apache-2.0
 */

/ {
	model = "Cytron Maker Nano RP2040 @ USB-CDC/ACM Concole";
	compatible = "waveshare,maker-nano-rp2040", "waveshare,maker-nano-rp2040-usbcons";

	chosen {
		zephyr,shell-uart = &snippet_cdc_acm_console_uart;
	};
};
