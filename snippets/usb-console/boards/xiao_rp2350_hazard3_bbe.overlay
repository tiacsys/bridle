/*
 * Copyright (c) 2026 TiaC Systems
 * SPDX-License-Identifier: Apache-2.0
 */

/ {
	model = "Seeed Studio XIAO RP2350 (Hazard3) @ USB-CDC/ACM Concole (BBE)";
	compatible = "seeed,xiao-rp2350",
		     "seeed,xiao-rp2350-bbe",
		     "seeed,xiao-rp2350-usbcons",
		     "seeed,xiao-rp2350-usbcons-bbe";

	chosen {
		zephyr,shell-uart = &snippet_cdc_acm_console_uart;
	};
};
