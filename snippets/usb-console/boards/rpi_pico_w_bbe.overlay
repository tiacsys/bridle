/*
 * Copyright (c) 2023-2026 TiaC Systems
 * SPDX-License-Identifier: Apache-2.0
 */

/ {
	model = "Raspberry Pi Pico W @ USB-CDC/ACM Concole (BBE)";
	compatible = "raspberrypi,rpi-pico-w",
		     "raspberrypi,rpi-pico-w-bbe",
		     "raspberrypi,rpi-pico-w-usbcons",
		     "raspberrypi,rpi-pico-w-usbcons-bbe";

	chosen {
		zephyr,shell-uart = &snippet_cdc_acm_console_uart;
	};
};
