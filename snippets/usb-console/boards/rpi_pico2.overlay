/*
 * Copyright (c) 2025 TiaC Systems
 * SPDX-License-Identifier: Apache-2.0
 */

/ {
	model = "Raspberry Pi Pico 2 @ USB-CDC/ACM Concole";
	compatible = "raspberrypi,rpi-pico2", "raspberrypi,rpi-pico2-usbcons";

	chosen {
		zephyr,shell-uart = &snippet_cdc_acm_console_uart;
	};
};
