/*
 * Copyright (c) 2023-2026 TiaC Systems
 * SPDX-License-Identifier: Apache-2.0
 */

/ {
	model = "Raspberry Pi Pico W - MCUboot @ USB-CDC/ACM Concole (BBE)";
	compatible = "raspberrypi,rpi-pico-w-mcuboot",
		     "raspberrypi,rpi-pico-w-mcuboot-bbe",
		     "raspberrypi,rpi-pico-w-mcuboot-usbcons",
		     "raspberrypi,rpi-pico-w-mcuboot-usbcons-bbe";

	chosen {
		zephyr,shell-uart = &snippet_cdc_acm_console_uart;
	};
};
