/*
 * Copyright (c) 2023-2026 TiaC Systems
 * SPDX-License-Identifier: Apache-2.0
 */

/ {
	model = "Seeed XIAO SAMD21 (Seeeduino XIAO) @ USB-CDC/ACM Concole";
	compatible = "seeed,xiao-samd21",
		     "seeed,xiao-samd21-usbcons",
		     "seeed,seeeduino-xiao",
		     "seeed,seeeduino-xiao-usbcons",
		     "atmel,samd21g18a",
		     "atmel,samd21";

	chosen {
		zephyr,shell-uart = &snippet_cdc_acm_console_uart;
	};
};
