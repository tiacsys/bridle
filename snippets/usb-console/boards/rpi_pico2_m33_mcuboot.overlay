/*
 * Copyright (c) 2025-2026 TiaC Systems
 * SPDX-License-Identifier: Apache-2.0
 */

/ {
	model = "Raspberry Pi Pico 2 (Cortex-M33) - MCUboot @ USB-CDC/ACM Concole";
	compatible = "raspberrypi,rpi-pico2-mcuboot",
		     "raspberrypi,rpi-pico2-mcuboot-usbcons";

	chosen {
		zephyr,shell-uart = &snippet_cdc_acm_console_uart;
	};
};
