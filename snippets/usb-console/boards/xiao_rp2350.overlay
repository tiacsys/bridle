/*
 * Copyright (c) 2026 TiaC Systems
 * SPDX-License-Identifier: Apache-2.0
 */

/ {
	model = "Seeed Studio XIAO RP2350 @ USB-CDC/ACM Concole";
	compatible = "seeed,xiao-rp2350",
		     "seeed,xiao-rp2350-usbcons";

	chosen {
		zephyr,shell-uart = &snippet_cdc_acm_console_uart;
	};
};
