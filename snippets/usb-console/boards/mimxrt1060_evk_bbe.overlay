/*
 * Copyright (c) 2023-2026 TiaC Systems
 * SPDX-License-Identifier: Apache-2.0
 */

/ {
	model = "NXP MIMXRT1060-EVK board @ USB-CDC/ACM Concole (BBE)";
	compatible = "nxp,mimxrt1062",
		     "nxp,mimxrt1062-bbe",
		     "nxp,mimxrt1062-usbcons",
		     "nxp,mimxrt1062-usbcons-bbe";

	chosen {
		zephyr,shell-uart = &snippet_cdc_acm_console_uart;
	};
};
