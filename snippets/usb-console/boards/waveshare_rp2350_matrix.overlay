/*
 * SPDX-FileCopyrightText: Copyright (c) 2026 TiaC Systems
 * SPDX-License-Identifier: Apache-2.0
 */

/ {
	model = "Waveshare RP2350-Matrix @ USB-CDC/ACM Concole";
	compatible = "waveshare,rp2350-matrix",
		     "waveshare,rp2350-matrix-usbcons";

	chosen {
		zephyr,shell-uart = &snippet_cdc_acm_console_uart;
	};
};
