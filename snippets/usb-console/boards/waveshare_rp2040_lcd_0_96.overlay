/*
 * Copyright (c) 2023 TiaC Systems
 * SPDX-License-Identifier: Apache-2.0
 */

/ {
	model = "Waveshare RP2040-LCD-0.96 @ USB-CDC/ACM Concole";
	compatible = "waveshare,rp2040-lcd-0.96", "waveshare,rp2040-lcd-0.96-usbcons";

	chosen {
		zephyr,shell-uart = &snippet_cdc_acm_console_uart;
	};
};
