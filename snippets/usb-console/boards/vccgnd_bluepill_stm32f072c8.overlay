/*
 * Copyright (c) 2025-2026 TiaC Systems
 * SPDX-License-Identifier: Apache-2.0
 */

/ {
	model = "VccGND Studio BluePill STM32F072C8 @ USB-CDC/ACM Concole";
	compatible = "vccgnd,bluepill-stm32f072c8",
		     "vccgnd,bluepill-stm32f072c8-usbcons";

	chosen {
		zephyr,shell-uart = &snippet_cdc_acm_console_uart;
	};
};
