## snippets/usb-console/boards/rpi_pico_w.conf
```kconfig
# Copyright (c) 2023-2024 TiaC Systems
# SPDX-License-Identifier: Apache-2.0

CONFIG_USB_DEVICE_INITIALIZE_AT_BOOT=y

# Raspberry Pi @ Raspberry Pi Pico
CONFIG_USB_DEVICE_VID=0x2e8a
CONFIG_USB_DEVICE_PID=0x000a
CONFIG_USB_DEVICE_MANUFACTURER="Raspberry Pi"
CONFIG_USB_DEVICE_PRODUCT="RPi Pico W (CDC ACM)"
```

## snippets/usb-console/boards/seeeduino_cm0.conf
```kconfig
# Copyright (c) 2023-2025 TiaC Systems
# SPDX-License-Identifier: Apache-2.0

# Atmel Corp. SAMD21 @ Seeeduino Cortex-M0+
CONFIG_CDC_ACM_SERIAL_VID=0x2886
CONFIG_CDC_ACM_SERIAL_PID=0x8027
CONFIG_CDC_ACM_SERIAL_MANUFACTURER_STRING="Seeed LLC"
CONFIG_CDC_ACM_SERIAL_PRODUCT_STRING="Seeeduino Cortex-M0+ (CDC ACM)"
```

## snippets/usb-console/boards/seeeduino_xiao.conf
```kconfig
# Copyright (c) 2024-2025 TiaC Systems
# SPDX-License-Identifier: Apache-2.0

# Atmel Corp. SAMD21 @ Seeed XIAO M0
CONFIG_CDC_ACM_SERIAL_VID=0x2886
CONFIG_CDC_ACM_SERIAL_PID=0x802f
CONFIG_CDC_ACM_SERIAL_MANUFACTURER_STRING="Seeed"
CONFIG_CDC_ACM_SERIAL_PRODUCT_STRING="Seeed XIAO M0 (CDC ACM)"
```

## snippets/usb-console/boards/vccgnd_bluepill_stm32f103.conf
```kconfig
# Copyright (c) 2025 TiaC Systems
# SPDX-License-Identifier: Apache-2.0

# VccGND Studio @ BluePill STM32F103
CONFIG_CDC_ACM_SERIAL_VID=0x0483
CONFIG_CDC_ACM_SERIAL_PID=0x5740
CONFIG_CDC_ACM_SERIAL_MANUFACTURER_STRING="VccGND (STMicroelectronics)"
CONFIG_CDC_ACM_SERIAL_PRODUCT_STRING="BluePill STM32F103 (CDC ACM)"
```

## snippets/usb-console/boards/waveshare_rp2040_eth.conf
```kconfig
# Copyright (c) 2023-2025 TiaC Systems
# SPDX-License-Identifier: Apache-2.0

# Waveshare @ RP2040-ETH
CONFIG_CDC_ACM_SERIAL_VID=0x2e8a
CONFIG_CDC_ACM_SERIAL_PID=0x000a
CONFIG_CDC_ACM_SERIAL_MANUFACTURER_STRING="Waveshare (Raspberry Pi)"
CONFIG_CDC_ACM_SERIAL_PRODUCT_STRING="RP2040-ETH (CDC ACM)"
```

## snippets/usb-console/boards/weact_bluepillplus_ch32v203.conf
```kconfig
# Copyright (c) 2025 TiaC Systems
# SPDX-License-Identifier: Apache-2.0

# WeAct Studio @ BluePill+ CH32V203
CONFIG_CDC_ACM_SERIAL_VID=0x0483
CONFIG_CDC_ACM_SERIAL_PID=0x5740
CONFIG_CDC_ACM_SERIAL_MANUFACTURER_STRING="WeAct (STMicroelectronics)"
CONFIG_CDC_ACM_SERIAL_PRODUCT_STRING="BluePill+ CH32V203 (CDC ACM)"
```

## snippets/usb-console/boards/weact_bluepillplus_stm32f103.conf
```kconfig
# Copyright (c) 2025 TiaC Systems
# SPDX-License-Identifier: Apache-2.0

# WeAct Studio @ BluePill+ STM32F103
CONFIG_CDC_ACM_SERIAL_VID=0x0483
CONFIG_CDC_ACM_SERIAL_PID=0x5740
CONFIG_CDC_ACM_SERIAL_MANUFACTURER_STRING="WeAct (STMicroelectronics)"
CONFIG_CDC_ACM_SERIAL_PRODUCT_STRING="BluePill+ STM32F103 (CDC ACM)"
```

## snippets/usb-console/boards/xiao_rp2350.conf
```kconfig
# Copyright (c) 2026 TiaC Systems
# SPDX-License-Identifier: Apache-2.0

# Seeed LLC @ XIAO RP2350
CONFIG_CDC_ACM_SERIAL_VID=0x2e8a
CONFIG_CDC_ACM_SERIAL_PID=0x000a
CONFIG_CDC_ACM_SERIAL_MANUFACTURER_STRING="Seeed LLC (Raspberry Pi)"
CONFIG_CDC_ACM_SERIAL_PRODUCT_STRING="XIAO RP2350 (CDC ACM)"
```

## snippets/usb-console/boards/xiao_samd21.conf
```kconfig
# Copyright (c) 2023-2025 TiaC Systems
# SPDX-License-Identifier: Apache-2.0

# Atmel Corp. SAMD21 @ Seeeduino XIAO SAMD21
CONFIG_CDC_ACM_SERIAL_VID=0x2886
CONFIG_CDC_ACM_SERIAL_PID=0x802f
CONFIG_CDC_ACM_SERIAL_MANUFACTURER_STRING="Seeed Studio"
CONFIG_CDC_ACM_SERIAL_PRODUCT_STRING="XIAO SAMD21 (CDC ACM)"
```

## soc/arm/stm32f730xx/Kconfig
```kconfig
# Copyright (c) 2023 TiaC Systems
# SPDX-License-Identifier: Apache-2.0

if SOC_FAMILY_STM32

config SOC_STM32F730XX
	bool "STM32F730XX"
	depends on SOC_SERIES_STM32F7X

endif # SOC_FAMILY_STM32
```

## soc/arm/stm32f730xx/Kconfig.defconfig
```kconfig
# ST Microelectronics STM32F7 MCU line

# Copyright (c) 2023 TiaC Systems
# SPDX-License-Identifier: Apache-2.0

# Kconfig symbols common to STM32F7 series

if SOC_SERIES_STM32F7X

if SOC_STM32F730XX

config SOC
	default "stm32f730xx"

config NUM_IRQS
	default 104

endif # SOC_STM32F730XX

endif # SOC_SERIES_STM32F7X
```

## soc/arm/stm32f767xx/Kconfig
```kconfig
# Copyright (c) 2021 TiaC Systems
# Copyright (c) 2021 Li-Pro.Net
# SPDX-License-Identifier: Apache-2.0

if SOC_FAMILY_STM32

choice
	prompt "STM32F767XX MCU Variation"
	depends on SOC_SERIES_STM32F7X
	depends on SOC_STM32F767XX

config SOC_STM32F767XX_STM32F767XX
	bool "STM32F767XX as STM32F767XX"

config SOC_STM32F767XX_STM32F777XX
	bool "STM32F767XX as STM32F777XX"
	select SOC_STM32F777XX

endchoice

config SOC_STM32F777XX
	bool "STM32F777XX MCU Selection"
	select CPU_HAS_FPU_DOUBLE_PRECISION
	depends on SOC_STM32F767XX_STM32F777XX

endif # SOC_FAMILY_STM32
```

## soc/arm/stm32f767xx/Kconfig.defconfig
```kconfig
# ST Microelectronics STM32F7 MCU line

# Copyright (c) 2021 TiaC Systems
# Copyright (c) 2021 Li-Pro.Net
# Copyright (c) 2018 Yurii Hamann
# SPDX-License-Identifier: Apache-2.0

# Kconfig symbols common to STM32F7 series

if SOC_SERIES_STM32F7X

if SOC_STM32F767XX_STM32F767XX

config SOC
	default "stm32f767xx"

endif # SOC_STM32F767XX_STM32F767XX

if SOC_STM32F767XX_STM32F777XX

config SOC
	default "stm32f777xx"

endif # SOC_STM32F767XX_STM32F777XX

endif # SOC_SERIES_STM32F7X
```

## soc/st/stm32/Kconfig
```kconfig
# ST Microelectronics STM32 MCU line

# Copyright (c) 2024-2025 TiaC Systems
# SPDX-License-Identifier: Apache-2.0

if SOC_FAMILY_STM32

# zephyr-keep-sorted-start
rsource "*/Kconfig"
# zephyr-keep-sorted-stop

endif # SOC_FAMILY_STM32
```

## soc/st/stm32/Kconfig.defconfig
```kconfig
# ST Microelectronics STM32 MCU line

# Copyright (c) 2024-2025 TiaC Systems
# SPDX-License-Identifier: Apache-2.0

# Kconfig symbols common to STM32F7 series

if SOC_FAMILY_STM32

# zephyr-keep-sorted-start
rsource "*/Kconfig.defconfig"
# zephyr-keep-sorted-stop

endif # SOC_FAMILY_STM32
```

## soc/st/stm32/stm32f7x/Kconfig.defconfig
```kconfig
# ST Microelectronics STM32F7 MCU line

# Copyright (c) 2024-2025 TiaC Systems
# SPDX-License-Identifier: Apache-2.0

# Kconfig symbols common to STM32F7 series

if SOC_SERIES_STM32F7X

# zephyr-keep-sorted-start
rsource "Kconfig.defconfig.stm32f7*"
# zephyr-keep-sorted-stop

endif # SOC_SERIES_STM32F7X
```

## soc/st/stm32/stm32f7x/Kconfig.defconfig.stm32f777xx
```kconfig
# ST STM32F777XI MCU configuration options

# Copyright (c) 2024 TiaC Systems
# SPDX-License-Identifier: Apache-2.0

if SOC_STM32F777XX

config NUM_IRQS
	default 110

config CPU_HAS_FPU_DOUBLE_PRECISION
	default y

endif # SOC_STM32F777XX
```

## soc/wch/ch32/Kconfig
```kconfig
config SOC_FAMILY_WCH_CH32
	bool
	select RISCV
	select RISCV_ISA_RV32I
	select RISCV_ISA_EXT_M
	select RISCV_ISA_EXT_A
	select RISCV_ISA_EXT_C
	select RISCV_ISA_EXT_ZICSR
	select RISCV_ISA_EXT_ZIFENCEI
	select RISCV_SOC_HAS_GP_RELATIVE_ADDRESSING
	select ARCH_HAS_CUSTOM_CPU_IDLE
	select ARCH_HAS_CUSTOM_CPU_ATOMIC_IDLE
	select INCLUDE_RESET_VECTOR
	select BUILD_OUTPUT_HEX
	select TICKLESS_CAPABLE
	imply XIP
#	check ARCH_HAS_CUSTOM_CPU_IDLE and ARCH_HAS_CUSTOM_CPU_ATOMIC_IDLE
#	and try to use Zephyr functions in: arch/riscv/core/cpu_idle.c

rsource "*/Kconfig"
```

## soc/wch/ch32/Kconfig.defconfig
```kconfig
# Copyright (c) 2025 TiaC Systems
# Copyright (c) 2024 Matthew Tran
# SPDX-License-Identifier: Apache-2.0

if SOC_FAMILY_WCH_CH32

config GNU_C_EXTENSIONS
	default y

rsource "*/Kconfig.defconfig"

endif # SOC_FAMILY_WCH_CH32
```

## soc/wch/ch32/Kconfig.soc
```kconfig
# Copyright (c) 2025 TiaC Systems
# Copyright (c) 2024 Matthew Tran
# SPDX-License-Identifier: Apache-2.0

if SOC_FAMILY_WCH_CH32

rsource "*/Kconfig.soc"

endif # SOC_FAMILY_WCH_CH32
```

## soc/wch/ch32/ch32x035/Kconfig
```kconfig
config SOC_SERIES_CH32X035
    bool
    select SOC_FAMILY_WCH_CH32
    select RISCV_ISA_RV32I
    select RISCV_ISA_EXT_M
    select RISCV_ISA_EXT_A
    select RISCV_ISA_EXT_C
    select RISCV_ISA_EXT_ZICSR
    select ATOMIC_OPERATIONS_BUILTIN

config SOC_SERIES
    default "ch32x035" if SOC_SERIES_CH32X035
```

## soc/wch/ch32/ch32x035/Kconfig.defconfig
```kconfig
# Copyright (c) 2025 TiaC Systems
# Copyright (c) 2024 Matthew Tran
# SPDX-License-Identifier: Apache-2.0

if SOC_SERIES_CH32X035

config SYS_CLOCK_HW_CYCLES_PER_SEC
	default $(dt_node_int_prop_int,/cpus/cpu@0,clock-frequency)

config CLOCK_CONTROL
	default y

config NUM_IRQS
	default 54

endif # SOC_SERIES_CH32X035
```

## soc/wch/ch32/ch32x035/Kconfig.soc
```kconfig
# Copyright (c) 2024 Matthew Tran
# SPDX-License-Identifier: Apache-2.0

config SOC_CH32X035
    bool
    select SOC_SERIES_CH32X035

config SOC
    default "ch32x035" if SOC_CH32X035
```

## soc/wch/ch32v/Kconfig
```kconfig
# WinChipHead CH32V MCU line

# Copyright (c) 2025 TiaC Systems
# SPDX-License-Identifier: Apache-2.0

if SOC_FAMILY_CH32V

rsource "*/Kconfig"

endif # SOC_FAMILY_CH32V
```

## soc/wch/ch32v/Kconfig.defconfig
```kconfig
# WinChipHead CH32V MCU line

# Copyright (c) 2025 TiaC Systems
# SPDX-License-Identifier: Apache-2.0

# Kconfig symbols common to CH32V series

if SOC_FAMILY_CH32V

rsource "*/Kconfig.defconfig"

endif # SOC_FAMILY_CH32V
```
