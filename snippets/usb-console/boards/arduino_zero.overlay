/*
 * Copyright (c) 2023-2026 TiaC Systems
 * SPDX-License-Identifier: Apache-2.0
 */

/ {
	model = "Arduino Zero @ USB-CDC/ACM Concole";
	compatible = "arduino,zero",
		     "arduino,zero-usbcons",
		     "atmel,samd21g18a",
		     "atmel,samd21";

	chosen {
		zephyr,shell-uart = &snippet_cdc_acm_console_uart;
	};
};
