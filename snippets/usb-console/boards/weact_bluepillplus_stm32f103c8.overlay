/*
 * Copyright (c) 2025 TiaC Systems
 * SPDX-License-Identifier: Apache-2.0
 */

/ {
	model = "WeAct Studio BluePill+ STM32F103C8 @ USB-CDC/ACM Concole";
	compatible = "weact,bluepillplus-stm32f103c8",
		     "weact,bluepillplus-stm32f103c8-usbcons";

	chosen {
		zephyr,shell-uart = &snippet_cdc_acm_console_uart;
	};
};
