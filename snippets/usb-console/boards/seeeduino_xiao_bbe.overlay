/*
 * Copyright (c) 2024-2026 TiaC Systems
 * SPDX-License-Identifier: Apache-2.0
 */

/ {
	model = "Seeeduino XIAO @ USB-CDC/ACM Concole (BBE)";
	compatible = "seeed,seeeduino-xiao",
		     "seeed,seeeduino-xiao-bbe",
		     "seeed,seeeduino-xiao-usbcons",
		     "seeed,seeeduino-xiao-usbcons-bbe",
		     "atmel,samd21g18a",
		     "atmel,samd21";

	chosen {
		zephyr,shell-uart = &snippet_cdc_acm_console_uart;
	};
};
