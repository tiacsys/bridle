/*
 * Copyright (c) 2023-2026 TiaC Systems
 * SPDX-License-Identifier: Apache-2.0
 */

/ {
	model = "Waveshare RP2040-Tiny @ USB-CDC/ACM Concole";
	compatible = "waveshare,rp2040-tiny",
		     "waveshare,rp2040-tiny-usbcons";

	chosen {
		zephyr,shell-uart = &snippet_cdc_acm_console_uart;
	};
};
