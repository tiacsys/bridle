/*
 * Copyright (c) 2023-2026 TiaC Systems
 * SPDX-License-Identifier: Apache-2.0
 */

/ {
	model = "Raspberry Pi Pico @ USB-CDC/ACM Concole (BBE)";
	compatible = "raspberrypi,rpi-pico",
		     "raspberrypi,rpi-pico-bbe",
		     "raspberrypi,rpi-pico-usbcons",
		     "raspberrypi,rpi-pico-usbcons-bbe";

	chosen {
		zephyr,shell-uart = &snippet_cdc_acm_console_uart;
	};
};
