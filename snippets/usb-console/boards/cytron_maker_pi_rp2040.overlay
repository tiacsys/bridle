/*
 * Copyright (c) 2023-2026 TiaC Systems
 * SPDX-License-Identifier: Apache-2.0
 */

/ {
	model = "Cytron Maker Pi RP2040 @ USB-CDC/ACM Concole";
	compatible = "cytron,maker-pi-rp2040",
		     "cytron,maker-pi-rp2040-usbcons";

	chosen {
		zephyr,shell-uart = &snippet_cdc_acm_console_uart;
	};
};
