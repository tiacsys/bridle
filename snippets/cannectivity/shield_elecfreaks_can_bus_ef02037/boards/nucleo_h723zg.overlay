/ {
	cannectivity: cannectivity {
		compatible = "cannectivity";

		/delete-node/ channel0;
		channel0 {
			compatible = "cannectivity-channel";

			can-controller = <&mcp2515_elecfreaks_can_bus_ef02037>;
			state-led = <&yellow_led>;
			activity-leds = <&green_led &red_led>;
		};
	};
};

&fdcan1 {
	status = "disabled";
};
