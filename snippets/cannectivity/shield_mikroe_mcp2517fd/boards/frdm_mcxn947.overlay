/ {
	cannectivity: cannectivity {
		compatible = "cannectivity";

		channel1 {
			compatible = "cannectivity-channel";

			can-controller = <&mcp2517fd_mikroe_mcp2517fd_click>;
			state-led = <&green_led>;
		};
	};
};
