/ {
	cannectivity: cannectivity {
		compatible = "cannectivity";

		channel0 {
			compatible = "cannectivity-channel";

			can-controller = <&fdcan1>;
			state-led = <&yellow_led>;
			activity-leds = <&green_led &red_led>;
		};
	};
};
