/* Copyright (c) 2026 TiaC Systems
 * SPDX-License-Identifier: Apache-2.0
 */
/dts-v1/;

/*
 * Fixture board for the 3-cell PWM feature's UNSUPPORTED-COUNT witness
 * (a count outside the supported set is refused at board load): tc_socket4
 * and its parent controller BOTH declare #pwm-cells = <4> --
 * self-consistent with each other, but 4 is outside the supported set
 * {2, 3} -- board/project.py's own checked read must still refuse this with
 * the same phys-board LoadError shape and "supports only ... today"
 * wording any unsupported count draws -- 3-cell support widened the
 * accepted set, not the refusal. Distinct from the mismatch board: here
 * both sides AGREE with each other, they just agree on a count rigc
 * does not support.
 */
/ {
	model = "Three-Cell PWM Unsupported-Count Fixture Board";
	compatible = "vnd,three-cell-pwm-unsupported-fixture-board";

	tc_pwm4: pwm_ctrl4 {
		#pwm-cells = <4>;
	};

	tc_socket4: connector_tc_socket4 {
		compatible = "socket,three-cell-pwm-nexus";

		#pwm-cells = <4>;
		pwm-map = <0 0 0 0 &tc_pwm4 0 0 0 0>;
	};
};
