## CMakeLists.txt
```
# SPDX-FileCopyrightText: 2021-2026 TiaC Systems
# SPDX-License-Identifier: Apache-2.0

cmake_minimum_required(VERSION 3.28.0)
find_package(Bridle REQUIRED HINTS $ENV{BRIDLE_BASE})
project(bridle_common)

target_sources(app PRIVATE
  src/main.c
  )
```

## prj.conf
```kconfig
# SPDX-FileCopyrightText: 2021-2026 TiaC Systems
# SPDX-License-Identifier: Apache-2.0

# zephyr-keep-sorted-start
CONFIG_ZTEST=y
# zephyr-keep-sorted-stop

# zephyr-keep-sorted-start
CONFIG_BOOT_DELAY=500
CONFIG_BOUNDS_CHECK_BYPASS_MITIGATION=y
CONFIG_IRQ_OFFLOAD=y
CONFIG_LOG=y
CONFIG_POLL=y
CONFIG_PRINTK=y
CONFIG_TEST_USERSPACE=y
# zephyr-keep-sorted-stop
```

## boards/qemu_riscv32_xip.conf
```kconfig
# SPDX-FileCopyrightText: 2021-2026 TiaC Systems
# SPDX-License-Identifier: Apache-2.0

# disable components to avoid RAM overflow on BSS allocation
# zephyr-keep-sorted-start
CONFIG_TEST_HW_STACK_PROTECTION=n
CONFIG_TEST_USERSPACE=n
# zephyr-keep-sorted-stop
```

## src/main.c
```c
/*
 * SPDX-FileCopyrightText: 2021-2026 TiaC Systems
 * SPDX-FileCopyrightText: 2016 Intel Corporation
 * SPDX-License-Identifier: Apache-2.0
 */

#include <zephyr/ztest.h>
#include <bridle/core_version.h>
#include "bridle/version.h"

/**
 * @defgroup bridle_common_tests Common Tests
 * @ingroup  all_tests
 * @since    3.7
 * @version  2.0.0
 */

/**
 * @brief Test sys_bridle_version_get() functionality
 *
 * @ingroup bridle_common_tests
 *
 * @see sys_bridle_version_get()
 */
ZTEST(common, test_version)
{
	uint32_t version = sys_bridle_version_get();

	zassert_true(version == BRIDLEVERSION, "version mismatch");

	zassert_true(SYS_BRIDLE_VER_MAJOR(version) == BRIDLE_VERSION_MAJOR,
		     "major version mismatch");
	zassert_true(SYS_BRIDLE_VER_MINOR(version) == BRIDLE_VERSION_MINOR,
		     "minor version mismatch");
	zassert_true(SYS_BRIDLE_VER_PATCHLEVEL(version) == BRIDLE_PATCHLEVEL,
		     "patchlevel version match");
}

ZTEST_SUITE(common, NULL, NULL, NULL, NULL, NULL);
```
