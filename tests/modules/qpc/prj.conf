## CMakeLists.txt
```
# Copyright (c) 2021 TiaC Systems
# SPDX-License-Identifier: Apache-2.0

cmake_minimum_required(VERSION 3.13.1)
find_package(Zephyr REQUIRED HINTS $ENV{ZEPHYR_BASE})
project(test_qpc)

target_sources(app PRIVATE
  src/main.c
  src/test_qep_minimal.c
  src/test_qep_simple.c
  )
```

## prj.conf
```kconfig
CONFIG_ZTEST=y
CONFIG_ZTEST_NEW_API=y
CONFIG_PRINTK=y
CONFIG_LOG=y
CONFIG_POLL=y
CONFIG_BOOT_DELAY=500
CONFIG_IRQ_OFFLOAD=y
CONFIG_BOUNDS_CHECK_BYPASS_MITIGATION=y
CONFIG_QPC=y
CONFIG_QPC_NO_QASSERT=n
CONFIG_QPC_AO_SUPPORT=y

CONFIG_DEBUG=y
CONFIG_DEBUG_OPTIMIZATIONS=y
```

## src/main.c
```c
/*
 * Copyright (c) 2021 TiaC Systems
 * Copyright (c) 2016 Intel Corporation
 *
 * SPDX-License-Identifier: Apache-2.0
 */

#include <ztest.h>

void test_main(void)
{
	ztest_run_test_suites(NULL);
}
```

## src/test_qep_hierarchical.c
```c
/**
 * @defgroup module_qpc_tests QPC Tests
 * @ingroup all_tests
 * @{
 * @file
 * @brief Test suite: Hierarchical QHsm
 * @}
 *
 */
#include <zephyr.h>
#include <ztest.h>

#include <qep_port.h>
#include <qassert.h>

#ifndef CONFIG_QPC_NO_QASSERT
Q_DEFINE_THIS_FILE
#endif

typedef struct MyHsm
{
    QHsm super;
} MyHsm_t;

enum MyHsmSignals
{
    ACTIVATE_SIG = Q_USER_SIG,
    DEACTIVATE_SIG,
    TOGGLE_SIG,
    MAX_SIG
};

static MyHsm_t dut;
static QState MyHsm_active(MyHsm_t *me, QEvt const *e);
static QState MyHsm_active_collecting(MyHsm_t *me, QEvt const *e);
static QState MyHsm_active_storing(MyHsm_t *me, QEvt const *e);

static QState MyHsm_inactive(MyHsm_t *me, QEvt const *e);

static QState MyHsm_active(MyHsm_t *me, QEvt const *e)
{
    QState status;

    switch (e->sig)
    {
    case Q_ENTRY_SIG:
    {
        printk("enter active\n");
        status = Q_HANDLED();
        break;
    }
    case Q_EXIT_SIG:
    {
        printk("leaving active\n");
        status = Q_HANDLED();
        break;
    }

    case Q_INIT_SIG:
    {
        printk("init active\n");
        status = Q_TRAN(&MyHsm_active_collecting);
        break;
    }

    case DEACTIVATE_SIG:
    {
        status = Q_TRAN(&MyHsm_inactive);
        break;
    }
    default:
    {
        status = Q_SUPER(&QHsm_top);
        break;
    }
    }
    return status;
}

static QState MyHsm_active_collecting(MyHsm_t *me, QEvt const *e)
{
    QState status;

    switch (e->sig)
    {
    case Q_ENTRY_SIG:
    {
        printk("enter active.collecting\n");
        status = Q_HANDLED();
        break;
    }
    case Q_EXIT_SIG:
    {
        printk("leaving active.collecting\n");
        status = Q_HANDLED();
        break;
    }

    case TOGGLE_SIG:
    {
        status = Q_TRAN(&MyHsm_active_storing);
        break;
    }

    default:
    {
        status = Q_SUPER(&MyHsm_active);
        break;
    }
    }
    return status;
}

static QState MyHsm_active_storing(MyHsm_t *me, QEvt const *e)
{
    QState status;

    switch (e->sig)
    {
    case Q_ENTRY_SIG:
    {
        printk("enter active.storing\n");
        status = Q_HANDLED();
        break;
    }
    case Q_EXIT_SIG:
    {
        printk("leaving active.storing\n");
        status = Q_HANDLED();
        break;
    }

    case TOGGLE_SIG:
    {
        status = Q_TRAN(&MyHsm_active_collecting);
        break;
    }

    default:
    {
        status = Q_SUPER(&MyHsm_active);
        break;
    }
    }
    return status;
}

static QState MyHsm_inactive(MyHsm_t *me, QEvt const *e)
{
    QState status;
    switch (e->sig)
    {
    case Q_ENTRY_SIG:
    {
        printk("enter inactive\n");
        status = Q_HANDLED();
        break;
    }
    case Q_EXIT_SIG:
    {
        printk("leaving inactive\n");
        status = Q_HANDLED();
        break;
    }

    case TOGGLE_SIG:
    {
        status = Q_TRAN(&MyHsm_active);
        break;
    }

    default:
    {
        status = Q_SUPER(&QHsm_top);
        break;
    }
    }
    return status;
}

static QState MyHsm_initial(MyHsm_t *me, QEvt const *e)
{
    return Q_TRAN(&MyHsm_active);
}

static void MyHsm_ctor()
{
    MyHsm_t *me = &dut;
    QHsm_ctor(&me->super, (QStateHandler)&MyHsm_initial);
}

static void *suite_setup()
{
    printk("setup suite\n");
    return NULL;
}

static void suite_before_each_test()
{
    QHsm *const Q_dut = (QHsm *)&dut;

    printk("reset state machine object\n");
    MyHsm_ctor();
    QHSM_INIT(Q_dut, NULL, NULL);
}

ZTEST_SUITE(qpc_hierarchical, NULL, suite_setup, suite_before_each_test, NULL, NULL);

/**
 * @brief Test QHsm init functionality
 *
 * @ingroup module_qpc_tests QPC Tests
 *
 *
 */
ZTEST(qpc_hierarchical, test_when_init_then_active_collecting)
{
    QHsm *const Q_dut = (QHsm *)&dut;

    zassert_true(QHsm_state(Q_dut) == Q_STATE_CAST(MyHsm_active_collecting), "active.collecting state not reached");
}

/**
 * @brief Test QHsm child to child state transition
 *
 * @ingroup module_qpc_tests QPC Tests
 *
 *
 */
ZTEST(qpc_hierarchical, test_when_active_then_toggle_between_substates)
{
    QEvt e;
    QHsm *const Q_dut = (QHsm *)&dut;

    e.sig = TOGGLE_SIG;

    QHSM_DISPATCH(Q_dut, &e, NULL);
    zassert_true(QHsm_state(Q_dut) == Q_STATE_CAST(MyHsm_active_storing), "active.storing state not reached");

    QHSM_DISPATCH(Q_dut, &e, NULL);
    zassert_true(QHsm_state(Q_dut) == Q_STATE_CAST(MyHsm_active_collecting), "active.collecting state not reached");
}


/**
 * @brief Test QHsm leave any child state functionality
 *
 * @ingroup module_qpc_tests QPC Tests
 *
 *
 */
ZTEST(qpc_hierarchical, test_when_active_and_deactivate_then_inactive)
{
    QEvt e;
    QHsm *const Q_dut = (QHsm *)&dut;

    e.sig = DEACTIVATE_SIG;

    QHSM_DISPATCH(Q_dut, &e, NULL);

    zassert_true(QHsm_state(Q_dut) == Q_STATE_CAST(MyHsm_inactive), "inactive state not reached");
}
```

## src/test_qep_minimal.c
```c
/**
 * @defgroup module_qpc_tests QPC Tests
 * @ingroup all_tests
 * @{
 * @file
 * @brief Test suite: Minimal QHsm
 * @}
 *
 */
#include <zephyr.h>
#include <ztest.h>

#include <qep_port.h>
#include <qassert.h>

#ifndef CONFIG_QPC_NO_QASSERT
	Q_DEFINE_THIS_MODULE("test_minimal")
#endif


typedef struct MyHsm
{
	QHsm super;
	int my_state;
} MyHsm_t;

static MyHsm_t dut;

static QState MyHsm_active(MyHsm_t *me, QEvt const *e)
{
	QState status;

    switch (e->sig) {
         case Q_ENTRY_SIG: {
             printk("enter active\n");
			 me->my_state++;
             status = Q_HANDLED();
             break;
         }
         case Q_EXIT_SIG: {
             printk("leaving active\n");
			 status = Q_HANDLED();
             break;
         }

		 case Q_INIT_SIG:{
			 printk("init active\n");
			 me->my_state++;
			 status = Q_SUPER(&QHsm_top);
			 break;
		 }

         default: {
			 printk("defer to super state\n");
             status = Q_SUPER(&QHsm_top);
             break;
         }
     }
	return status;
}

static QState MyHsm_initial(MyHsm_t *me, QEvt const *e)
{
	me->my_state++;
	return Q_TRAN(&MyHsm_active);
}

static void MyHsm_ctor(void)
{
	MyHsm_t *me = &dut;
	QHsm_ctor(&me->super, (QStateHandler)&MyHsm_initial);
	me->my_state = 0;
}


ZTEST_SUITE(qpc_minimal, NULL, NULL, NULL, NULL, NULL);

/**
 * @brief Test QHsm ctor functionality
 *
 * @ingroup module_qpc_tests QPC Tests
 *
 *
 */
ZTEST(qpc_minimal, test_can_construct_Hsm)
{
	MyHsm_ctor();	
	zassert_true(dut.my_state==0, "state machine ctor not called");

}

/**
 * @brief Test QHsm init functionality
 *
 * @ingroup module_qpc_tests QPC Tests
 *
 *
 */
ZTEST(qpc_minimal, test_can_initialize_Hsm)
{
	QHsm *const Q_dut = (QHsm *)&dut;

	QHSM_INIT(Q_dut, NULL, NULL);
	zassert_true(dut.my_state==3, "active state initialized and entered");

}
```

## src/test_qep_simple.c
```c
/**
 * @defgroup module_qpc_tests QPC Tests
 * @ingroup all_tests
 * @{
 * @file
 * @brief Test suite: Simple QHsm
 * @}
 *
 */
#include <zephyr.h>
#include <ztest.h>

#include <qep_port.h>
#include <qassert.h>

#ifndef CONFIG_QPC_NO_QASSERT
Q_DEFINE_THIS_MODULE("test_simple")
#endif

typedef struct MyHsm
{
	QHsm super;
	int my_state;
} MyHsm_t;

enum MyHsmSignals
{
	TOGGLE_SIG = Q_USER_SIG,
	MAX_SIG
};

static MyHsm_t dut;
static QState MyHsm_active(MyHsm_t *me, QEvt const *e);
static QState MyHsm_inactive(MyHsm_t *me, QEvt const *e);

static QState MyHsm_active(MyHsm_t *me, QEvt const *e)
{
	QState status;

	switch (e->sig)
	{
	case Q_ENTRY_SIG:
	{
		printk("enter active\n");
		me->my_state++;
		status = Q_HANDLED();
		break;
	}
	case Q_EXIT_SIG:
	{
		printk("leaving active\n");
		status = Q_HANDLED();
		break;
	}

	case Q_INIT_SIG:
	{
		printk("init active\n");
		me->my_state++;
		status = Q_SUPER(&QHsm_top);
		break;
	}

	case TOGGLE_SIG:
	{
		status = Q_TRAN(&MyHsm_inactive);
		break;
	}

	default:
	{
		printk("defer to super state\n");
		status = Q_SUPER(&QHsm_top);
		break;
	}
	}
	return status;
}

static QState MyHsm_inactive(MyHsm_t *me, QEvt const *e)
{
	QState status;
	switch (e->sig)
	{
		case Q_ENTRY_SIG:
	{
		printk("enter inactive\n");
		me->my_state++;
		status = Q_HANDLED();
		break;
	}
	case Q_EXIT_SIG:
	{
		printk("leaving inactive\n");
		status = Q_HANDLED();
		break;
	}

	case Q_INIT_SIG:
	{
		printk("init inactive\n");
		me->my_state++;
		status = Q_SUPER(&QHsm_top);
		break;
	}

	case TOGGLE_SIG:
	{
		status = Q_TRAN(&MyHsm_active);
		break;
	}

	default:
	{
		status = Q_SUPER(&QHsm_top);
		break;
	}
	}
	return status;
}

static QState MyHsm_initial(MyHsm_t *me, QEvt const *e)
{
	me->my_state++;
	return Q_TRAN(&MyHsm_active);
}

static void MyHsm_ctor()
{
	MyHsm_t *me = &dut;
	QHsm_ctor(&me->super, (QStateHandler)&MyHsm_initial);
	me->my_state = 0;
}

static void *suite_setup()
{
	printk("setup suite\n");
	return NULL;
}

static void suite_before_each_test()
{
	QHsm *const Q_dut = (QHsm *)&dut;

	printk("before each test\n");
	MyHsm_ctor();
	QHSM_INIT(Q_dut, NULL, NULL);
}

ZTEST_SUITE(qpc_simple, NULL, suite_setup, suite_before_each_test, NULL, NULL);

/**
 * @brief Test QHsm init functionality
 *
 * @ingroup module_qpc_tests QPC Tests
 *
 *
 */
ZTEST(qpc_simple, test_when_active_and_event_then_inactive)
{
	QEvt e;
	QHsm *const Q_dut = (QHsm *)&dut;

	e.sig = TOGGLE_SIG;

	QHSM_DISPATCH(Q_dut, &e, NULL);
	zassert_true(QHsm_state(Q_dut) == Q_STATE_CAST(MyHsm_inactive), "inactive state not reached");
}

/**
 * @brief Test QHsm init functionality
 *
 * @ingroup module_qpc_tests QPC Tests
 *
 *
 */
ZTEST(qpc_simple, test_when_inactive_and_event_then_active)
{
	QEvt e;
	QHsm *const Q_dut = (QHsm *)&dut;

	e.sig = TOGGLE_SIG;

	QHSM_DISPATCH(Q_dut, &e, NULL);
	QHSM_DISPATCH(Q_dut, &e, NULL);
	zassert_true(QHsm_state(Q_dut) == Q_STATE_CAST(MyHsm_active), "active state not reached");
}
```

## src/test_qf_minimal.c
```c
/**
 * @defgroup module_qf_tests qf Tests
 * @ingroup all_tests
 * @{
 * @file
 * @brief Test suite: Minimal QHsm
 * @}
 *
 */
#include <zephyr.h>
#include <ztest.h>

#define QP_IMPL
#include <qf_port.h>
#include <qf_pkg.h>
#include <qassert.h>

#ifndef CONFIG_qf_NO_QASSERT
	Q_DEFINE_THIS_FILE
#endif

typedef struct MyAO
{
	QActive super;
	int my_state;
} MyAO_t;

static MyAO_t dut;
static QEvt const *dutQSto[10];

static QState MyAO_active(MyAO_t *me, QEvt const *e)
{
	QState status;

	switch (e->sig)
	{
	case Q_ENTRY_SIG:
	{
		printk("enter active\n");
		me->my_state++;
		status = Q_HANDLED();
		break;
	}
	case Q_EXIT_SIG:
	{
		printk("leaving active\n");
		status = Q_HANDLED();
		break;
	}

	case Q_INIT_SIG:
	{
		printk("init active\n");
		me->my_state++;
		status = Q_SUPER(&QHsm_top);
		break;
	}

	default:
	{
		printk("defer to super state\n");
		status = Q_SUPER(&QHsm_top);
		break;
	}
	}
	return status;
}

static QState MyAO_initial(MyAO_t *me, QEvt const *e)
{
	me->my_state++;
	return Q_TRAN(&MyAO_active);
}

static void MyAO_ctor(void)
{
	MyAO_t *me = &dut;
	QActive_ctor(&me->super, Q_STATE_CAST(&MyAO_initial));
	me->my_state = 0;
}

ZTEST_SUITE(qf_minimal, NULL, NULL, NULL, NULL, NULL);

/**
 * @brief Test AO ctor functionality
 *
 * @ingroup module_qf_tests qf Tests
 *
 *
 */
ZTEST(qf_minimal, test_can_construct_AO)
{
	MyAO_ctor();
	zassert_true(dut.my_state == 0, "state machine ctor not called");
}

/**
 * @brief Test AO event init functionality
 *
 * @ingroup module_qf_tests qf Tests
 *
 *
 */
ZTEST(qf_minimal, test_can_initialize_event_queue)
{
	QActive *Q_dut = (QActive *)&dut;
	QEQueue_init(&Q_dut->eQueue, dutQSto, Q_DIM(dutQSto));
	zassert_true(Q_dut->eQueue.ring == dutQSto, "event queue not properly initialized");
	zassert_true(Q_dut->eQueue.nFree==11, "queue size not correct");
}


/**
 * @brief Test AO init functionality
 *
 * @ingroup module_qf_tests qf Tests
 *
 *
 */
ZTEST(qf_minimal, test_can_initialize_hsm)
{
	QActive *Q_dut = (QActive *)&dut;
	MyAO_ctor();

	QHSM_INIT(&Q_dut->super, NULL, 0);
	zassert_true(QHsm_state(Q_dut) == Q_STATE_CAST(MyAO_active), "active state not reached");
}
```

## src/tests.h
```c
#ifndef __QPC_TESTS
#define __QPC_TESTS



#endif
```
