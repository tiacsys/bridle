## tests/snippets/usb-console/build_all/boards/picoboy_color_plus_rp2350a_m33.conf
```kconfig
# Copyright (c) 2025 TiaC Systems
# SPDX-License-Identifier: Apache-2.0

CONFIG_TEST_CHOSEN_ZEPHYR_SHELL_UART=y

# JSED @ PicoBoy Color
CONFIG_TEST_EXPECTED_USB_DEVICE_VID=0x2E8A
CONFIG_TEST_EXPECTED_USB_DEVICE_PID=0x000A
CONFIG_TEST_EXPECTED_USB_DEVICE_MANUFACTURER="JSED (Raspberry Pi)"
CONFIG_TEST_EXPECTED_USB_DEVICE_PRODUCT="PicoBoy Color Plus (CDC ACM)"
```

## tests/snippets/usb-console/build_all/boards/rpi_pico.conf
```kconfig
# Copyright (c) 2025 TiaC Systems
# SPDX-License-Identifier: Apache-2.0

CONFIG_TEST_CHOSEN_ZEPHYR_SHELL_UART=y

# Raspberry Pi @ Raspberry Pi Pico
CONFIG_TEST_EXPECTED_USB_DEVICE_VID=0x2e8a
CONFIG_TEST_EXPECTED_USB_DEVICE_PID=0x000a
CONFIG_TEST_EXPECTED_USB_DEVICE_MANUFACTURER="Raspberry Pi"
CONFIG_TEST_EXPECTED_USB_DEVICE_PRODUCT="RPi Pico (CDC ACM)"
```

## tests/snippets/usb-console/build_all/boards/seeeduino_lotus.conf
```kconfig
# Copyright (c) 2025 TiaC Systems
# SPDX-License-Identifier: Apache-2.0

CONFIG_TEST_CHOSEN_ZEPHYR_SHELL_UART=y

# Atmel Corp. SAMD21 @ Seeeduino Lotus Cortex-M0+
CONFIG_TEST_EXPECTED_USB_DEVICE_VID=0x2886
CONFIG_TEST_EXPECTED_USB_DEVICE_PID=0x8026
CONFIG_TEST_EXPECTED_USB_DEVICE_MANUFACTURER="Seeed LLC"
CONFIG_TEST_EXPECTED_USB_DEVICE_PRODUCT="Seeeduino Lotus Cortex-M0+ (CDC ACM)"
```

## tests/snippets/usb-console/build_all/boards/seeeduino_xiao_bbe.conf
```kconfig
# Copyright (c) 2025 TiaC Systems
# SPDX-License-Identifier: Apache-2.0

CONFIG_TEST_CHOSEN_ZEPHYR_SHELL_UART=y

# Atmel Corp. SAMD21 @ Seeeduino XIAO M0
CONFIG_TEST_EXPECTED_CDC_ACM_SERIAL_VID=0x2886
CONFIG_TEST_EXPECTED_CDC_ACM_SERIAL_PID=0x802f
CONFIG_TEST_EXPECTED_CDC_ACM_SERIAL_MANUFACTURER_STRING="Seeed"
CONFIG_TEST_EXPECTED_CDC_ACM_SERIAL_PRODUCT_STRING="Seeed XIAO M0 (CDC ACM)"
CONFIG_TEST_EXPECTED_CDC_ACM_SERIAL_SELF_POWERED=n
CONFIG_TEST_EXPECTED_CDC_ACM_SERIAL_MAX_POWER=250
```

## tests/snippets/usb-console/build_all/boards/vccgnd_bluepill_stm32f072cb.conf
```kconfig
# Copyright (c) 2025 TiaC Systems
# SPDX-License-Identifier: Apache-2.0

CONFIG_TEST_CHOSEN_ZEPHYR_SHELL_UART=y

# VccGND Studio @ BluePill STM32F072
CONFIG_TEST_EXPECTED_CDC_ACM_SERIAL_VID=0x0483
CONFIG_TEST_EXPECTED_CDC_ACM_SERIAL_PID=0x5740
CONFIG_TEST_EXPECTED_CDC_ACM_SERIAL_MANUFACTURER_STRING="VccGND (STMicroelectronics)"
CONFIG_TEST_EXPECTED_CDC_ACM_SERIAL_PRODUCT_STRING="BluePill STM32F072 (CDC ACM)"
CONFIG_TEST_EXPECTED_CDC_ACM_SERIAL_SELF_POWERED=n
CONFIG_TEST_EXPECTED_CDC_ACM_SERIAL_MAX_POWER=250
```

## tests/snippets/usb-console/build_all/boards/waveshare_rp2040_eth.conf
```kconfig
# Copyright (c) 2025 TiaC Systems
# SPDX-License-Identifier: Apache-2.0

CONFIG_TEST_CHOSEN_ZEPHYR_SHELL_UART=y

# Waveshare @ RP2040-ETH
CONFIG_TEST_EXPECTED_USB_DEVICE_VID=0x2e8a
CONFIG_TEST_EXPECTED_USB_DEVICE_PID=0x000a
CONFIG_TEST_EXPECTED_USB_DEVICE_MANUFACTURER="Waveshare (Raspberry Pi)"
CONFIG_TEST_EXPECTED_USB_DEVICE_PRODUCT="RP2040-ETH (CDC ACM)"
```

## tests/snippets/usb-console/build_all/boards/waveshare_rp2040_matrix.conf
```kconfig
# Copyright (c) 2025 TiaC Systems
# SPDX-License-Identifier: Apache-2.0

CONFIG_TEST_CHOSEN_ZEPHYR_SHELL_UART=y

# Waveshare @ RP2040-Matrix
CONFIG_TEST_EXPECTED_CDC_ACM_SERIAL_VID=0x2e8a
CONFIG_TEST_EXPECTED_CDC_ACM_SERIAL_PID=0x000a
CONFIG_TEST_EXPECTED_CDC_ACM_SERIAL_MANUFACTURER_STRING="Waveshare (Raspberry Pi)"
CONFIG_TEST_EXPECTED_CDC_ACM_SERIAL_PRODUCT_STRING="RP2040-Matrix (CDC ACM)"
CONFIG_TEST_EXPECTED_CDC_ACM_SERIAL_SELF_POWERED=n
CONFIG_TEST_EXPECTED_CDC_ACM_SERIAL_MAX_POWER=150
```

## tests/snippets/usb-console/build_all/boards/weact_bluepillplus_ch32v203c8.conf
```kconfig
# Copyright (c) 2025 TiaC Systems
# SPDX-License-Identifier: Apache-2.0

CONFIG_TEST_CHOSEN_ZEPHYR_SHELL_UART=y

# WeAct Studio @ BluePill+ CH32V203
CONFIG_TEST_EXPECTED_CDC_ACM_SERIAL_VID=0x0483
CONFIG_TEST_EXPECTED_CDC_ACM_SERIAL_PID=0x5740
CONFIG_TEST_EXPECTED_CDC_ACM_SERIAL_MANUFACTURER_STRING="WeAct (STMicroelectronics)"
CONFIG_TEST_EXPECTED_CDC_ACM_SERIAL_PRODUCT_STRING="BluePill+ CH32V203 (CDC ACM)"
CONFIG_TEST_EXPECTED_CDC_ACM_SERIAL_SELF_POWERED=n
CONFIG_TEST_EXPECTED_CDC_ACM_SERIAL_MAX_POWER=250
```

## tests/snippets/usb-console/build_all/boards/weact_bluepillplus_stm32f103c8.conf
```kconfig
# Copyright (c) 2025 TiaC Systems
# SPDX-License-Identifier: Apache-2.0

CONFIG_TEST_CHOSEN_ZEPHYR_SHELL_UART=y

# WeAct Studio @ BluePill+ STM32F103
CONFIG_TEST_EXPECTED_USB_DEVICE_VID=0x0483
CONFIG_TEST_EXPECTED_USB_DEVICE_PID=0x5740
CONFIG_TEST_EXPECTED_USB_DEVICE_MANUFACTURER="WeAct (STMicroelectronics)"
CONFIG_TEST_EXPECTED_USB_DEVICE_PRODUCT="BluePill+ STM32F103 (CDC ACM)"
```

## tests/snippets/usb-console/build_all/boards/xiao_rp2040_rp2040_bbe.conf
```kconfig
# Copyright (c) 2026 TiaC Systems
# SPDX-License-Identifier: Apache-2.0

CONFIG_TEST_CHOSEN_ZEPHYR_SHELL_UART=y

# Seeed LLC @ XIAO RP2040
CONFIG_TEST_EXPECTED_CDC_ACM_SERIAL_VID=0x2e8a
CONFIG_TEST_EXPECTED_CDC_ACM_SERIAL_PID=0x000a
CONFIG_TEST_EXPECTED_CDC_ACM_SERIAL_MANUFACTURER_STRING="Seeed LLC (Raspberry Pi)"
CONFIG_TEST_EXPECTED_CDC_ACM_SERIAL_PRODUCT_STRING="XIAO RP2040 (CDC ACM)"
CONFIG_TEST_EXPECTED_CDC_ACM_SERIAL_SELF_POWERED=n
CONFIG_TEST_EXPECTED_CDC_ACM_SERIAL_MAX_POWER=250
```

## tests/snippets/usb-console/build_all/boards/xiao_samd21.conf
```kconfig
# Copyright (c) 2025 TiaC Systems
# SPDX-License-Identifier: Apache-2.0

CONFIG_TEST_CHOSEN_ZEPHYR_SHELL_UART=y

# Atmel Corp. SAMD21 @ Seeeduino XIAO SAMD21
CONFIG_TEST_EXPECTED_USB_DEVICE_VID=0x2886
CONFIG_TEST_EXPECTED_USB_DEVICE_PID=0x802f
CONFIG_TEST_EXPECTED_USB_DEVICE_MANUFACTURER="Seeed Studio"
CONFIG_TEST_EXPECTED_USB_DEVICE_PRODUCT="XIAO SAMD21 (CDC ACM)"
```

## tests/snippets/usb-console/build_all/testcase.yaml
```yaml
##############################################################################
###
### ATTENTION:
###
### This test suite will be controlled by the standard integration platforms
### and must be invoked with the corresponding quarantine list. Otherwise,
### many board-shield constellations will terminate with an error.
###
###     west twister -G --quarantine-list bridle/tests/quarantine.yaml … … …
###
##############################################################################
common:
  tags:
    - base
    - snippets
    - usb-console
    - usb
  sysbuild: false
  build_only: true
  build_on_all: true
  filter: CONFIG_USB_DEVICE_STACK_NEXT and CONFIG_USBD_CDC_ACM_CLASS and
          dt_compat_enabled("zephyr,cdc-acm-uart") and
          dt_chosen_enabled("zephyr,console")
  # platform_exclude:
  #
  # AVOID `platform_exclude` statement here in the `common` section!
  #   USE the `tests/quarantine.yaml`file instead.
  #
  platform_allow:
    - native_sim
    - native_sim/native/64
    - arduino_zero/samd21g18a
    - arduino_zero/samd21g18a/bbe
    - coffeecaller_nrf52
    - cytron_maker_nano_rp2040
    - cytron_maker_pi_rp2040
    - cytron_motion_2350_pro/rp2350a/hazard3
    - cytron_motion_2350_pro/rp2350a/m33
    - magpie_f777ni
    - mimxrt1010_evk/mimxrt1011
    - mimxrt1010_evk/mimxrt1011/bbe
    - mimxrt1060_evk@A/mimxrt1062/qspi
    - mimxrt1060_evk@A/mimxrt1062/qspi/bbe
    - mimxrt1060_evk@B/mimxrt1062/qspi
    - mimxrt1060_evk@B/mimxrt1062/qspi/bbe
    - mimxrt1060_evk@C/mimxrt1062/qspi
    - mimxrt1060_evk@C/mimxrt1062/qspi/bbe
    - mimxrt1060_evk@C/mimxrt1062/hyperflash
    - mimxrt1060_evk@C/mimxrt1062/hyperflash/bbe
    - mimxrt1170_evk@A/mimxrt1176/cm7
    - mimxrt1170_evk@B/mimxrt1176/cm7
    - mini_usb_rp2040
    - mini_usb_rp2040@16mb
    - mini_usb_rp2040@chipled
    - mini_usb_rp2350/rp2350a/m33
    - mini_usb_rp2350@16mb/rp2350a/m33
    - nucleo_f413zh/stm32f413xx
    - nucleo_f413zh/stm32f413xx/bbe
    - nucleo_f746zg/stm32f746xx
    - nucleo_f746zg/stm32f746xx/bbe
    - nucleo_f767zi/stm32f767xx
    - nucleo_f767zi/stm32f767xx/bbe
    - nucleo_l496zg/stm32l496xx
    - nucleo_l496zg/stm32l496xx/bbe
    - picoboy/rp2040
    - picoboy_color/rp2040
    - picoboy_color_plus/rp2350a/m33
    - rpi_pico/rp2040
    - rpi_pico/rp2040/bbe
    - rpi_pico/rp2040/mcuboot
    - rpi_pico/rp2040/mcuboot/bbe
    - rpi_pico/rp2040/w
    - rpi_pico/rp2040/w/bbe
    - rpi_pico/rp2040/w/mcuboot
    - rpi_pico/rp2040/w/mcuboot/bbe
    - rpi_pico2/rp2350a/hazard3
    - rpi_pico2/rp2350a/hazard3/bbe
    - rpi_pico2/rp2350a/m33
    - rpi_pico2/rp2350a/m33/bbe
    - rpi_pico2/rp2350a/m33/mcuboot
    - rpi_pico2/rp2350a/m33/mcuboot/bbe
    - rpi_pico2/rp2350a/m33/w
    - rpi_pico2/rp2350a/m33/w/bbe
    - rpi_pico2/rp2350a/m33/w/mcuboot
    - rpi_pico2/rp2350a/m33/w/mcuboot/bbe
    - seeeduino_cm0/samd21g18a
    - seeeduino_lotus/samd21g18a
    - seeeduino_xiao/samd21g18a
    - seeeduino_xiao/samd21g18a/bbe
    - xiao_samd21/samd21g18a
    - xiao_rp2040
    - xiao_rp2350/rp2350a/hazard3
    - xiao_rp2350/rp2350a/m33
    - vccgnd_bluepill_stm32f103cb
    - vccgnd_bluepill_stm32f103c8
    - vccgnd_bluepill_stm32f072cb
    - vccgnd_bluepill_stm32f072c8
    - waveshare_rp2040_one
    - waveshare_rp2040_zero
    - waveshare_rp2040_matrix
    - waveshare_rp2040_tiny
    - waveshare_rp2040_eth
    - waveshare_rp2040_lcd_0_96
    - waveshare_rp2040_plus
    - waveshare_rp2040_plus@16mb
    - waveshare_rp2040_geek
    - waveshare_rp2350_can/rp2350a/hazard3
    - waveshare_rp2350_can/rp2350a/m33
    # Build issue (undefined node label 'zephyr_udc0') [USB WIP]: - weact_bluepillplus_ch32v203c6
    # Build issue (undefined node label 'zephyr_udc0') [USB WIP]: - weact_bluepillplus_ch32v203c8
    - weact_bluepillplus_stm32f103cb
    - weact_bluepillplus_stm32f103c8
tests:
  #
  # Well known bords (Bridle) with snippet support.
  #
  snippets.usb-console:
    depends_on:
      - usb_device
      - usb_cdc
    filter: CONFIG_CDC_ACM_SERIAL_INITIALIZE_AT_BOOT and
            dt_nodelabel_enabled("snippet_cdc_acm_console_uart") and
            dt_chosen_enabled("zephyr,shell-uart") and
            dt_chosen_enabled("zephyr,console")
    required_snippets:
      - usb-console
    integration_platforms:
      - cytron_maker_nano_rp2040
      - cytron_maker_pi_rp2040
      - cytron_motion_2350_pro/rp2350a/hazard3
      - cytron_motion_2350_pro/rp2350a/m33
      - magpie_f777ni
      - seeeduino_cm0/samd21g18a
      - seeeduino_lotus/samd21g18a
      - vccgnd_bluepill_stm32f103cb
      - vccgnd_bluepill_stm32f103c8
      - vccgnd_bluepill_stm32f072cb
      - vccgnd_bluepill_stm32f072c8
      - waveshare_rp2040_one
      - waveshare_rp2040_zero
      - waveshare_rp2040_matrix
      - waveshare_rp2040_tiny
      - waveshare_rp2040_eth
      - waveshare_rp2040_lcd_0_96
      - waveshare_rp2040_plus
      - waveshare_rp2040_plus@16mb
      - waveshare_rp2040_geek
      - waveshare_rp2350_can/rp2350a/hazard3
      - waveshare_rp2350_can/rp2350a/m33
      # Build issue (undefined node label 'zephyr_udc0') [USB WIP]: - weact_bluepillplus_ch32v203c6
      # Build issue (undefined node label 'zephyr_udc0') [USB WIP]: - weact_bluepillplus_ch32v203c8
      - weact_bluepillplus_stm32f103cb
      - weact_bluepillplus_stm32f103c8
  #
  # Forein bords (Zephyr) with snippet support.
  #
  snippets.usb-console.forein:
    #
    # Twister issue (No hardware support for {'usb_device'}) on platforms:
    #
    # - mimxrt1060_evk@B/mimxrt1062/qspi
    # - mimxrt1060_evk@C/mimxrt1062/qspi
    # - rpi_pico/rp2040
    # - rpi_pico/rp2040/mcuboot
    # - rpi_pico/rp2040/w
    # - rpi_pico/rp2040/w/mcuboot
    # - rpi_pico2/rp2350a/hazard3
    # - rpi_pico2/rp2350a/m33
    # - rpi_pico2/rp2350a/m33/mcuboot
    # - rpi_pico2/rp2350a/m33/w
    # - rpi_pico2/rp2350a/m33/w/mcuboot
    # - xiao_rp2040
    # - xiao_rp2350/rp2350a/hazard3
    # - xiao_rp2350/rp2350a/m33
    #
    # That needs to resolve (why and vs. {'usbd'}) and thus it is not yet active.
    #
    # depends_on:
    #   - usb_device
    #
    filter: CONFIG_CDC_ACM_SERIAL_INITIALIZE_AT_BOOT and
            dt_nodelabel_enabled("snippet_cdc_acm_console_uart") and
            dt_chosen_enabled("zephyr,shell-uart") and
            dt_chosen_enabled("zephyr,console")
    required_snippets:
      - usb-console
    integration_platforms:
      - arduino_zero/samd21g18a
      - arduino_zero/samd21g18a/bbe
      - mimxrt1010_evk/mimxrt1011
      - mimxrt1010_evk/mimxrt1011/bbe
      - mimxrt1060_evk@A/mimxrt1062/qspi
      - mimxrt1060_evk@A/mimxrt1062/qspi/bbe
      - mimxrt1060_evk@B/mimxrt1062/qspi
      - mimxrt1060_evk@B/mimxrt1062/qspi/bbe
      - mimxrt1060_evk@C/mimxrt1062/qspi
      - mimxrt1060_evk@C/mimxrt1062/qspi/bbe
      - mimxrt1060_evk@C/mimxrt1062/hyperflash
      - mimxrt1060_evk@C/mimxrt1062/hyperflash/bbe
      - mimxrt1170_evk@A/mimxrt1176/cm7
      - mimxrt1170_evk@B/mimxrt1176/cm7
      - nucleo_f413zh/stm32f413xx
      - nucleo_f413zh/stm32f413xx/bbe
      - nucleo_f746zg/stm32f746xx
      - nucleo_f746zg/stm32f746xx/bbe
      - nucleo_f767zi/stm32f767xx
      - nucleo_f767zi/stm32f767xx/bbe
      - nucleo_l496zg/stm32l496xx
      - nucleo_l496zg/stm32l496xx/bbe
      - rpi_pico/rp2040
      - rpi_pico/rp2040/bbe
      - rpi_pico/rp2040/mcuboot
      - rpi_pico/rp2040/mcuboot/bbe
      - rpi_pico/rp2040/w
      - rpi_pico/rp2040/w/bbe
      - rpi_pico/rp2040/w/mcuboot
      - rpi_pico/rp2040/w/mcuboot/bbe
      - rpi_pico2/rp2350a/hazard3
      - rpi_pico2/rp2350a/hazard3/bbe
      - rpi_pico2/rp2350a/m33
      - rpi_pico2/rp2350a/m33/bbe
      - rpi_pico2/rp2350a/m33/mcuboot
      - rpi_pico2/rp2350a/m33/mcuboot/bbe
      - rpi_pico2/rp2350a/m33/w
      - rpi_pico2/rp2350a/m33/w/bbe
      - rpi_pico2/rp2350a/m33/w/mcuboot
      - rpi_pico2/rp2350a/m33/w/mcuboot/bbe
      - seeeduino_xiao/samd21g18a
      - seeeduino_xiao/samd21g18a/bbe
      - xiao_samd21/samd21g18a
      - xiao_rp2040
      - xiao_rp2350/rp2350a/hazard3
      - xiao_rp2350/rp2350a/m33
  #
  # Well known bords (Bridle) with self contained support.
  #
  boards.usb-console:
    depends_on:
      - usb_device
      - usb_cdc
    filter: CONFIG_CDC_ACM_SERIAL_INITIALIZE_AT_BOOT and
            dt_chosen_enabled("zephyr,shell-uart") and
            dt_chosen_enabled("zephyr,console")
    integration_platforms:
      - coffeecaller_nrf52
      - mini_usb_rp2040
      - mini_usb_rp2040@16mb
      - mini_usb_rp2040@chipled
      - mini_usb_rp2350/rp2350a/m33
      - mini_usb_rp2350@16mb/rp2350a/m33
      - picoboy/rp2040
      - picoboy_color/rp2040
      - picoboy_color_plus/rp2350a/m33
  #
  # Forein bords (Zephyr) without or unknown snippet support.
  #
  boards.usb-console.forein:
    depends_on:
      - usb_device
    filter: dt_nodelabel_enabled("snippet_cdc_acm_console_uart") and
            dt_chosen_enabled("zephyr,shell-uart") and
            dt_chosen_enabled("zephyr,console")
    required_snippets:
      - usb-console
    extra_args:
      - CONFIG_USBD_LOG_LEVEL_ERR=y
      - CONFIG_USBD_CDC_ACM_LOG_LEVEL_OFF=y
      - CONFIG_CDC_ACM_SERIAL_INITIALIZE_AT_BOOT=y
    integration_platforms:
      - native_sim
      - native_sim/native/64
```
