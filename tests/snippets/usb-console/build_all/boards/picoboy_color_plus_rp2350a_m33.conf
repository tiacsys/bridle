## west.yml
```yaml
# The west manifest file for Bridle for embedded systems based on Zephyr.
#
# Copyright (c) 2021-2023 TiaC Systems
# Copyright (c) 2019-2021 Li-Pro.Net
#
# SPDX-License-Identifier: Apache-2.0
#
# The per-installation west configuration file, .west/config, sets the
# path to the project containing this file in the [manifest] section's
# "path" variable.
#
# You are free to create your own manifest files and put them in any
# repository you want, to create your own custom Zephyr installations.
# For example, you could create a manifest file in your own out of
# tree application directory, which would pull this Zephyr repository
# in as an ordinary project.
#
# You can pass your manifest repositories to west init when creating a
# new Zephyr installation. See the west documentation for more
# information.

manifest:
  version: "0.13"

  # If not otherwise specified, the projects below should be obtained
  # from the tiacsys remote.
  defaults:
    remote: tiacsys

  # "remotes" is a list of locations where git repositories are cloned
  # and fetched from.
  remotes:
    - name: tiacsys
      url-base: https://github.com/tiacsys

  # West-related configuration for the Bridle repository.
  self:
    # This repository should be cloned to workspace/bridle.
    path: bridle
    # This line configures west extensions which are currently
    # only for internal use by TIAC maintainers; import build
    # commands from Zephyr repo.
    west-commands: scripts/west-commands.yml
    # Import additional Zephyr submodules from separate files.
    import: submanifests
```

## zephyr/alt-config/drivers/can/timing/testcase.yaml
```yaml
tests:
  drivers.can.timing:
    tags:
      - drivers
      - can
    depends_on: can
    filter: dt_chosen_enabled("zephyr,canbus")
    # required_snippets:
    #   - can-timing-adj
    # required_snippets can not yet be used, because of open issues, see:
    #   - https://github.com/zephyrproject-rtos/zephyr/issues/63011
    #   - https://github.com/zephyrproject-rtos/zephyr/pull/63232
    platform_exclude:
      - tiac_magpie
  drivers.can.timing.tiac_magpie:
    tags:
      - drivers
      - can
    depends_on: can
    filter: dt_chosen_enabled("zephyr,canbus")
    extra_args:
      - DTC_OVERLAY_FILE=${ZEPHYR_BRIDLE_MODULE_DIR}/snippets/can-timing-adj/boards/tiac_magpie.overlay
    platform_allow:
      - tiac_magpie
```

## zephyr/alt-config/drivers/display/sample.yaml
```yaml
sample:
  name: Display Bit Order and Orientation
common:
  tags:
    - zephyr
    - shield
    - drivers
    - display
  depends_on: spi
  harness: display
  build_only: true
tests:
  #
  # shield: Waveshare Pico LCD 1.14
  #
  sample.drivers.display.waveshare_pico_lcd_1_14:
    extra_args:
      SHIELD=waveshare_pico_lcd_1_14
    integration_platforms:
      - rpi_pico
      - rpi_pico/rp2040/w
      - waveshare_rp2040_plus
      - waveshare_rp2040_plus@16mb
  #
  # shield: Waveshare Pico LCD 2
  #
  sample.drivers.display.waveshare_pico_lcd_2:
    extra_args:
      SHIELD=waveshare_pico_lcd_2
    integration_platforms:
      - rpi_pico
      - rpi_pico/rp2040/w
      - waveshare_rp2040_plus
      - waveshare_rp2040_plus@16mb
  #
  # shield: Waveshare Pico ResTouch LCD 3.5
  #
  sample.drivers.display.waveshare_pico_restouch_lcd_3_5:
    extra_args:
      SHIELD=waveshare_pico_restouch_lcd_3_5
    integration_platforms:
      - rpi_pico
      - rpi_pico/rp2040/w
      - waveshare_rp2040_plus
      - waveshare_rp2040_plus@16mb
  #
  # shield: Waveshare 2.4 LCD
  #
  sample.drivers.display.waveshare_2_4_lcd:
    extra_args:
      SHIELD=waveshare_2_4_lcd
    integration_platforms:
      - cytron_maker_nano_rp2040
      - cytron_maker_pi_rp2040
```

## zephyr/alt-config/drivers/led_strip/sample.yaml
```yaml
sample:
  description: Demonstration of the LED strip driver.
  name: led_strip_sample
common:
  tags:
    - zephyr
    - shield
    - drivers
    - led
  filter: dt_alias_exists("led-strip")
  harness: led_strip
  build_only: true
tests:
  #
  # boards with LED strip
  #
  sample.drivers.led_strip:
    integration_platforms:
      - cytron_maker_nano_rp2040
      - cytron_maker_pi_rp2040
      - waveshare_rp2040_eth
      - waveshare_rp2040_matrix
      - waveshare_rp2040_one
      - waveshare_rp2040_tiny
      - waveshare_rp2040_zero
  #
  # shield: Waveshare Pico RGB LED
  #
  sample.drivers.led_strip.waveshare_pico_rgb_led:
    extra_args:
      SHIELD=waveshare_pico_rgb_led
    integration_platforms:
      - rpi_pico
      - rpi_pico/rp2040/w
      - waveshare_rp2040_lcd_0_96
      - waveshare_rp2040_plus
      - waveshare_rp2040_plus@16mb
```

## zephyr/alt-config/samples/basic/rgb_led/sample.yaml
```yaml
sample:
  description: Drive an RGB LED using the PWM API.
  name: RGB LED
common:
  tags:
    - zephyr
    - shield
    - drivers
    - pwm
  depends_on: pwm
  harness: console
  harness_config:
    fixture: fixture_led
tests:
  sample.basic.rgb_led:
    filter: dt_alias_exists("red-pwm-led") and
            dt_alias_exists("green-pwm-led") and
            dt_alias_exists("blue-pwm-led")
    integration_platforms:
      - nrf52840_mdk
  #
  # shield: PiMoroni Pico LCD 1.14
  #
  sample.basic.rgb_led.pimoroni_pico_lcd_1_44:
    extra_args:
      SHIELD=pimoroni_pico_lcd_1_44
    integration_platforms:
      - rpi_pico
      - rpi_pico/rp2040/w
      - waveshare_rp2040_plus
      - waveshare_rp2040_plus@16mb
  #
  # shield: PiMoroni Pico LCD 2
  #
  sample.basic.rgb_led.pimoroni_pico_lcd_2:
    extra_args:
      SHIELD=pimoroni_pico_lcd_2
    integration_platforms:
      - rpi_pico
      - rpi_pico/rp2040/w
      - waveshare_rp2040_plus
      - waveshare_rp2040_plus@16mb
```

## zephyr/alt-config/samples/drivers/display/sample.yaml
```yaml
sample:
  description: Display Bit Order and Orientation.
  name: Display sample
common:
  tags:
    # TODO/FIXME: disable for the time being (fix SPI_RPI_PICO_PIO_DMA) - zephyr
    - shield
    - drivers
    - display
  depends_on: spi
  harness: console
  harness_config:
    fixture: fixture_display
    type: one_line
    regex:
      - "Display sample for (.*)"
tests:
  #
  # shield: GeeekPi Pico Breadboard Kit (EP-0164)
  #
  sample.drivers.display.geeekpi_pico_bb:
    extra_args:
      SHIELD=geeekpi_pico_bb
    integration_platforms:
      - rpi_pico
      - rpi_pico/rp2040/w
      - waveshare_rp2040_plus
      - waveshare_rp2040_plus@16mb
  #
  # shield: GeeekPi Pico Breadboard Kit Plus (EP-0172)
  #
  sample.drivers.display.geeekpi_pico_bb_plus:
    extra_args:
      SHIELD=geeekpi_pico_bb_plus
    integration_platforms:
      - rpi_pico
      - rpi_pico/rp2040/w
      - waveshare_rp2040_plus
      - waveshare_rp2040_plus@16mb
  #
  # shield: PiMoroni Pico LCD 1.14
  #
  sample.drivers.display.pimoroni_pico_lcd_1_44:
    extra_args:
      SHIELD=pimoroni_pico_lcd_1_44
    integration_platforms:
      - rpi_pico
      - rpi_pico/rp2040/w
      - waveshare_rp2040_plus
      - waveshare_rp2040_plus@16mb
  #
  # shield: PiMoroni Pico LCD 2
  #
  sample.drivers.display.pimoroni_pico_lcd_2:
    extra_args:
      SHIELD=pimoroni_pico_lcd_2
    integration_platforms:
      - rpi_pico
      - rpi_pico/rp2040/w
      - waveshare_rp2040_plus
      - waveshare_rp2040_plus@16mb
  #
  # shield: Spotpear Pico LCD 1.54
  #
  sample.drivers.display.spotpear_pico_lcd_1_54:
    extra_args:
      SHIELD=spotpear_pico_lcd_1_54
    integration_platforms:
      - rpi_pico
      - rpi_pico/rp2040/w
      - waveshare_rp2040_plus
      - waveshare_rp2040_plus@16mb
  #
  # shield: Waveshare Pico LCD 0.96
  #
  sample.drivers.display.waveshare_pico_lcd_0_96:
    extra_args:
      SHIELD=waveshare_pico_lcd_0_96
    integration_platforms:
      - rpi_pico
      - rpi_pico/rp2040/w
      - waveshare_rp2040_plus
      - waveshare_rp2040_plus@16mb
  #
  # shield: Waveshare Pico LCD 1.14
  #
  sample.drivers.display.waveshare_pico_lcd_1_14:
    extra_args:
      SHIELD=waveshare_pico_lcd_1_14
    integration_platforms:
      - rpi_pico
      - rpi_pico/rp2040/w
      - waveshare_rp2040_plus
      - waveshare_rp2040_plus@16mb
  #
  # shield: Waveshare Pico LCD 1.3
  #
  sample.drivers.display.waveshare_pico_lcd_1_3:
    extra_args:
      SHIELD=waveshare_pico_lcd_1_3
    integration_platforms:
      - rpi_pico
      - rpi_pico/rp2040/w
      - waveshare_rp2040_plus
      - waveshare_rp2040_plus@16mb
  #
  # shield: Waveshare Pico LCD 1.44
  #
  sample.drivers.display.waveshare_pico_lcd_1_44:
    extra_args:
      SHIELD=waveshare_pico_lcd_1_44
    integration_platforms:
      - rpi_pico
      - rpi_pico/rp2040/w
      - waveshare_rp2040_plus
      - waveshare_rp2040_plus@16mb
  #
  # shield: Waveshare Pico LCD 1.8
  #
  sample.drivers.display.waveshare_pico_lcd_1_8:
    extra_args:
      SHIELD=waveshare_pico_lcd_1_8
    integration_platforms:
      - rpi_pico
      - rpi_pico/rp2040/w
      - waveshare_rp2040_plus
      - waveshare_rp2040_plus@16mb
  #
  # shield: Waveshare Pico LCD 2
  #
  sample.drivers.display.waveshare_pico_lcd_2:
    extra_args:
      SHIELD=waveshare_pico_lcd_2
    integration_platforms:
      - rpi_pico
      - rpi_pico/rp2040/w
      - waveshare_rp2040_plus
      - waveshare_rp2040_plus@16mb
  #
  # shield: Waveshare Pico ResTouch LCD 2.8
  #
  sample.drivers.display.waveshare_pico_restouch_lcd_2_8:
    extra_args:
      SHIELD=waveshare_pico_restouch_lcd_2_8
    integration_platforms:
      - rpi_pico
      - rpi_pico/rp2040/w
      - waveshare_rp2040_plus
      - waveshare_rp2040_plus@16mb
  #
  # shield: Waveshare Pico ResTouch LCD 3.5
  #
  sample.drivers.display.waveshare_pico_restouch_lcd_3_5:
    extra_args:
      SHIELD=waveshare_pico_restouch_lcd_3_5
    integration_platforms:
      - rpi_pico
      - rpi_pico/rp2040/w
      - waveshare_rp2040_plus
      - waveshare_rp2040_plus@16mb
  #
  # shield: Waveshare 2.4 LCD
  #
  sample.drivers.display.waveshare_2_4_lcd:
    extra_args:
      SHIELD=waveshare_2_4_lcd
    integration_platforms:
      - cytron_maker_nano_rp2040
      - cytron_maker_pi_rp2040
```

## zephyr/alt-config/samples/drivers/led/led_strip/sample.yaml
```yaml
sample:
  description: Demonstration of the LED strip driver.
  name: LED strip sample
common:
  tags:
    - zephyr
    - shield
    - drivers
    - led
  filter: dt_alias_exists("led-strip")
  harness: console
  harness_config:
    fixture: fixture_led_strip
tests:
  #
  # boards with LED strip
  #
  sample.drivers.led_strip:
    integration_platforms:
      - cytron_maker_nano_rp2040
      - cytron_maker_pi_rp2040
      - picoboy_color_plus/rp2350a/m33
      - waveshare_rp2040_eth
      - waveshare_rp2040_matrix
      - waveshare_rp2040_one
      - waveshare_rp2040_tiny
      - waveshare_rp2040_zero
  #
  # shield: GeeekPi Pico Breadboard Kit Plus (EP-0172)
  #
  sample.drivers.led_strip.geeekpi_pico_bb_plus:
    extra_args:
      SHIELD=geeekpi_pico_bb_plus
    integration_platforms:
      - rpi_pico
      - rpi_pico/rp2040/w
      - rpi_pico2/rp2350a/hazard3
      - rpi_pico2/rp2350a/m33
      - rpi_pico2/rp2350a/m33/w
      - waveshare_rp2040_plus
      - waveshare_rp2040_plus@16mb
  #
  # shield: Waveshare Pico RGB LED
  #
  sample.drivers.led_strip.waveshare_pico_rgb_led:
    extra_args:
      SHIELD=waveshare_pico_rgb_led
    integration_platforms:
      - rpi_pico
      - rpi_pico/rp2040/w
      - rpi_pico2/rp2350a/hazard3
      - rpi_pico2/rp2350a/m33
      - rpi_pico2/rp2350a/m33/w
      - waveshare_rp2040_lcd_0_96
      - waveshare_rp2040_plus
      - waveshare_rp2040_plus@16mb
      - waveshare_rp2350_can/rp2350a/hazard3
      - waveshare_rp2350_can/rp2350a/m33
```

## zephyr/alt-config/samples/subsys/input/input_dump/sample.yaml
```yaml
sample:
  description: Print all input events.
  name: input_dump_sample
common:
  tags:
    - zephyr
    - shield
    - input
  depends_on: pico_gpio
  harness: console
  harness_config:
    fixture: fixture_input
tests:
  #
  # shield: GeeekPi Pico Breadboard Kit (EP-0164)
  #
  sample.input.input_dump.geeekpi_pico_bb:
    extra_args:
      SHIELD=geeekpi_pico_bb
    integration_platforms:
      - rpi_pico
      - rpi_pico/rp2040/w
      - waveshare_rp2040_plus
      - waveshare_rp2040_plus@16mb
  #
  # shield: GeeekPi Pico Breadboard Kit Plus (EP-0172)
  #
  sample.input.input_dump.geeekpi_pico_bb_plus:
    extra_args:
      SHIELD=geeekpi_pico_bb_plus
    integration_platforms:
      - rpi_pico
      - rpi_pico/rp2040/w
      - waveshare_rp2040_plus
      - waveshare_rp2040_plus@16mb
  #
  # shield: PiMoroni Pico LCD 1.14
  #
  sample.input.input_dump.pimoroni_pico_lcd_1_44:
    extra_args:
      SHIELD=pimoroni_pico_lcd_1_44
    integration_platforms:
      - rpi_pico
      - rpi_pico/rp2040/w
      - waveshare_rp2040_plus
      - waveshare_rp2040_plus@16mb
  #
  # shield: PiMoroni Pico LCD 2
  #
  sample.input.input_dump.pimoroni_pico_lcd_2:
    extra_args:
      SHIELD=pimoroni_pico_lcd_2
    integration_platforms:
      - rpi_pico
      - rpi_pico/rp2040/w
      - waveshare_rp2040_plus
      - waveshare_rp2040_plus@16mb
  #
  # shield: Spotpear Pico LCD 1.54
  #
  sample.input.input_dump.spotpear_pico_lcd_1_54:
    extra_args:
      SHIELD=spotpear_pico_lcd_1_54
    integration_platforms:
      - rpi_pico
      - rpi_pico/rp2040/w
      - waveshare_rp2040_plus
      - waveshare_rp2040_plus@16mb
  #
  # shield: Waveshare Pico LCD 0.96
  #
  sample.input.input_dump.waveshare_pico_lcd_0_96:
    extra_args:
      SHIELD=waveshare_pico_lcd_0_96
    integration_platforms:
      - rpi_pico
      - rpi_pico/rp2040/w
      - waveshare_rp2040_plus
      - waveshare_rp2040_plus@16mb
  #
  # shield: Waveshare Pico LCD 1.14
  #
  sample.input.input_dump.waveshare_pico_lcd_1_14:
    extra_args:
      SHIELD=waveshare_pico_lcd_1_14
    integration_platforms:
      - rpi_pico
      - rpi_pico/rp2040/w
      - waveshare_rp2040_plus
      - waveshare_rp2040_plus@16mb
  #
  # shield: Waveshare Pico LCD 1.3
  #
  sample.input.input_dump.waveshare_pico_lcd_1_3:
    extra_args:
      SHIELD=waveshare_pico_lcd_1_3
    integration_platforms:
      - rpi_pico
      - rpi_pico/rp2040/w
      - waveshare_rp2040_plus
      - waveshare_rp2040_plus@16mb
  #
  # shield: Waveshare Pico LCD 1.44
  #
  sample.input.input_dump.waveshare_pico_lcd_1_44:
    extra_args:
      SHIELD=waveshare_pico_lcd_1_44
    integration_platforms:
      - rpi_pico
      - rpi_pico/rp2040/w
      - waveshare_rp2040_plus
      - waveshare_rp2040_plus@16mb
  #
  # shield: Waveshare Pico LCD 2
  #
  sample.input.input_dump.waveshare_pico_lcd_2:
    extra_args:
      SHIELD=waveshare_pico_lcd_2
    integration_platforms:
      - rpi_pico
      - rpi_pico/rp2040/w
      - waveshare_rp2040_plus
      - waveshare_rp2040_plus@16mb
```

## zephyr/alt-config/subsys/input/input_dump/sample.yaml
```yaml
sample:
  name: Input Dump
common:
  tags:
    - zephyr
    - shield
    - input
  build_only: true
  depends_on: pico_gpio
  harness: input
tests:
  #
  # shield: Waveshare Pico LCD 1.14
  #
  sample.input.input_dump.waveshare_pico_lcd_1_14:
    extra_args:
      SHIELD=waveshare_pico_lcd_1_14
    integration_platforms:
      - rpi_pico
      - rpi_pico/rp2040/w
      - waveshare_rp2040_plus
      - waveshare_rp2040_plus@16mb
  #
  # shield: Waveshare Pico LCD 2
  #
  sample.input.input_dump.waveshare_pico_lcd_2:
    extra_args:
      SHIELD=waveshare_pico_lcd_2
    integration_platforms:
      - rpi_pico
      - rpi_pico/rp2040/w
      - waveshare_rp2040_plus
      - waveshare_rp2040_plus@16mb
```

## zephyr/alt-config/tests/drivers/build_all/display/testcase.yaml
```yaml
common:
  build_only: true
  tags:
    - zephyr
    - drivers
    - display
  integration_platforms:
    - native_sim
    - native_sim/native/64
  platform_allow:
    - native_sim
    - native_sim/native/64
tests:
  drivers.display.build:
    required_snippets:
      - tstdrv-bldall-display-adj
```
