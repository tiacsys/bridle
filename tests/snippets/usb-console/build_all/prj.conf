## CMakeLists.txt
```
# SPDX-FileCopyrightText: 2025-2026 TiaC Systems
# SPDX-License-Identifier: Apache-2.0

cmake_minimum_required(VERSION 3.28.0)

find_package(Bridle REQUIRED HINTS $ENV{BRIDLE_BASE})
project(grove_shields)

target_sources(app PRIVATE src/main.c)

function(test_if_exact if_value test_prompt)
  cmake_parse_arguments(TEST_PROMPT_CONV "bMaxPower" "" "" ${ARGN})
  set(PSX "                                                  ")
  string(LENGTH "${PSX}" PSL)
  string(PREPEND PSX "${test_prompt}")
  string(SUBSTRING "${PSX}" 0 ${PSL} PSX)
  if(DEFINED CONFIG_${if_value} AND
    CONFIG_${if_value} STREQUAL CONFIG_TEST_EXPECTED_${if_value})
    if(${TEST_PROMPT_CONV_bMaxPower})
      math(EXPR bMaxPower "2 * ${CONFIG_TEST_EXPECTED_${if_value}}"
           OUTPUT_FORMAT DECIMAL)
      message(STATUS "[✓] ${PSX}: ${bMaxPower} mA")
    elseif("y" STREQUAL CONFIG_TEST_EXPECTED_${if_value})
      message(STATUS "[✓] ${PSX}: yes")
    else()
      message(STATUS "[✓] ${PSX}: ${CONFIG_TEST_EXPECTED_${if_value}}")
    endif()
  elseif(NOT DEFINED CONFIG_${if_value} AND
    NOT DEFINED CONFIG_TEST_EXPECTED_${if_value})
      message(STATUS "[✓] ${PSX}: no")
  else()
    message(FATAL_ERROR "${test_prompt}: Test failed, "
      "actual \"CONFIG_${if_value}\" has the value "
      "\"${CONFIG_${if_value}}\", expected "
      "\"${CONFIG_TEST_EXPECTED_${if_value}}\"."
    )
  endif()
  unset(PSX)
endfunction()

function(test_if_chosen_comp if_chosen if_comp test_prompt)
  set(PSX "                                                  ")
  string(LENGTH "${PSX}" PSL)
  string(PREPEND PSX "${test_prompt} (${if_chosen})")
  string(SUBSTRING "${PSX}" 0 ${PSL} PSX)
  dt_has_chosen(has_if_chosen PROPERTY "${if_chosen}")
  if(NOT has_if_chosen)
    message(FATAL_ERROR "Expect to use a ${test_prompt}. "
      "Add `${if_chosen}` to the device tree.")
  else()
    dt_chosen(if_chosen_path PROPERTY "${if_chosen}")
    dt_node_exists(if_chosen_node_exists PATH "${if_chosen_path}")
    dt_prop(if_chosen_node_comp PATH "${if_chosen_path}" PROPERTY "compatible")
    foreach(if_chosen_comp IN LISTS if_chosen_node_comp)
      if(DEFINED if_chosen_node_comp AND if_chosen_comp STREQUAL if_comp)
        message(STATUS "[✓] ${PSX}: compatible = \"${if_comp}\"")
        break()
      else()
        message(FATAL_ERROR "Test failed, "
          "actual either "
          "the node path \"${if_chosen_path}\" is missing or "
          "the node path is not compatible to ${test_prompt} @ USB, "
          "expected node compatible to \"${if_comp}\" "
          "but got \"${if_chosen_comp}\"."
        )
      endif()
    endforeach()
  endif()
  unset(PSX)
endfunction()

function(test_if_chosen_comp_ifdef if_feature_toggle)
  if(${${if_feature_toggle}})
    test_if_chosen_comp(${ARGN})
  endif()
endfunction()

# Save default values for later restore.
set(CMAKE_CURRENT_MESSAGE_INDENT ${CMAKE_MESSAGE_INDENT})
list(APPEND CMAKE_MESSAGE_INDENT " [TEST] ")

message(STATUS "")
message(STATUS "${CONFIG_TEST_NAME}")

message(STATUS "")
message(STATUS "*** USB Device Driver")
test_if_exact("UDC_DRIVER" "USB Device Driver Support")
test_if_exact("UDC_DRIVER_LOG_LEVEL_OFF"
  "    Log Level for USB Device Driver is OFF")
test_if_exact("UDC_DRIVER_LOG_LEVEL_ERR"
  "    Log Level for USB Device Driver is ERROR")
test_if_exact("UDC_DRIVER_LOG_LEVEL_WRN"
  "    Log Level for USB Device Driver is WARNING")
test_if_exact("UDC_DRIVER_LOG_LEVEL_INF"
  "    Log Level for USB Device Driver is INFO")
test_if_exact("UDC_DRIVER_LOG_LEVEL_DBG"
  "    Log Level for USB Device Driver is DEBUG")
test_if_exact("UDC_DRIVER_LOG_LEVEL_DEFAULT"
  "    Log Level for USB Device Driver is DEFAULT")

message(STATUS "")
message(STATUS "*** USB Device Stack")
test_if_exact("USB_DEVICE_STACK_NEXT" "USB Device Stack Support")
test_if_exact("USBD_LOG_LEVEL_OFF"
  "    Log Level for USB Device Stack is OFF")
test_if_exact("USBD_LOG_LEVEL_ERR"
  "    Log Level for USB Device Stack is ERROR")
test_if_exact("USBD_LOG_LEVEL_WRN"
  "    Log Level for USB Device Stack is WARNING")
test_if_exact("USBD_LOG_LEVEL_INF"
  "    Log Level for USB Device Stack is INFO")
test_if_exact("USBD_LOG_LEVEL_DBG"
  "    Log Level for USB Device Stack is DEBUG")
test_if_exact("USBD_LOG_LEVEL_DEFAULT"
  "    Log Level for USB Device Stack is DEFAULT")

message(STATUS "")
message(STATUS "*** USB CDC ACM Class")
test_if_exact("USBD_CDC_ACM_CLASS" "USB CDC ACM Class Support")
test_if_exact("USBD_CDC_ACM_LOG_LEVEL_OFF"
  "    Log Level for USB CDC ACM Class is OFF")
test_if_exact("USBD_CDC_ACM_LOG_LEVEL_ERROR"
  "    Log Level for USB CDC ACM Class is ERROR")
test_if_exact("USBD_CDC_ACM_LOG_LEVEL_WRN"
  "    Log Level for USB CDC ACM Class is WARNING")
test_if_exact("USBD_CDC_ACM_LOG_LEVEL_INF"
  "    Log Level for USB CDC ACM Class is INFO")
test_if_exact("USBD_CDC_ACM_LOG_LEVEL_DBG"
  "    Log Level for USB CDC ACM Class is DEBUG")
test_if_exact("USBD_CDC_ACM_LOG_LEVEL_DEFAULT"
  "    Log Level for USB CDC ACM Class is DEFAULT")
test_if_exact("CDC_ACM_SERIAL_INITIALIZE_AT_BOOT"
  "    Initialize USB Device Support at boot")
test_if_exact("CDC_ACM_SERIAL_VID"
  "        Vendor ID")
test_if_exact("CDC_ACM_SERIAL_PID"
  "        Product ID")
test_if_exact("CDC_ACM_SERIAL_MANUFACTURER_STRING"
  "        Manufacturer Name")
test_if_exact("CDC_ACM_SERIAL_PRODUCT_STRING"
  "        Product Name")
test_if_exact("CDC_ACM_SERIAL_SELF_POWERED"
  "        Device Self-Powered")
test_if_exact("CDC_ACM_SERIAL_MAX_POWER"
  "        Device Current Consuption (max)" "bMaxPower")

message(STATUS "")
message(STATUS "*** DTS chosen properties")
test_if_chosen_comp_ifdef(CONFIG_TEST_EXPECTED_USBD_CDC_ACM_CLASS
  "zephyr,console" "zephyr,cdc-acm-uart" "Zephyr Console")
test_if_chosen_comp_ifdef(CONFIG_TEST_CHOSEN_ZEPHYR_SHELL_UART
  "zephyr,shell-uart" "zephyr,cdc-acm-uart" "Zephyr Shell UART")
test_if_chosen_comp_ifdef(CONFIG_TEST_CHOSEN_ZEPHYR_UART_MCUMGR
  "zephyr,uart-mcumgr" "zephyr,cdc-acm-uart" "Zephyr UART Device Manager")
test_if_chosen_comp_ifdef(CONFIG_TEST_CHOSEN_ZEPHYR_BT_MON_UART
  "zephyr,bt-mon-uart" "zephyr,cdc-acm-uart" "Zephyr BT Monitor UART")
test_if_chosen_comp_ifdef(CONFIG_TEST_CHOSEN_ZEPHYR_BT_C2H_UART
  "zephyr,bt-c2h-uart" "zephyr,cdc-acm-uart" "Zephyr BT HCI UART")

message(STATUS "")

# Clean up temp variables
set(CMAKE_MESSAGE_INDENT ${CMAKE_CURRENT_MESSAGE_INDENT})
```

## Kconfig
```
# SPDX-FileCopyrightText: 2025-2026 TiaC Systems
# SPDX-License-Identifier: Apache-2.0

mainmenu "Buildability over all Bridle USB Console Boards and Snippets (usb-console)"

comment "Test configuration:"
config TEST_NAME
	string "Test Name"
	default "Verify USB device descriptor data for USB console (CDC ACM)"

config TEST_CHOSEN_ZEPHYR_SHELL_UART
	bool "Test `/chosen` property `zephyr,shell-uart`"
	default n

config TEST_CHOSEN_ZEPHYR_UART_MCUMGR
	bool "Test `/chosen` property `zephyr,uart-mcumgr`"
	default n

config TEST_CHOSEN_ZEPHYR_BT_MON_UART
	bool "Test `/chosen` property `zephyr,bt-mon-uart`"
	default n

config TEST_CHOSEN_ZEPHYR_BT_C2H_UART
	bool "Test `/chosen` property `zephyr,bt-c2h-uart`"
	default n

menuconfig TEST_EXPECTED_UDC_DRIVER
	bool "Expected USB Device Driver Support"
	default n
	help
	  Expect, USB device driver is enabled.

if TEST_EXPECTED_UDC_DRIVER

module = TEST_EXPECTED_UDC_DRIVER
module-str = expected udc driver
source "subsys/logging/Kconfig.template.log_config"

menuconfig TEST_EXPECTED_USB_DEVICE_STACK_NEXT
	bool "Expected USB Device Support"
	default n
	help
	  Expect, USB device stack is enabled.

if TEST_EXPECTED_USB_DEVICE_STACK_NEXT

module = TEST_EXPECTED_USBD
module-str = expected usbd
source "subsys/logging/Kconfig.template.log_config"

menuconfig TEST_EXPECTED_USBD_CDC_ACM_CLASS
	bool "Expected USB CDC ACM Class Support"
	default n
	help
	  Expected USB CDC ACM class support.

if TEST_EXPECTED_USBD_CDC_ACM_CLASS

module = TEST_EXPECTED_USBD_CDC_ACM
module-str = expected usbd cdc acm
source "subsys/logging/Kconfig.template.log_config"

menuconfig TEST_EXPECTED_CDC_ACM_SERIAL_INITIALIZE_AT_BOOT
	bool "Expect initialize USB Device Support at boot"
	default n
	help
	  Expect use CDC ACM UART as backend for console, shell, or logging.

if TEST_EXPECTED_CDC_ACM_SERIAL_INITIALIZE_AT_BOOT

config TEST_EXPECTED_CDC_ACM_SERIAL_VID
	hex "Expected USB CDC ACM Vendor ID"
	default 0x2FE3
	help
	  Expected USB CDC ACM device vendor ID.
	  MUST be configured by vendor.

config TEST_EXPECTED_CDC_ACM_SERIAL_PID
	hex "Expected USB CDC ACM Product ID"
	default 0x0100
	help
	  Expected USB CDC ACM device product ID.
	  MUST be configured by vendor.

config TEST_EXPECTED_CDC_ACM_SERIAL_MANUFACTURER_STRING
	string "Expected USB CDC ACM Manufacturer Name"
	default "ZEPHYR"
	help
	  Expected USB CDC ACM device manufacturer string.
	  MUST be configured by vendor.

config TEST_EXPECTED_CDC_ACM_SERIAL_PRODUCT_STRING
	string "Expected USB CDC ACM Product Name"
	default "USB-DEV"
	help
	  Expected USB CDC ACM device product string.
	  MUST be configured by vendor.

config TEST_EXPECTED_CDC_ACM_SERIAL_SELF_POWERED
	bool "Expected USB CDC ACM Device Self-Powered"
	default y
	help
	  Expected self-powered attribute in the configuration.

config TEST_EXPECTED_CDC_ACM_SERIAL_MAX_POWER
	int "Expected USB CDC ACM Device bMaxPower Value"
	default 125
	range 0 250
	help
	  Expected bMaxPower value in the configuration in 2 mA units.

endif # TEST_EXPECTED_CDC_ACM_SERIAL_INITIALIZE_AT_BOOT

endif # TEST_EXPECTED_USBD_CDC_ACM_CLASS

endif # TEST_EXPECTED_USB_DEVICE_STACK_NEXT

endif # TEST_EXPECTED_UDC_DRIVER

# Sources Kconfig.zephyr in the Zephyr root directory.
comment "Zephyr configuration:"
menu "Zephyr Kernel"
source "Kconfig.zephyr"
endmenu
```

## prj.conf
```kconfig
# SPDX-FileCopyrightText: 2025-2026 TiaC Systems
# SPDX-License-Identifier: Apache-2.0

CONFIG_TEST=y
CONFIG_CONSOLE=y

# Zephyr chosen properties
CONFIG_TEST_CHOSEN_ZEPHYR_SHELL_UART=y
CONFIG_TEST_CHOSEN_ZEPHYR_UART_MCUMGR=y
CONFIG_TEST_CHOSEN_ZEPHYR_BT_MON_UART=y
CONFIG_TEST_CHOSEN_ZEPHYR_BT_C2H_UART=y

# USB Device Driver
CONFIG_TEST_EXPECTED_UDC_DRIVER=y
CONFIG_TEST_EXPECTED_UDC_DRIVER_LOG_LEVEL_ERR=y

# USB Device Stack
CONFIG_TEST_EXPECTED_USB_DEVICE_STACK_NEXT=y
CONFIG_TEST_EXPECTED_USBD_LOG_LEVEL_ERR=y

# USB CDC ACM Class
CONFIG_TEST_EXPECTED_USBD_CDC_ACM_CLASS=y
CONFIG_TEST_EXPECTED_USBD_CDC_ACM_LOG_LEVEL_OFF=y
CONFIG_TEST_EXPECTED_CDC_ACM_SERIAL_SELF_POWERED=n
CONFIG_TEST_EXPECTED_CDC_ACM_SERIAL_MAX_POWER=125

# Zephyr Project @ USB console sample
CONFIG_TEST_EXPECTED_CDC_ACM_SERIAL_VID=0x2FE3
CONFIG_TEST_EXPECTED_CDC_ACM_SERIAL_PID=0x0004
CONFIG_TEST_EXPECTED_CDC_ACM_SERIAL_MANUFACTURER_STRING="Zephyr Project"
CONFIG_TEST_EXPECTED_CDC_ACM_SERIAL_PRODUCT_STRING="Console over USB CDC ACM"
CONFIG_TEST_EXPECTED_CDC_ACM_SERIAL_INITIALIZE_AT_BOOT=y
```

## boards/arduino_zero.conf
```kconfig
# SPDX-FileCopyrightText: 2025-2026 TiaC Systems
# SPDX-License-Identifier: Apache-2.0

# Atmel Corp. SAMD21 @ Arduino Zero
CONFIG_TEST_EXPECTED_CDC_ACM_SERIAL_VID=0x2341
CONFIG_TEST_EXPECTED_CDC_ACM_SERIAL_PID=0x804d
CONFIG_TEST_EXPECTED_CDC_ACM_SERIAL_MANUFACTURER_STRING="Arduino LLC"
CONFIG_TEST_EXPECTED_CDC_ACM_SERIAL_PRODUCT_STRING="Arduino Zero (CDC ACM)"
CONFIG_TEST_EXPECTED_CDC_ACM_SERIAL_SELF_POWERED=n
CONFIG_TEST_EXPECTED_CDC_ACM_SERIAL_MAX_POWER=250
```

## boards/arduino_zero_bbe.conf
```kconfig
# Copyright (c) 2025 TiaC Systems
# SPDX-License-Identifier: Apache-2.0

CONFIG_TEST_CHOSEN_ZEPHYR_SHELL_UART=y

# Atmel Corp. SAMD21 @ Arduino Zero
CONFIG_TEST_EXPECTED_CDC_ACM_SERIAL_VID=0x2341
CONFIG_TEST_EXPECTED_CDC_ACM_SERIAL_PID=0x804d
CONFIG_TEST_EXPECTED_CDC_ACM_SERIAL_MANUFACTURER_STRING="Arduino LLC"
CONFIG_TEST_EXPECTED_CDC_ACM_SERIAL_PRODUCT_STRING="Arduino Zero (CDC ACM)"
CONFIG_TEST_EXPECTED_CDC_ACM_SERIAL_SELF_POWERED=n
CONFIG_TEST_EXPECTED_CDC_ACM_SERIAL_MAX_POWER=250
```

## boards/coffeecaller_nrf52.conf
```kconfig
# SPDX-FileCopyrightText: 2025-2026 TiaC Systems
# SPDX-License-Identifier: Apache-2.0

# TiaC @ CoffeeCaller nRF52
CONFIG_TEST_EXPECTED_CDC_ACM_SERIAL_VID=0x1915
CONFIG_TEST_EXPECTED_CDC_ACM_SERIAL_PID=0xC0CA
CONFIG_TEST_EXPECTED_CDC_ACM_SERIAL_MANUFACTURER_STRING="TiaC (Nordic Semiconductor ASA)"
CONFIG_TEST_EXPECTED_CDC_ACM_SERIAL_PRODUCT_STRING="CoffeeCaller nRF52 (CDC ACM)"
CONFIG_TEST_EXPECTED_CDC_ACM_SERIAL_SELF_POWERED=n
CONFIG_TEST_EXPECTED_CDC_ACM_SERIAL_MAX_POWER=75
```

## boards/cytron_maker_nano_rp2040.conf
```kconfig
# SPDX-FileCopyrightText: 2025-2026 TiaC Systems
# SPDX-License-Identifier: Apache-2.0

# Cytron @ Maker Nano RP2040
CONFIG_TEST_EXPECTED_CDC_ACM_SERIAL_VID=0x2e8a
CONFIG_TEST_EXPECTED_CDC_ACM_SERIAL_PID=0x000a
CONFIG_TEST_EXPECTED_CDC_ACM_SERIAL_MANUFACTURER_STRING="Cytron (Raspberry Pi)"
CONFIG_TEST_EXPECTED_CDC_ACM_SERIAL_PRODUCT_STRING="Maker Nano RP2040 (CDC ACM)"
CONFIG_TEST_EXPECTED_CDC_ACM_SERIAL_SELF_POWERED=n
CONFIG_TEST_EXPECTED_CDC_ACM_SERIAL_MAX_POWER=215
```

## boards/cytron_maker_pi_rp2040.conf
```kconfig
# SPDX-FileCopyrightText: 2025-2026 TiaC Systems
# SPDX-License-Identifier: Apache-2.0

# Cytron @ Maker Pi RP2040
CONFIG_TEST_EXPECTED_CDC_ACM_SERIAL_VID=0x2e8a
CONFIG_TEST_EXPECTED_CDC_ACM_SERIAL_PID=0x000a
CONFIG_TEST_EXPECTED_CDC_ACM_SERIAL_MANUFACTURER_STRING="Cytron (Raspberry Pi)"
CONFIG_TEST_EXPECTED_CDC_ACM_SERIAL_PRODUCT_STRING="Maker Pi RP2040 (CDC ACM)"
CONFIG_TEST_EXPECTED_CDC_ACM_SERIAL_SELF_POWERED=n
CONFIG_TEST_EXPECTED_CDC_ACM_SERIAL_MAX_POWER=250
```

## boards/cytron_motion_2350_pro_hazard3.conf
```kconfig
# Copyright (c) 2026 TiaC Systems
# SPDX-License-Identifier: Apache-2.0

CONFIG_TEST_CHOSEN_ZEPHYR_SHELL_UART=y

# Cytron @ MOTION 2350 Pro
CONFIG_TEST_EXPECTED_CDC_ACM_SERIAL_VID=0x2e8a
CONFIG_TEST_EXPECTED_CDC_ACM_SERIAL_PID=0x000a
CONFIG_TEST_EXPECTED_CDC_ACM_SERIAL_MANUFACTURER_STRING="Cytron (Raspberry Pi)"
CONFIG_TEST_EXPECTED_CDC_ACM_SERIAL_PRODUCT_STRING="MOTION 2350 Pro (CDC ACM)"
CONFIG_TEST_EXPECTED_CDC_ACM_SERIAL_SELF_POWERED=n
CONFIG_TEST_EXPECTED_CDC_ACM_SERIAL_MAX_POWER=250
```

## src/main.c
```c
/*
 * SPDX-FileCopyrightText: 2025-2026 TiaC Systems
 * SPDX-License-Identifier: Apache-2.0
 */

void test_main(void)
{
	/* Intentionally left empty, we are testing DTS bindings. */
}
```
