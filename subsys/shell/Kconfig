## subsys/shell/Kconfig
```kconfig
# Shell configuration options

# SPDX-FileCopyrightText: 2021-2026 TiaC Systems
# SPDX-FileCopyrightText: 2018 Nordic Semiconductor ASA
# SPDX-FileCopyrightText: 2016 Intel Corporation
# SPDX-FileCopyrightText: 2014-2015 Wind River Systems, Inc.
# SPDX-License-Identifier: Apache-2.0

if SHELL

# zephyr-keep-sorted-start
rsource "modules/Kconfig"
# zephyr-keep-sorted-stop

endif # SHELL
```

## subsys/shell/modules/Kconfig
```kconfig
# SPDX-FileCopyrightText: 2021-2026 TiaC Systems
# SPDX-FileCopyrightText: 2019-2021 Li-Pro.Net
# SPDX-License-Identifier: Apache-2.0

config BRIDLE_SHELL
	bool "Enable Bridle shell"
	default y
	help
	  This shell provides access to basic Bridle data like version.

rsource "Kconfig.commands"
```

## tests/snippets/usb-console/build_all/boards/native_sim_native.conf
```kconfig
# SPDX-FileCopyrightText: Copyright (c) 2026 TiaC Systems
# SPDX-License-Identifier: Apache-2.0

# USB Device Driver
CONFIG_TEST_EXPECTED_UDC_DRIVER_LOG_LEVEL_DEFAULT=y

# USB Device Stack
CONFIG_TEST_EXPECTED_USBD_LOG_LEVEL_DEFAULT=y

# USB CDC ACM Class
CONFIG_TEST_EXPECTED_USBD_CDC_ACM_LOG_LEVEL_DEFAULT=y
```

## tests/snippets/usb-console/build_all/boards/picoboy_color_plus_rp2350a_m33_0.conf
```kconfig
# SPDX-FileCopyrightText: Copyright (c) 2025-2026 TiaC Systems
# SPDX-License-Identifier: Apache-2.0

# Zephyr chosen properties, disabled due to lack of board level support
CONFIG_TEST_CHOSEN_ZEPHYR_UART_MCUMGR=n
CONFIG_TEST_CHOSEN_ZEPHYR_BT_MON_UART=n
CONFIG_TEST_CHOSEN_ZEPHYR_BT_C2H_UART=n

# JSED @ PicoBoy Color Plus
CONFIG_TEST_EXPECTED_CDC_ACM_SERIAL_VID=0x2E8A
CONFIG_TEST_EXPECTED_CDC_ACM_SERIAL_PID=0x000A
CONFIG_TEST_EXPECTED_CDC_ACM_SERIAL_MANUFACTURER_STRING="JSED (Raspberry Pi)"
CONFIG_TEST_EXPECTED_CDC_ACM_SERIAL_PRODUCT_STRING="PicoBoy Color Plus (CDC ACM)"
CONFIG_TEST_EXPECTED_CDC_ACM_SERIAL_SELF_POWERED=n
CONFIG_TEST_EXPECTED_CDC_ACM_SERIAL_MAX_POWER=125
```

## tests/snippets/usb-console/build_all/boards/xiao_rp2350_rp2350a_m33_0.conf
```kconfig
# SPDX-FileCopyrightText: Copyright (c) 2026 TiaC Systems
# SPDX-License-Identifier: Apache-2.0

# Seeed LLC @ XIAO RP2350
CONFIG_TEST_EXPECTED_CDC_ACM_SERIAL_VID=0x2e8a
CONFIG_TEST_EXPECTED_CDC_ACM_SERIAL_PID=0x000a
CONFIG_TEST_EXPECTED_CDC_ACM_SERIAL_MANUFACTURER_STRING="Seeed LLC (Raspberry Pi)"
CONFIG_TEST_EXPECTED_CDC_ACM_SERIAL_PRODUCT_STRING="XIAO RP2350 (CDC ACM)"
CONFIG_TEST_EXPECTED_CDC_ACM_SERIAL_SELF_POWERED=n
CONFIG_TEST_EXPECTED_CDC_ACM_SERIAL_MAX_POWER=250
```

## tests/snippets/usb-console/build_all/boards/xiao_stm32c5_stm32c5a3xx.conf
```kconfig
# SPDX-FileCopyrightText: Copyright (c) 2026 TiaC Systems
# SPDX-License-Identifier: Apache-2.0

# USB Device Stack
CONFIG_TEST_EXPECTED_USBD_LOG_LEVEL_OFF=y

# Seeed Studio @ XIAO STM32C5
CONFIG_TEST_EXPECTED_CDC_ACM_SERIAL_VID=0x2886
CONFIG_TEST_EXPECTED_CDC_ACM_SERIAL_PID=0x00c5
CONFIG_TEST_EXPECTED_CDC_ACM_SERIAL_MANUFACTURER_STRING="Seeed Studio"
CONFIG_TEST_EXPECTED_CDC_ACM_SERIAL_PRODUCT_STRING="XIAO STM32C5 (CDC ACM)"
CONFIG_TEST_EXPECTED_CDC_ACM_SERIAL_SELF_POWERED=n
CONFIG_TEST_EXPECTED_CDC_ACM_SERIAL_MAX_POWER=250
```
