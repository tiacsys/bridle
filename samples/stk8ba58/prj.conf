## CMakeLists.txt
```
# SPDX-FileCopyrightText: 2025-2026 TiaC Systems
# SPDX-License-Identifier: Apache-2.0

cmake_minimum_required(VERSION 3.28.0)

# Standard Bridle application boilerplate, includes Zephyr.
find_package(Bridle REQUIRED HINTS $ENV{BRIDLE_BASE})
project("STK8BA58 3-Axis Accelerometer Sample" VERSION 0.1)

FILE(GLOB app_sources src/*.c)
target_sources(app PRIVATE ${app_sources})
```

## Kconfig
```
# SPDX-FileCopyrightText: 2025-2026 TiaC Systems
# SPDX-License-Identifier: Apache-2.0

mainmenu "STK8BA58 3-axis accelerometer sample application"

config APPLICATION_RANGE
	int "Application range in m/s^2"
	default 80
	range 20 80
	help
	  Application range (multiply of g) that have to set in polling
	  and trigger mode. Only following values are meaningfull:

	  20 ~ 2g (19.61330 m/s^2)
	  40 - 4g (39.22660 m/s^2)
	  80 - 8g (78.45320 m/s^2)

config APPLICATION_ODR
	int "Application ODR in Hz"
	default 15
	range 0 2000
	depends on STK8BA58_TRIGGER
	help
	  Application output data rate (ODR) that have to set
	  in trigger mode. Only following values are meaningfull:

	     0 - OFF (STK8BA58_DT_ODR_OFF)
	    15 Hz (STK8BA58_DT_ODR_15Hz63)
	    31 Hz (STK8BA58_DT_ODR_31Hz25)
	    62 Hz (STK8BA58_DT_ODR_62Hz5)
	   125 Hz (STK8BA58_DT_ODR_125Hz)
	   250 Hz (STK8BA58_DT_ODR_250Hz)
	   500 Hz (STK8BA58_DT_ODR_500Hz)
	  1000 Hz (STK8BA58_DT_ODR_1000Hz)
	  2000 Hz (STK8BA58_DT_ODR_2000Hz)

config APPLICATION_LPSLEEP
	int "Application low-power sleep in us"
	default 1000000
	range 0 1000000
	depends on STK8BA58_TRIGGER
	help
	  Application low-power sleep duration that have to set
	  in trigger mode. Only following values are meaningfull:

	        0 - OFF (STK8BA58_DT_POWER_NORMAL)
	      500 us (STK8BA58_DT_LOW_POWER_0ms5)
	     1000 us (STK8BA58_DT_LOW_POWER_1ms)
	     2000 us (STK8BA58_DT_LOW_POWER_2ms)
	     4000 us (STK8BA58_DT_LOW_POWER_4ms)
	     6000 us (STK8BA58_DT_LOW_POWER_6ms)
	    10000 us (STK8BA58_DT_LOW_POWER_10ms)
	    25000 us (STK8BA58_DT_LOW_POWER_25ms)
	    50000 us (STK8BA58_DT_LOW_POWER_50ms)
	   100000 us (STK8BA58_DT_LOW_POWER_100ms)
	   500000 us (STK8BA58_DT_LOW_POWER_500ms)
	  1000000 us (STK8BA58_DT_LOW_POWER_1000ms)

# Sources Kconfig.zephyr in the Zephyr root directory.
menu "Zephyr Kernel"
source "Kconfig.zephyr"
endmenu
```

## sample.yaml
```
# Copyright (c) 2025 TiaC Systems
# SPDX-License-Identifier: Apache-2.0

sample:
  description: STK8BA58 3-Axis Accelerometer Sample
  name: stk8ba58 3axis accelerometer
common:
  tags:
    - bridle
    - sensors
    - stk8ba58
  depends_on:
    - i2c
    - gpio
  filter: dt_compat_enabled("sensortek,stk8ba58")
  sysbuild: false
tests:
  bridle.sample.stk8ba58:
    integration_platforms:
      - picoboy/rp2040
      - picoboy_color_plus/rp2350a/m33
```

## prj.conf
```kconfig
# SPDX-FileCopyrightText: 2025-2026 TiaC Systems
# SPDX-License-Identifier: Apache-2.0

CONFIG_CBPRINTF_FP_SUPPORT=y
CONFIG_I2C=y
CONFIG_SENSOR=y

CONFIG_LOG=y
CONFIG_SENSOR_LOG_LEVEL_DBG=y
```

## src/main.c
```c
/*
 * SPDX-FileCopyrightText: 2025-2026 TiaC Systems
 * SPDX-License-Identifier: Apache-2.0
 */

#include <stdio.h>
#include <zephyr/kernel.h>
#include <zephyr/device.h>
#include <zephyr/drivers/sensor.h>

static void fetch_and_display(const struct device *sensor)
{
	static unsigned int count;
	struct sensor_value accel[3];
	const char *overrun = "";
	int rc = sensor_sample_fetch(sensor);

	++count;
	if (rc == -EBADMSG) {
		/* Sample overrun.  Ignore in polled mode. */
		if (IS_ENABLED(CONFIG_STK8BA58_TRIGGER)) {
			overrun = "[OVERRUN] ";
		}
		rc = 0;
	}
	if (rc == 0) {
		rc = sensor_channel_get(sensor,
					SENSOR_CHAN_ACCEL_XYZ,
					accel);
	}
	if (rc < 0) {
		printf("ERROR: Update failed: %d\n", rc);
	} else {
		printf("#%u @ %u ms: %sx %f , y %f , z %f\n",
		       count, k_uptime_get_32(), overrun,
		       sensor_value_to_double(&accel[0]),
		       sensor_value_to_double(&accel[1]),
		       sensor_value_to_double(&accel[2]));
	}
}

#ifdef CONFIG_STK8BA58_TRIGGER
static void trigger_handler(const struct device *dev,
			    const struct sensor_trigger *trig)
{
	fetch_and_display(dev);
}
#endif

int main(void)
{
	const struct device *const sensor = DEVICE_DT_GET_ANY(sensortek_stk8ba58);
	int rc;

	if (sensor == NULL) {
		printf("No device found\n");
		return 0;
	}
	if (!device_is_ready(sensor)) {
		printf("Device %s is not ready\n", sensor->name);
		return 0;
	}

	struct sensor_value attr_val = {
		.val1 = CONFIG_APPLICATION_RANGE,
		.val2 = 0,
	};

	rc = sensor_attr_set(sensor, SENSOR_CHAN_ACCEL_XYZ,
			     SENSOR_ATTR_FULL_SCALE, &attr_val);
	if (rc != 0) {
		printf("Failed to set range: %d\n", rc);
		return 0;
	}
	printf("Range at %u m/s^2\n", attr_val.val1);

#if CONFIG_STK8BA58_TRIGGER
	{
		struct sensor_trigger trig;

		trig.type = SENSOR_TRIG_DATA_READY;
		trig.chan = SENSOR_CHAN_ACCEL_XYZ;

		attr_val.val1 = CONFIG_APPLICATION_ODR;
		attr_val.val2 = 0;
		rc = sensor_attr_set(sensor, trig.chan,
				     SENSOR_ATTR_SAMPLING_FREQUENCY,
				     &attr_val);
		if (rc != 0) {
			printf("Failed to set odr: %d\n", rc);
			return 0;
		}
		printf("Sampling at %u Hz\n", attr_val.val1);

		sensor_value_from_milli(&attr_val, CONFIG_APPLICATION_LPSLEEP);
		rc = sensor_attr_set(sensor, trig.chan,
				     SENSOR_ATTR_CONFIGURATION,
				     &attr_val);
		if (rc != 0) {
			printf("Failed to set pm: %d\n", rc);
			return 0;
		}
		printf("LP Sleep at %u ms\n", attr_val.val1);

		rc = sensor_trigger_set(sensor, &trig, trigger_handler);
		if (rc != 0) {
			printf("Failed to set trigger: %d\n", rc);
			return 0;
		}

		printf("Waiting for triggers\n");
		while (true) {
			k_sleep(K_MSEC(2000));
		}
	}
#else /* CONFIG_STK8BA58_TRIGGER */
	printf("Polling at 0.5 Hz\n");
	while (true) {
		fetch_and_display(sensor);
		k_sleep(K_MSEC(2000));
	}
#endif /* CONFIG_STK8BA58_TRIGGER */
}
```
