## CMakeLists.txt
```
# SPDX-FileCopyrightText: 2023-2026 TiaC Systems
# SPDX-License-Identifier: Apache-2.0

cmake_minimum_required(VERSION 3.28.0)

# Standard Bridle application boilerplate, includes Zephyr.
find_package(Bridle REQUIRED HINTS $ENV{BRIDLE_BASE})
project("UBXLib Hello Shell" VERSION 0.1)

assert(CONFIG_SHELL "Zephyr's embedded shell must be enabled")

# Add your source file to the "app" target. This must come after
# the boilerplate code, which defines the target.
target_sources(app PRIVATE
    src/main.c
    src/shell.c
)

target_include_directories(app PRIVATE
    src
)
```

## Kconfig
```
# SPDX-FileCopyrightText: 2024-2026 TiaC Systems
# SPDX-FileCopyrightText: 2023-2025 Sarah Renkhoff
# SPDX-License-Identifier: Apache-2.0

menu "Ubxlib GNSS sample settings"

module = MAIN
module-str = "main"
source "subsys/logging/Kconfig.template.log_config"

endmenu

# Sources Kconfig.zephyr in the Zephyr root directory.
menu "Zephyr Kernel"
source "Kconfig.zephyr"
endmenu
```

## sample.yaml
```
sample:
  description: demonstrating how to integrate a u-blox GNSS device
    into a Zephyr application
  name: ubxlib gnss
common:
  tags:
    - bridle
    - ubxlib
  sysbuild: false
  platform_exclude:
    - nucleo_f303re/stm32f303xe
    - nucleo_f401re/stm32f401xe
    - nucleo_l496zg/stm32l496xx
  platform_allow:
    - mimxrt1010_evk/mimxrt1011
    - mimxrt1010_evk/mimxrt1011/bbe
    - mimxrt1060_evk@A/mimxrt1062/qspi
    - mimxrt1060_evk@B/mimxrt1062/qspi
    - mimxrt1060_evk@C/mimxrt1062/qspi
    - mimxrt1060_evk@C/mimxrt1062/hyperflash
    - mimxrt1170_evk@A/mimxrt1176/cm7
    - mimxrt1170_evk@B/mimxrt1176/cm7
    - nrf52840dk/nrf52840
    - nrf9160dk/nrf9160
    - nucleo_f303re/stm32f303xe/bbe
    - nucleo_f401re/stm32f401xe/bbe
    - nucleo_f413zh/stm32f413xx
    - nucleo_f413zh/stm32f413xx/bbe
    - nucleo_f746zg/stm32f746xx
    - nucleo_f746zg/stm32f746xx/bbe
    - nucleo_f767zi/stm32f767xx
    - nucleo_f767zi/stm32f767xx/bbe
    - nucleo_l496zg/stm32l496xx/bbe
  integration_platforms:
    - mimxrt1010_evk/mimxrt1011
    - mimxrt1010_evk/mimxrt1011/bbe
    - mimxrt1060_evk@A/mimxrt1062/qspi
    - mimxrt1060_evk@B/mimxrt1062/qspi
    - mimxrt1060_evk@C/mimxrt1062/qspi
    - mimxrt1060_evk@C/mimxrt1062/hyperflash
    - mimxrt1170_evk@A/mimxrt1176/cm7
    - mimxrt1170_evk@B/mimxrt1176/cm7
    - nrf52840dk/nrf52840
    - nrf9160dk/nrf9160
    - nucleo_f303re/stm32f303xe/bbe
    - nucleo_f401re/stm32f401xe/bbe
    - nucleo_f413zh/stm32f413xx
    - nucleo_f413zh/stm32f413xx/bbe
    - nucleo_f746zg/stm32f746xx
    - nucleo_f746zg/stm32f746xx/bbe
    - nucleo_f767zi/stm32f767xx
    - nucleo_f767zi/stm32f767xx/bbe
    - nucleo_l496zg/stm32l496xx/bbe
tests:
  bridle.sample.ubx_gnss.release:
    build_only: true
    build_on_all: true
    extra_args: CMAKE_BUILD_TYPE=ZRelease
  bridle.sample.ubx_gnss.debug:
    build_only: true
    build_on_all: true
    extra_args: CMAKE_BUILD_TYPE=ZDebug
```

## prj.conf
```kconfig
# SPDX-FileCopyrightText: 2022 Peter Lerup
# SPDX-FileCopyrightText: 2023 Rob Meades
# SPDX-FileCopyrightText: 2023 Sarah Renkhoff
# SPDX-FileCopyrightText: 2023-2026 TiaC Systems
# SPDX-License-Identifier: Apache-2.0

# Multi-threaded, with timer support in the kernel
CONFIG_MULTITHREADING=y
CONFIG_NUM_COOP_PRIORITIES=16
CONFIG_NUM_METAIRQ_PRIORITIES=0

CONFIG_ERRNO=y
CONFIG_SCHED_SIMPLE=y
CONFIG_WAITQ_SIMPLE=y

# Shell with printk
CONFIG_BOOT_BANNER=y
CONFIG_PRINTK=y
CONFIG_CBPRINTF_FP_SUPPORT=y
CONFIG_SHELL=y

# Logging
CONFIG_LOG=y

# Ubxlib
CONFIG_GPIO=y
CONFIG_SERIAL=y
CONFIG_UBXLIB=y
CONFIG_UBXLIB_GNSS=y

# Libc
CONFIG_MINIMAL_LIBC=y
CONFIG_COMMON_LIBC_MALLOC=n

# Memory
CONFIG_MAIN_STACK_SIZE=8192
CONFIG_HEAP_MEM_POOL_SIZE=16384

# Interrupt driven UART is set just to point out that is the
# case: it will be the default anyway, except for Zephyr Linux
# where the UART has, unfortunately, to be polled
CONFIG_UART_INTERRUPT_DRIVEN=y

# Required for uPortTaskStackMinFree() to work (from Ubxlib)
CONFIG_INIT_STACKS=y
CONFIG_THREAD_STACK_INFO=y
CONFIG_THREAD_NAME=y
```

## boards/mimxrt1010_evk.conf
```kconfig
# Copyright (c) 2024-2025 TiaC Systems
# SPDX-License-Identifier: Apache-2.0

# reduction of RAM consumption to an absolute minimum
# zephyr-keep-sorted-start
CONFIG_HEAP_MEM_POOL_SIZE=16384
CONFIG_ISR_STACK_SIZE=1024
CONFIG_LOG=n
CONFIG_MAIN_STACK_SIZE=3456
CONFIG_SHELL_MINIMAL=y
CONFIG_SYSTEM_WORKQUEUE_STACK_SIZE=512
CONFIG_USB_CDC_ACM_RINGBUF_SIZE=512
CONFIG_USB_WORKQUEUE_STACK_SIZE=512
# zephyr-keep-sorted-stop
```

## boards/mimxrt1010_evk_bbe.conf
```kconfig
# SPDX-FileCopyrightText: 2024-2026 TiaC Systems
# SPDX-License-Identifier: Apache-2.0

# reduction of RAM consumption to an absolute minimum
# zephyr-keep-sorted-start
CONFIG_HEAP_MEM_POOL_SIZE=16384
CONFIG_ISR_STACK_SIZE=1024
CONFIG_LOG=n
CONFIG_MAIN_STACK_SIZE=3456
CONFIG_SHELL_MINIMAL=y
CONFIG_SYSTEM_WORKQUEUE_STACK_SIZE=512
CONFIG_USB_CDC_ACM_RINGBUF_SIZE=512
CONFIG_USB_WORKQUEUE_STACK_SIZE=512
# zephyr-keep-sorted-stop
```

## boards/nrf9160dk_nrf9160.conf
```kconfig
# SPDX-FileCopyrightText: 2024-2026 TiaC Systems
# SPDX-License-Identifier: Apache-2.0

# increase RAM consumption to avoid stack overflows on nRF9160 DK
# zephyr-keep-sorted-start
CONFIG_SHELL_STACK_SIZE=4096
# zephyr-keep-sorted-stop
```

## app.overlay
```dts
/*
 * SPDX-FileCopyrightText: 2024-2026 TiaC Systems
 * SPDX-FileCopyrightText: 2023 Sarah Renkhoff
 * SPDX-License-Identifier: Apache-2.0
 */

/ {
	/* Pin assignment
	 * - from MCU
	 * - over Arduino header
	 * - to the GNSS device
	 *
	 * MCU		Arduino		GNSS device
	 * ------------	------------	------------
	 * U(S)ART RxD	D0 (RxD)	TxD
	 * U(S)ART TxD	D1 (TxD)	RxD
	 * GPIO		D8		RESET
	 */

	reset_switch: reset_switch {
		compatible = "reset-switch";
		gpios = <&arduino_header 14 GPIO_ACTIVE_LOW>;
	};

	aliases {
		ubxlib-uart0 = &arduino_serial;
	};
};

&arduino_serial {
	status = "okay";
	current-speed = <9600>;
};
```

## boards/mimxrt1170_evk_mimxrt1176_cm7.overlay
```dts
/*
 * SPDX-FileCopyrightText: 2024-2026 TiaC Systems
 * SPDX-License-Identifier: Apache-2.0
 */

/* FIXME: revert this overlay as soon as possible,
 *        provide at least a new board extension,
 *        or better, change Zephyr upstream */

/* Zephyr upstream doesn't provide the Arduino header */

/ {
	reset_switch: reset_switch {
		compatible = "reset-switch";
		gpios = <&gpio9 6 GPIO_ACTIVE_LOW>;	/* D8 */
	};

	aliases {
		ubxlib-uart0 = &lpuart2;
	};
};

&lpuart2 {
	status = "okay";
	current-speed = <9600>;
};
```

## dts/bindings/reset-switch.yaml
```yaml
# SPDX-FileCopyrightText: 2023-2026 TiaC Systems
# SPDX-FileCopyrightText: 2023 Sarah Renkhoff
# SPDX-License-Identifier: Apache-2.0

description: GPIO pin to cause a reset on an external device

compatible: "reset-switch"

properties:
  gpios:
    type: phandle-array
    required: true
    description: |
      The GPIO pin connected to a reset switch.
```

## src/main.c
```c
/*
 * SPDX-FileCopyrightText: 2024-2026 TiaC Systems
 * SPDX-FileCopyrightText: 2023 Sarah Renkhoff
 * SPDX-License-Identifier: Apache-2.0
 */

/* Zephyr includes */
#include <zephyr/kernel.h>
#include <zephyr/init.h>
#include <zephyr/devicetree.h>
#include <zephyr/drivers/gpio.h>

/* Application specific includes */
#include <main.h>

/* Logging */
#include <zephyr/logging/log.h>
LOG_MODULE_REGISTER(main, CONFIG_MAIN_LOG_LEVEL);

#if !DT_NODE_EXISTS(DT_NODELABEL(reset_switch))
#error No reset switch node found in devicetree, check overlay for your board
#endif

static const struct gpio_dt_spec reset_switch = GPIO_DT_SPEC_GET(DT_NODELABEL(reset_switch), gpios);

static const uDeviceCfg_t device_config = {
	.deviceType = U_DEVICE_TYPE_GNSS,
	.deviceCfg = {
		.cfgGnss = {
			.moduleType = U_GNSS_MODULE_TYPE_M10,
			.pinEnablePower = -1,
			.pinDataReady = -1,
		},
	},
	.transportType = U_DEVICE_TRANSPORT_TYPE_UART,
	.transportCfg = {
		.cfgUart = {
			.uart = 0,
			.baudRate = U_GNSS_UART_BAUD_RATE,
			.pinTxd = -1,
			.pinRxd = -1,
			.pinCts = -1,
			.pinRts = -1,
		}
	},
};

uDeviceHandle_t gnss_device_handle;

static int init(void)
{
	uPortInit();
	uDeviceInit();

	gpio_pin_configure_dt(&reset_switch, GPIO_OUTPUT_INACTIVE);

	return 0;
}
SYS_INIT(init, APPLICATION, 90);

void reset_gnss(void)
{
	gpio_pin_set_dt(&reset_switch, 1);
	k_msleep(200);
	gpio_pin_set_dt(&reset_switch, 0);
}

int main(void)
{
	int ret;

	ret = uDeviceOpen(&device_config, &gnss_device_handle);
	if (ret != 0) {
		LOG_ERR("Error during uDeviceOpen: %d", ret);
		return 0;
	}

#if IS_ENABLED(CONFIG_LOG)
	LOG_INF("GNSS Device is ready!");
#else
	printk("GNSS Device is ready!\n");
#endif

	while (true) {
		k_msleep(1000);
	}

	return 0;
}
```

## src/main.h
```c
/*
 * SPDX-FileCopyrightText: 2023-2026 TiaC Systems
 * SPDX-License-Identifier: Apache-2.0
 */

#ifndef MAIN_H
#define MAIN_H

/* ubxlib specific includes */
#include <ubxlib.h>
#include <u_cfg_app_platform_specific.h>

extern uDeviceHandle_t gnss_device_handle;

void reset_gnss(void);

#endif /* MAIN_H */
```

## src/shell.c
```c
/*
 * SPDX-FileCopyrightText: 2023-2026 TiaC Systems
 * SPDX-License-Identifier: Apache-2.0
 */

#include <zephyr/shell/shell.h>
#include <stdlib.h>

/* Application specific includes */
#include <main.h>

/* Logging */
#include <zephyr/logging/log.h>
LOG_MODULE_DECLARE(main, CONFIG_MAIN_LOG_LEVEL);

static void gnss_stream_callback(uDeviceHandle_t device_handle,
				 int32_t error_code,
				 int32_t latitudeX1e7,
				 int32_t longitudeX1e7,
				 int32_t altitude_millimeters,
				 int32_t radius_millimeters,
				 int32_t speed_millimeters_per_second,
				 int32_t space_vehicles_used,
				 int64_t time_utc)
{
	if (error_code != 0) {
		LOG_ERR("Error during uGnssPosGetStreamed: %d", error_code);
		return;
	}

	double latitude = latitudeX1e7 / 1.e7;
	double longitude = longitudeX1e7 / 1.e7;
	double altitude_meters = altitude_millimeters / 1000.0;
	double radius_meters = radius_millimeters / 1000.0;

#if IS_ENABLED(CONFIG_LOG)
	LOG_INF("Found position estimate: (lat, lon): (%f, %f), alt: "
		"%.2fm, radius: %.2fm (%d SV used)", latitude, longitude,
		altitude_meters, radius_meters, space_vehicles_used);
#else
	printk("Found position estimate: (lat, lon): (%f, %f), alt: "
	       "%.2fm, radius: %.2fm (%d SV used)\n", latitude, longitude,
	       altitude_meters, radius_meters, space_vehicles_used);
#endif

}

static int cmd_gnss_single(const struct shell *sh, size_t argc, char **argv, void *data)
{
	if (gnss_device_handle == NULL) {
		shell_print(sh, "Error: GNSS device is not ready");
		return -1;
	}

	int32_t latitudeX1e7 = 0;
	int32_t longitudeX1e7 = 0;
	int32_t altitude_millimeters = 0;
	int32_t radius_millimeters = 0;
	int32_t speed_millimeters_per_second = 0;
	int32_t space_vehicles_used = 0;
	int64_t time_utc = 0;

	int64_t start_time_ms = k_uptime_get();

	int ret = uGnssPosGet(gnss_device_handle, &latitudeX1e7,
						  &longitudeX1e7,
						  &altitude_millimeters,
						  &radius_millimeters,
						  &speed_millimeters_per_second,
						  &space_vehicles_used,
						  &time_utc,
						  NULL);

	if (ret != 0) {
		shell_error(sh, "Error during uGnssPosGet: %d", ret);
		return -1;
	}

	int64_t stop_time_ms = k_uptime_get();
	double time_to_fix_seconds = (stop_time_ms - start_time_ms) / 1000.0;

	double latitude = latitudeX1e7 / 1.e7;
	double longitude = longitudeX1e7 / 1.e7;
	double altitude_meters = altitude_millimeters / 1000.0;
	double radius_meters = radius_millimeters / 1000.0;

	shell_print(sh, "Found position estimate after %.1fs: "
			"(lat, lon): (%f, %f), alt: %.2fm, radius: "
			"%.2fm (%d SV used)", time_to_fix_seconds,
			latitude, longitude, altitude_meters,
			radius_meters, space_vehicles_used);

	return 0;
}

static int cmd_gnss_stream_start(const struct shell *sh, size_t argc, char **argv, void *data)
{
	if (gnss_device_handle == NULL) {
		shell_error(sh, "Error: GNSS device is not ready");
		return -1;
	}

	uGnssPosGetStreamedStart(gnss_device_handle, 1000, gnss_stream_callback);

	return 0;
}

static int cmd_gnss_stream_stop(const struct shell *sh, size_t argc, char **argv, void *data)
{
	if (gnss_device_handle == NULL) {
		shell_error(sh, "Error: GNSS device is not ready");
		return -1;
	}

	uGnssPosGetStreamedStop(gnss_device_handle);

	return 0;
}

static int cmd_gnss_reset(const struct shell *sh, size_t argc, char **argv, void *data)
{
	if (gnss_device_handle == NULL) {
		shell_error(sh, "Error: GNSS device is not ready");
		return -1;
	}

	reset_gnss();
	return 0;
}

static int cmd_gnss_ttff(const struct shell *sh, size_t argc, char **argv, void *data)
{
	if (gnss_device_handle == NULL) {
		shell_error(sh, "Error: GNSS device is not ready");
		return -1;
	}

	int n_tests = 1;

	if (argc > 1) {
		n_tests = atoi(argv[1]);
	}

	uint64_t durations_total_ms = 0;

	for (int i = 0; i < n_tests; i++) {

		uint64_t start_time_ms, stop_time_ms, duration_ms;
		int ret;

		reset_gnss();

		start_time_ms = k_uptime_get();
		ret = uGnssPosGet(gnss_device_handle, NULL, NULL, NULL, NULL,
						      NULL, NULL, NULL, NULL);
		if (ret != 0) {
			shell_error(sh, "Error during uGnssPosGet: %d", ret);
			return -1;
		}

		stop_time_ms = k_uptime_get();
		duration_ms = stop_time_ms - start_time_ms;

		shell_print(sh, "Run %d of %d: Acquired fix after %.2fs",
				i+1, n_tests, duration_ms / 1000.0);

		durations_total_ms += duration_ms;
	}

	double duration_avg_seconds = (durations_total_ms / 1000.0) / n_tests;

	shell_print(sh, "---------------");
	shell_print(sh, "Avg. TTFF: %.2f", duration_avg_seconds);

	return 0;
}

SHELL_STATIC_SUBCMD_SET_CREATE(gnss_stream_sub,
	SHELL_CMD(start, NULL, "Start streaming position estimates", cmd_gnss_stream_start),
	SHELL_CMD(stop, NULL, "Stop streaming position estimates", cmd_gnss_stream_stop),
	SHELL_SUBCMD_SET_END
);

SHELL_STATIC_SUBCMD_SET_CREATE(gnss_sub,
	SHELL_CMD(single, NULL, "Get a one-shot position estimate", cmd_gnss_single),
	SHELL_CMD(stream, &gnss_stream_sub, "Start or stop streaming of position estimates", NULL),
	SHELL_CMD(reset, NULL, "Reset GNSS module", cmd_gnss_reset),
	SHELL_CMD(ttff, NULL, "Measure TTFF", cmd_gnss_ttff),
	SHELL_SUBCMD_SET_END
);
SHELL_CMD_REGISTER(gnss, &gnss_sub, "GNSS related commands", NULL);
```
