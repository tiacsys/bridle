/*
 * Copyright (c) 2021-2023 TiaC Systems
 * SPDX-License-Identifier: Apache-2.0
 *
 * disable unsupported components or components with issues
 *
 */

/* FLEXPWM not routed to LED on this EVK revision, thus why board DTS
 * disables &flexpwm2_pwm3 but neither related &pwmleds node nor alias. */

/ {
	aliases {
		/delete-property/ pwm-led0;
	};

	/delete-node/ pwmleds;
};

/* FLEXCAN3 needs proper speed setup for both, standard CAN and FD CAN */

&flexcan3 {
	status = "okay";
	bus-speed = <500000>;
	bus-speed-data = <5000000>;
	sample-point = <800>;
	sample-point-data = <750>;

	can-transceiver {
		max-bitrate = <5000000>;
	};
};
