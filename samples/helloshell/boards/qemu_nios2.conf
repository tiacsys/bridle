## samples/helloshell/boards/qemu_nios2.conf
```kconfig
# Copyright (c) 2021-2023 TiaC Systems
# SPDX-License-Identifier: Apache-2.0

# disable unsupported components or components with issues
CONFIG_FLASH=n
CONFIG_FLASH_SHELL=n

# disable components to avoid FLASH overflow on RODATA allocation
CONFIG_SENSOR=n
CONFIG_SENSOR_INFO=n
CONFIG_SENSOR_SHELL=n
```

## samples/helloshell/boards/qemu_riscv32_xip_fe310_g002.conf
```kconfig
# Copyright (c) 2021-2025 TiaC Systems
# SPDX-License-Identifier: Apache-2.0

# disable unsupported components or components with issues
# zephyr-keep-sorted-start
CONFIG_FLASH=n
CONFIG_FLASH_SHELL=n
CONFIG_GPIO=n
CONFIG_GPIO_SHELL=n
# zephyr-keep-sorted-stop

# disable components to avoid RAM overflow on BSS allocation
# zephyr-keep-sorted-start
CONFIG_SENSOR_SHELL=n
CONFIG_SHELL_MINIMAL=y
# zephyr-keep-sorted-stop
```

## samples/helloshell/boards/qemu_x86.conf
```kconfig
# Copyright (c) 2021 TiaC Systems
# Copyright (c) 2019-2021 Li-Pro.Net
# SPDX-License-Identifier: Apache-2.0

# disable unsupported components
CONFIG_ADC=n
CONFIG_ADC_SHELL=n
```

## samples/helloshell/boards/seeeduino_cm0.conf
```kconfig
# Copyright (c) 2021-2025 TiaC Systems
# SPDX-License-Identifier: Apache-2.0

# disable unsupported components or components with issues
# zephyr-keep-sorted-start
CONFIG_COUNTER=n
CONFIG_COUNTER_SHELL=n
CONFIG_EEPROM=n
CONFIG_EEPROM_SHELL=n
CONFIG_REGULATOR=n
CONFIG_REGULATOR_SHELL=n
CONFIG_RTC=n
CONFIG_RTC_SHELL=n
CONFIG_SENSOR=n
CONFIG_SENSOR_INFO=n
CONFIG_SENSOR_SHELL=n
# zephyr-keep-sorted-stop
```

## samples/helloshell/boards/seeeduino_lotus.conf
```kconfig
# Copyright (c) 2021-2024 TiaC Systems
# SPDX-License-Identifier: Apache-2.0

# disable unsupported components or components with issues
CONFIG_REGULATOR=n
CONFIG_REGULATOR_SHELL=n
CONFIG_COUNTER=n
CONFIG_COUNTER_SHELL=n
CONFIG_EEPROM=n
CONFIG_EEPROM_SHELL=n
CONFIG_RTC=n
CONFIG_RTC_SHELL=n
CONFIG_SENSOR=n
CONFIG_SENSOR_INFO=n
CONFIG_SENSOR_SHELL=n
```

## samples/helloshell/boards/waveshare_rp2350_can_m33.conf
```kconfig
# Copyright (c) 2025 TiaC Systems
# SPDX-License-Identifier: Apache-2.0

# disable unsupported components or components with issues
# zephyr-keep-sorted-start
CONFIG_CAN=y
CONFIG_CAN_SHELL=y
CONFIG_CAN_STATS=y
CONFIG_STATS=y
CONFIG_STATS_NAMES=y
CONFIG_STATS_SHELL=y
# zephyr-keep-sorted-stop
```

## samples/kernel-tut/Kconfig
```kconfig
# Config options for logger sample app

# Copyright (c) 2018 Nordic Semiconductor ASA
# SPDX-License-Identifier: Apache-2.0

mainmenu "Kernel Tutorial Application"

choice 
	prompt "Tutorial configuration"
	default TUTORIAL_1
	help
	 Select which tutorial shall be built

config TUTORIAL_1
	bool "Minimal build, no multithreading, no timers"

config TUTORIAL_2
	bool "Minimalistic timer example"

endchoice

source "Kconfig.zephyr"
```

## samples/memc-sram-ext/sample.yaml
```yaml
sample:
  description: Memory controller SRAM sample
  name: memc driver for SRAM sample
common:
  tags: memc
  filter: dt_alias_exists("sram-ext")
  integration_platforms:
    - stm32f7308_dk
  harness: console
  harness_config:
    type: one_line
    regex:
      - "Read data matches written data"
tests:
  sample.drivers.memc.sram:
    tags: memc sram
```

## samples/robot2/sample.yaml
```yaml
sample:
  description: Robot Framework sample to test uart and led on a device
  name: robot2 tests
common:
  tags: introduction
  integration_platforms:
    - nucleo_f303re
    - nucleo_f401re
    - mimxrt1060_evkb
tests:
  bridle.samples.robot2:
    harness: robot2
    platform_allow:
      - nucleo_f401re
      - mimxrt1060_evkb
    timeout: 300
    tags:
      - test_framework
      - robot
      - shell
```

## samples/robot_framework/sample.yaml
```yaml
sample:
  description: Robot Framework sample to test uart and led on a device
  name: robot tests
common:
  tags: introduction
  integration_platforms:
    - nucleo_f303re
    - nucleo_f401re
    - mimxrt1060_evkb
tests:
  bridle.samples.robot_device:
    harness: pytest
    harness_config:
      pytest_root:
        - "pytest/main.py"
    platform_allow:
      - nucleo_f401re
      - mimxrt1060_evkb
    timeout: 300
```

## samples/waveshare_pico_10dof_imu_sensor/Kconfig
```kconfig
# Copyright (c) 2024-2025 TiaC Systems
# SPDX-License-Identifier: Apache-2.0

mainmenu "Waveshare Pico 10-DOF IMU Sensor sample application"

# Sources Kconfig.zephyr in the Zephyr root directory.
menu "Zephyr Kernel"
source "Kconfig.zephyr"
endmenu
```

## samples/waveshare_pico_10dof_imu_sensor/sample.yaml
```yaml
# Copyright (c) 2024 TiaC Systems
# SPDX-License-Identifier: Apache-2.0

sample:
  description: Waveshare Pico 10-DOF IMU Sensor Sample
  name: waveshare pico 10dof imu sensor
common:
  tags:
    - bridle
    - sensors
    - lps22hb
    - mpu9250
  depends_on:
    - pico_i2c
    - pico_gpio
tests:
  bridle.sample.waveshare_pico_10dof_imu_sensor_r2:
    extra_args: SHIELD=waveshare_pico_10dof_imu_sensor_r2
    integration_platforms:
      - rpi_pico
      - rpi_pico/rp2040/w
      - waveshare_rp2040_lcd_0_96
      - waveshare_rp2040_plus
      - waveshare_rp2040_plus@16mb
  bridle.sample.waveshare_pico_10dof_imu_sensor_r1:
    extra_args: SHIELD=waveshare_pico_10dof_imu_sensor_r1
    integration_platforms:
      - rpi_pico
      - rpi_pico/rp2040/w
      - waveshare_rp2040_lcd_0_96
      - waveshare_rp2040_plus
      - waveshare_rp2040_plus@16mb
```

## services/Kconfig
```kconfig
# Copyright (c) 2019-2021 Li-Pro.Net
# SPDX-License-Identifier: Apache-2.0

menu "Custom Services"

# rsource "name/Kconfig"

endmenu
```

## snippets/tstdrv-bldall-sensor-adj/boards/native_sim_native_64.conf
```kconfig
# Copyright (c) 2025 TiaC Systems
# SPDX-License-Identifier: Apache-2.0

CONFIG_ADXL362_TRIGGER_NONE=n
CONFIG_ADXL362_TRIGGER_OWN_THREAD=n
CONFIG_ADXL362_TRIGGER_GLOBAL_THREAD=n

CONFIG_ADXL367_TRIGGER_NONE=n
CONFIG_ADXL367_TRIGGER_OWN_THREAD=n
CONFIG_ADXL367_TRIGGER_GLOBAL_THREAD=n

CONFIG_ADXL372_TRIGGER_NONE=n
CONFIG_ADXL372_TRIGGER_OWN_THREAD=n
CONFIG_ADXL372_TRIGGER_GLOBAL_THREAD=n
```

## snippets/usb-console/boards/arduino_zero.conf
```kconfig
# Copyright (c) 2023-2025 TiaC Systems
# SPDX-License-Identifier: Apache-2.0

# Atmel Corp. SAMD21 @ Arduino Zero
CONFIG_CDC_ACM_SERIAL_VID=0x2341
CONFIG_CDC_ACM_SERIAL_PID=0x804d
CONFIG_CDC_ACM_SERIAL_MANUFACTURER_STRING="Arduino LLC"
CONFIG_CDC_ACM_SERIAL_PRODUCT_STRING="Arduino Zero (CDC ACM)"
```

## snippets/usb-console/boards/cytron_maker_nano_rp2040.conf
```kconfig
# Copyright (c) 2023-2025 TiaC Systems
# SPDX-License-Identifier: Apache-2.0

# Cytron @ Maker Nano RP2040
CONFIG_CDC_ACM_SERIAL_VID=0x2e8a
CONFIG_CDC_ACM_SERIAL_PID=0x000a
CONFIG_CDC_ACM_SERIAL_MANUFACTURER_STRING="Cytron (Raspberry Pi)"
CONFIG_CDC_ACM_SERIAL_PRODUCT_STRING="Maker Nano RP2040 (CDC ACM)"
```

## snippets/usb-console/boards/cytron_motion_2350_pro.conf
```kconfig
# Copyright (c) 2026 TiaC Systems
# SPDX-License-Identifier: Apache-2.0

# Cytron @ MOTION 2350 Pro
CONFIG_CDC_ACM_SERIAL_VID=0x2e8a
CONFIG_CDC_ACM_SERIAL_PID=0x000a
CONFIG_CDC_ACM_SERIAL_MANUFACTURER_STRING="Cytron (Raspberry Pi)"
CONFIG_CDC_ACM_SERIAL_PRODUCT_STRING="MOTION 2350 Pro (CDC ACM)"
```

## snippets/usb-console/boards/magpie_f777ni.conf
```kconfig
# Copyright (c) 2025 TiaC Systems
# SPDX-License-Identifier: Apache-2.0

# STMicroelectronics @ TiaC Magpie F777NI
CONFIG_CDC_ACM_SERIAL_VID=0x0483
CONFIG_CDC_ACM_SERIAL_PID=0x5740
CONFIG_CDC_ACM_SERIAL_MANUFACTURER_STRING="STMicroelectronics"
CONFIG_CDC_ACM_SERIAL_PRODUCT_STRING="TiaC Magpie F777NI (CDC ACM)"
```

## snippets/usb-console/boards/mimxrt1010_evk.conf
```kconfig
# Copyright (c) 2023-2025 TiaC Systems
# SPDX-License-Identifier: Apache-2.0

# NXP @ MIMXRT1010-EVK (MIMXRT1011DAE5A)
CONFIG_CDC_ACM_SERIAL_VID=0x1fc9
CONFIG_CDC_ACM_SERIAL_PID=0x1011
CONFIG_CDC_ACM_SERIAL_MANUFACTURER_STRING="NXP"
CONFIG_CDC_ACM_SERIAL_PRODUCT_STRING="MIMXRT1010-EVK (CDC ACM)"
```

## snippets/usb-console/boards/mimxrt1060_evk.conf
```kconfig
# Copyright (c) 2023-2024 TiaC Systems
# SPDX-License-Identifier: Apache-2.0

CONFIG_USB_DEVICE_INITIALIZE_AT_BOOT=y

# NXP @ MIMXRT1060-EVK (MIMXRT1062DVL6A)
CONFIG_USB_DEVICE_VID=0x1fc9
CONFIG_USB_DEVICE_PID=0x1062
CONFIG_USB_DEVICE_MANUFACTURER="NXP"
CONFIG_USB_DEVICE_PRODUCT="MIMXRT1060-EVK (CDC ACM)"

CONFIG_USB_DEVICE_LOG_LEVEL_ERR=y
CONFIG_USB_CDC_ACM_LOG_LEVEL_OFF=y

CONFIG_LOG=y
CONFIG_LOG_PROCESS_THREAD_STARTUP_DELAY_MS=4000

CONFIG_BOOT_DELAY=4000
```

## snippets/usb-console/boards/mimxrt1170_evk.conf
```kconfig
# Copyright (c) 2026 TiaC Systems
# SPDX-License-Identifier: Apache-2.0

# NXP @ MIMXRT1170-EVK (MIMXRT1176DVMAA)
CONFIG_CDC_ACM_SERIAL_VID=0x1fc9
CONFIG_CDC_ACM_SERIAL_PID=0x1176
CONFIG_CDC_ACM_SERIAL_MANUFACTURER_STRING="NXP"
CONFIG_CDC_ACM_SERIAL_PRODUCT_STRING="MIMXRT1170-EVK (CDC ACM)"
```

## snippets/usb-console/boards/nucleo_f746zg.conf
```kconfig
# Copyright (c) 2026 TiaC Systems
# SPDX-License-Identifier: Apache-2.0

# STMicroelectronics @ STM32F746ZG-NUCLEO (STM32F746ZG)
CONFIG_CDC_ACM_SERIAL_VID=0x0483
CONFIG_CDC_ACM_SERIAL_PID=0x5740
CONFIG_CDC_ACM_SERIAL_MANUFACTURER_STRING="STMicroelectronics"
CONFIG_CDC_ACM_SERIAL_PRODUCT_STRING="STM32F746ZG-NUCLEO (CDC ACM)"
```

## snippets/usb-console/boards/nucleo_f767zi.conf
```kconfig
# Copyright (c) 2024-2025 TiaC Systems
# SPDX-License-Identifier: Apache-2.0

# STMicroelectronics @ STM32F767ZI-NUCLEO (STM32F767ZI)
CONFIG_CDC_ACM_SERIAL_VID=0x0483
CONFIG_CDC_ACM_SERIAL_PID=0x5740
CONFIG_CDC_ACM_SERIAL_MANUFACTURER_STRING="STMicroelectronics"
CONFIG_CDC_ACM_SERIAL_PRODUCT_STRING="STM32F767ZI-NUCLEO (CDC ACM)"
```

## snippets/usb-console/boards/nucleo_l496zg.conf
```kconfig
# Copyright (c) 2026 TiaC Systems
# SPDX-License-Identifier: Apache-2.0

# STMicroelectronics @ STM32L496ZG-NUCLEO (STM32L496ZG)
CONFIG_CDC_ACM_SERIAL_VID=0x0483
CONFIG_CDC_ACM_SERIAL_PID=0x5740
CONFIG_CDC_ACM_SERIAL_MANUFACTURER_STRING="STMicroelectronics"
CONFIG_CDC_ACM_SERIAL_PRODUCT_STRING="STM32L496ZG-NUCLEO (CDC ACM)"
```

## snippets/usb-console/boards/rpi_pico.conf
```kconfig
# Copyright (c) 2023-2025 TiaC Systems
# SPDX-License-Identifier: Apache-2.0

# Raspberry Pi @ Raspberry Pi Pico
CONFIG_CDC_ACM_SERIAL_VID=0x2e8a
CONFIG_CDC_ACM_SERIAL_PID=0x000a
CONFIG_CDC_ACM_SERIAL_MANUFACTURER_STRING="Raspberry Pi"
CONFIG_CDC_ACM_SERIAL_PRODUCT_STRING="RPi Pico (CDC ACM)"
```
