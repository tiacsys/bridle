/*
 * Copyright (c) 2026 Navimatix GmbH
 * SPDX-License-Identifier: Apache-2.0
 */

/ {
	chosen {
		zephyr,canbus = &can0;
	};
};

&can0 {
	status = "okay";
	host-interface = "can0";
};

&can_loopback0 {
	status = "disabled";
};
