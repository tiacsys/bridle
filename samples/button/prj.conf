## CMakeLists.txt
```
# SPDX-FileCopyrightText: 2021-2026 TiaC Systems
# SPDX-License-Identifier: Apache-2.0

cmake_minimum_required(VERSION 3.28.0)

# Standard Bridle application boilerplate, includes Zephyr.
find_package(Bridle REQUIRED HINTS $ENV{BRIDLE_BASE})
project("Fancy Button" VERSION 0.1)

target_sources(app PRIVATE src/init.c)

target_sources_ifdef(CONFIG_APPLICATION_MODE_POLLING app PRIVATE
    src/poll.c
)

target_sources_ifdef(CONFIG_APPLICATION_MODE_INTERRUPT app PRIVATE
    src/event.c
)
```

## Kconfig
```
# SPDX-FileCopyrightText: 2021-2026 TiaC Systems
# SPDX-License-Identifier: Apache-2.0

mainmenu "Button"

choice APPLICATION_MODE
	prompt "Application Mode"

config APPLICATION_MODE_POLLING
	bool "Poll button state"

config APPLICATION_MODE_INTERRUPT
	bool "Use an interrupt and callback"

endchoice

if APPLICATION_MODE_POLLING

config SLEEP_TIME_MS
	int "Polling loop sleep time"
	default 1
	help
	  This defines how long the polling loop waits
	  between subsequent queries of the push button
	  state.

endif # APPLICATION_MODE_POLLING

# Sources Kconfig.zephyr in the Zephyr root directory.
menu "Zephyr Kernel"
source "Kconfig.zephyr"
endmenu
```

## sample.yaml
```
sample:
  description: Button sample, one of the simplest Zephyr application
  name: button
common:
  tags:
    - bridle
    - introduction
  sysbuild: false
  build_only: true
  min_ram: 8
  min_flash: 16
  integration_platforms:
    - coffeecaller_nrf52
    - cytron_maker_nano_rp2040
    - cytron_maker_pi_rp2040
    - mimxrt1010_evk/mimxrt1011
    - mimxrt1010_evk/mimxrt1011/bbe
    - mimxrt1060_evk@A/mimxrt1062/qspi
    - mimxrt1060_evk@B/mimxrt1062/qspi
    - mimxrt1060_evk@C/mimxrt1062/qspi
    - mimxrt1060_evk@C/mimxrt1062/hyperflash
    - mimxrt1170_evk@A/mimxrt1176/cm4
    - mimxrt1170_evk@A/mimxrt1176/cm7
    - mimxrt1170_evk@B/mimxrt1176/cm4
    - mimxrt1170_evk@B/mimxrt1176/cm7
    - nrf52840dk/nrf52840
    - nrf9160dk/nrf9160
    - nucleo_f303re/stm32f303xe
    - nucleo_f303re/stm32f303xe/bbe
    - nucleo_f401re/stm32f401xe
    - nucleo_f401re/stm32f401xe/bbe
    - nucleo_f413zh/stm32f413xx
    - nucleo_f413zh/stm32f413xx/bbe
    - nucleo_f746zg/stm32f746xx
    - nucleo_f746zg/stm32f746xx/bbe
    - nucleo_f767zi/stm32f767xx
    - nucleo_f767zi/stm32f767xx/bbe
    - nucleo_l496zg/stm32l496xx
    - nucleo_l496zg/stm32l496xx/bbe
    - picoboy/rp2040
    - picoboy_color/rp2040
    - picoboy_color_plus/rp2350a/m33
    - weact_bluepillplus_ch32v203c6
    - weact_bluepillplus_ch32v203c8
    - weact_bluepillplus_stm32f103c8
    - weact_bluepillplus_stm32f103cb
tests:
  bridle.sample.button.poll:
    filter: dt_enabled_alias_with_parent_compat("sw0", "gpio-keys") and
            dt_enabled_alias_with_parent_compat("led0", "gpio-leds")
    extra_args:
      - EXTRA_CONF_FILE=prj-poll.conf
  bridle.sample.button.event:
    filter: dt_enabled_alias_with_parent_compat("sw0", "gpio-keys") and
            dt_enabled_alias_with_parent_compat("led0", "gpio-leds")
    extra_args:
      - EXTRA_CONF_FILE=prj-event.conf
```

## prj.conf
```kconfig
# SPDX-FileCopyrightText: 2021-2026 TiaC Systems
# SPDX-License-Identifier: Apache-2.0

# zephyr-keep-sorted-start
CONFIG_GPIO=y
# zephyr-keep-sorted-stop
```

## prj-event.conf
```kconfig
# SPDX-FileCopyrightText: 2021-2026 TiaC Systems
# SPDX-License-Identifier: Apache-2.0

# zephyr-keep-sorted-start
CONFIG_APPLICATION_MODE_INTERRUPT=y
CONFIG_GPIO=y
# zephyr-keep-sorted-stop
```

## prj-poll.conf
```kconfig
# SPDX-FileCopyrightText: 2021-2026 TiaC Systems
# SPDX-License-Identifier: Apache-2.0

# zephyr-keep-sorted-start
CONFIG_APPLICATION_MODE_POLLING=y
CONFIG_GPIO=y
# zephyr-keep-sorted-stop
```

## boards/cytron_maker_nano_rp2040.overlay
```dts
/*
 * Copyright (c) 2025 TiaC Systems
 * SPDX-License-Identifier: Apache-2.0
 */

#include "dis_pwm_leds.dtsi"
#include "ena_gpio_leds.dtsi"
```

## boards/dis_pwm_leds.dtsi
```dts
/*
 * SPDX-FileCopyrightText: 2025-2026 TiaC Systems
 * SPDX-License-Identifier: Apache-2.0
 */

&pwm_leds {
	status = "disabled";
};
```

## boards/ena_gpio_leds.dtsi
```dts
/*
 * Copyright (c) 2025 TiaC Systems
 * SPDX-License-Identifier: Apache-2.0
 */

&gpio_leds {
	status = "okay";
};
```

## boards/picoboy_color_plus_rp2350a_m33_0.overlay
```dts
/*
 * SPDX-FileCopyrightText: 2025-2026 TiaC Systems
 * SPDX-License-Identifier: Apache-2.0
 */

#include "dis_pwm_leds.dtsi"
#include "ena_gpio_leds.dtsi"
```

## src/event.c
```c
/*
 * SPDX-FileCopyrightText: 2021-2026 TiaC Systems
 * SPDX-License-Identifier: Apache-2.0
 */

#include <zephyr/device.h>
#include "init.h"

/* Interrupt handler  */
static void button_pressed(const struct device *dev, struct gpio_callback *cb, uint32_t pins)
{
	/* Only trigger on the correct pin */
	if (pins & BIT(btn.pin)) {
		int val = gpio_pin_get(dev, btn.pin);

		gpio_pin_set_dt(&led, val);
	}
}


/* Init function which creates the interrupt callback  */
static int init(void)
{
	static struct gpio_callback button_cb_data;
	int ret;

	/* Configure btn to trigger interrupts on both press and release */
	ret = gpio_pin_interrupt_configure_dt(&btn, GPIO_INT_EDGE_BOTH);
	if (ret != 0) {
		printk("Error %d: failed to configure interrupt on %s pin %d\n", ret,
		       btn.port->name, btn.pin);
		return ret;
	}

	/* Create and fill the callback struct. Register the callback. */
	gpio_init_callback(&button_cb_data, button_pressed, BIT(btn.pin));
	ret = gpio_add_callback(btn.port, &button_cb_data);
	if (ret != 0) {
		printk("Error %d: failed to register callback on %s pin %d\n", ret, btn.port->name,
		       btn.pin);
		return ret;
	}

	printk("Set up event handler at %s pin %d\n", btn.port->name, btn.pin);
	printk("Press the button\n");
	return 0;
}

/* Register our init function */
SYS_INIT(init, APPLICATION, APPLICATION_CB_INIT_PRIORITY);
```

## src/init.c
```c
/*
 * SPDX-FileCopyrightText: 2021-2026 TiaC Systems
 * SPDX-License-Identifier: Apache-2.0
 */

#include "init.h"

/* Setup for a button  */
#define BTN_NODE DT_ALIAS(sw0)
#if !DT_NODE_HAS_STATUS(BTN_NODE, okay)
#error "Unsupported board: sw0 devicetree alias is not defined"
#endif

const struct gpio_dt_spec btn = GPIO_DT_SPEC_GET(BTN_NODE, gpios);

/* Setup for an led */
#define LED_NODE DT_ALIAS(led0)
#if !DT_NODE_HAS_STATUS(LED_NODE, okay)
#error "Unsupported board: led0 devicetree alias is not defined"
#endif

const struct gpio_dt_spec led = GPIO_DT_SPEC_GET(LED_NODE, gpios);

/* Init function for configuring button and led gpio pins */
static int init(void)
{
	int ret;

	if (!gpio_is_ready_dt(&btn)) {
		printk("Error: button device %s is not ready\n", btn.port->name);
		return -ENODEV;
	}

	ret = gpio_pin_configure_dt(&btn, GPIO_INPUT);
	if (ret != 0) {
		printk("Error %d: failed to configure %s pin %d\n", ret, btn.port->name, btn.pin);
		return ret;
	}

	if (!gpio_is_ready_dt(&led)) {
		printk("Error: LED device %s is not ready\n", led.port->name);
		return -ENODEV;
	}

	ret = gpio_pin_configure_dt(&led, GPIO_OUTPUT);
	if (ret != 0) {
		printk("Error %d: failed to configure %s pin %d\n", ret, led.port->name, led.pin);
		return ret;
	}

	printk("Set up button at %s pin %d\n", btn.port->name, btn.pin);
	printk("Set up LED at %s pin %d\n", led.port->name, led.pin);
	return 0;
}

/* Register our init function  */
SYS_INIT(init, APPLICATION, APPLICATION_IO_INIT_PRIORITY);

/* Empty main */
int main(void) { return 0; }
```

## src/init.h
```c
/*
 * SPDX-FileCopyrightText: 2021-2026 TiaC Systems
 * SPDX-License-Identifier: Apache-2.0
 */

#include <zephyr/kernel.h>
#include <zephyr/drivers/gpio.h>

extern const struct gpio_dt_spec btn;
extern const struct gpio_dt_spec led;
extern const struct gpio_dt_spec led2;

#define APPLICATION_IO_INIT_PRIORITY 96
#define APPLICATION_CB_INIT_PRIORITY 97
```

## src/poll.c
```c
/*
 * SPDX-FileCopyrightText: 2021-2026 TiaC Systems
 * SPDX-License-Identifier: Apache-2.0
 */

#include <zephyr/device.h>
#include "init.h"

/* Setup for creating the polling thread */
#define MY_STACK_SIZE 512
#define MY_PRIORITY 5

K_THREAD_STACK_DEFINE(polling_thread_stack_area, MY_STACK_SIZE);

/* Entry point function for the polling thread  */
static void polling_thread_entry_point(void *btn_void, void *led_void, void *)
{
	/* Unwrap the argument pointers */
	struct gpio_dt_spec *btn = (struct gpio_dt_spec *) btn_void;
	struct gpio_dt_spec *led = (struct gpio_dt_spec *) led_void;

	/* Infinite polling loop */
	while (1) {
		int val = gpio_pin_get_dt(btn);

		gpio_pin_set_dt(led, val);

		/* Sleep the thread for a little while */
		k_msleep(CONFIG_SLEEP_TIME_MS);
	}
}

/* Init function which spawns a dedicated polling thread  */
static int init(void)
{
	static struct k_thread polling_thread;

	__unused k_tid_t tid = k_thread_create(&polling_thread,
					polling_thread_stack_area,
					K_THREAD_STACK_SIZEOF(polling_thread_stack_area),
					polling_thread_entry_point,
					(void *) &btn, (void *) &led, NULL,
					MY_PRIORITY, 0, K_NO_WAIT);

	printk("Press the button\n");
	return 0;
}

/* Register our init function */
SYS_INIT(init, APPLICATION, APPLICATION_CB_INIT_PRIORITY);
```
