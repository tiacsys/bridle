## CMakeLists.txt
```
# SPDX-FileCopyrightText: 2023-2026 TiaC Systems
# SPDX-License-Identifier: Apache-2.0

cmake_minimum_required(VERSION 3.28.0)

# Standard Bridle application boilerplate, includes Zephyr.
find_package(Bridle REQUIRED HINTS $ENV{BRIDLE_BASE})
project("Buzzer Shell" VERSION 0.1)

assert(CONFIG_SHELL "Zephyr's embedded shell must be enabled")

# Add your source file to the "app" target. This must come after
# the boilerplate code, which defines the target.
target_sources(app PRIVATE
    src/main.c
    src/shell.c
    src/buzzer.c
    src/song_beep.c
    src/song_folksong.c
    src/song_xmastime.c
    src/song_funkytown.c
    src/song_mario.c
    src/song_golioth.c
    src/song_tiacsys.c
)

target_include_directories(app PRIVATE
    src
)
```

## Kconfig
```
# SPDX-FileCopyrightText: 2023-2026 TiaC Systems
# SPDX-License-Identifier: Apache-2.0

menu "Buzzer shell sample settings"

module = BUZZER_SHELL
module-str = "buzzersh"
source "subsys/logging/Kconfig.template.log_config"

endmenu

# Sources Kconfig.zephyr in the Zephyr root directory.
menu "Zephyr Kernel"
source "Kconfig.zephyr"
endmenu
```

## sample.yaml
```
sample:
  description: Buzzer using PWM
  name: buzzer
common:
  tags:
    - bridle
    - drivers
    - pwm
  sysbuild: false
  platform_allow:
    - cytron_maker_nano_rp2040
    - cytron_maker_pi_rp2040
    - picoboy/rp2040
    - picoboy_color/rp2040
  integration_platforms:
    - cytron_maker_nano_rp2040
    - cytron_maker_pi_rp2040
    - picoboy/rp2040
    - picoboy_color/rp2040
tests:
  bridle.sample.buzzer:
    depends_on: pwm
    harness: buzzer
    filter: dt_enabled_alias_with_parent_compat("pwm-buzzer0", "pwm-buzzers")
```

## prj.conf
```kconfig
# SPDX-FileCopyrightText: 2023-2026 TiaC Systems
# SPDX-License-Identifier: Apache-2.0

# Multi-threaded, with timer support in the kernel
# zephyr-keep-sorted-start
CONFIG_ERRNO=y

CONFIG_MULTITHREADING=y
CONFIG_NUM_COOP_PRIORITIES=16
CONFIG_NUM_METAIRQ_PRIORITIES=0

CONFIG_SCHED_SIMPLE=y
CONFIG_WAITQ_SIMPLE=y
# zephyr-keep-sorted-stop

# shell with log and getopt
# zephyr-keep-sorted-start
CONFIG_BOOT_BANNER=y
CONFIG_LOG=y
CONFIG_LOG_CMDS=y
CONFIG_PRINTK=y
CONFIG_SHELL=y
CONFIG_SHELL_GETOPT=y
# zephyr-keep-sorted-stop

# shell with pwm and gpio
# zephyr-keep-sorted-start
CONFIG_GPIO=y
CONFIG_GPIO_SHELL=y
CONFIG_PWM=y
CONFIG_PWM_SHELL=y
# zephyr-keep-sorted-stop
```

## boards/rpi_pico2_rp2350a_m33_0_w.conf
```kconfig
# SPDX-FileCopyrightText: 2026 TiaC Systems
# SPDX-License-Identifier: Apache-2.0

# This prevents link errors, as the driver for the GPIO unit
# behind the Airock WiFi cannot be compiled unless the WiFi/L2
# network stack is enabled.

# zephyr-keep-sorted-start
CONFIG_GPIO_SHELL=n
# zephyr-keep-sorted-stop
```

## boards/rpi_pico2_rp2350a_m33_0_w_bbe.conf
```kconfig
# SPDX-FileCopyrightText: Copyright (c) 2026 TiaC Systems
# SPDX-License-Identifier: Apache-2.0

# This prevents link errors, as the driver for the GPIO unit
# behind the Airock WiFi cannot be compiled unless the WiFi/L2
# network stack is enabled.

# zephyr-keep-sorted-start
CONFIG_GPIO_SHELL=n
# zephyr-keep-sorted-stop
```

## boards/rpi_pico2_rp2350a_m33_w.conf
```kconfig
# Copyright (c) 2026 TiaC Systems
# SPDX-License-Identifier: Apache-2.0

# This prevents link errors, as the driver for the GPIO unit
# behind the Airock WiFi cannot be compiled unless the WiFi/L2
# network stack is enabled.

# zephyr-keep-sorted-start
CONFIG_GPIO_SHELL=n
# zephyr-keep-sorted-stop
```

## src/main.c
```c
/*
 * SPDX-FileCopyrightText: 2023-2026 TiaC Systems
 * SPDX-FileCopyrightText: 2022 Golioth, Inc.
 * SPDX-License-Identifier: Apache-2.0
 */

#include "buzzer.h"

#include <zephyr/kernel.h>
#include <zephyr/init.h>

/* Logging */
#include <zephyr/logging/log.h>
LOG_MODULE_REGISTER(buzzersh, CONFIG_BUZZER_SHELL_LOG_LEVEL);

/* Setup for a buzzer  */
#define PWM_BUZZER_NODE DT_ALIAS(buzzer0)
#if !DT_NODE_HAS_STATUS(PWM_BUZZER_NODE, okay)
#error "Unsupported board: pwm-buzzer0 devicetree alias is not defined"
#endif

/* Buzzer instance structs */
static struct buzzer_instance buzzer = {
	.dt_spec = PWM_DT_SPEC_GET(PWM_BUZZER_NODE),
	.song = beep /* on startup */
};

int main(void)
{
	int err;

	err = app_buzzer_init(&buzzer);
	if (err) {
		LOG_ERR("Unable to configure buzzer");
	}

	LOG_INF("Buzzer shell is ready!");
	return 0;
}
```

## src/buzzer.c
```c
/*
 * SPDX-FileCopyrightText: 2023-2026 TiaC Systems
 * SPDX-FileCopyrightText: 2022 Golioth, Inc.
 * SPDX-License-Identifier: Apache-2.0
 */

#include "buzzer.h"

#include <zephyr/kernel.h>
#include <zephyr/init.h>

/* Logging */
#include <zephyr/logging/log.h>
LOG_MODULE_DECLARE(buzzersh, CONFIG_BUZZER_SHELL_LOG_LEVEL);

/* Buzzer thread structs */
static k_tid_t buzzer_tid;
static struct k_thread buzzer_thread;
static struct buzzer_instance *buzzer_instance;
K_THREAD_STACK_DEFINE(buzzer_stack, 1024);
K_SEM_DEFINE(buzzer_initialized_sem, 0, 1); /* wait until buzzer is ready */

#define BUZZER_MAX_FREQ 2500
#define BUZZER_MIN_FREQ 10

/* extern */ void buzzer_entry(void *p0, void *p1, void *p2)
{
	buzzer_instance = (struct buzzer_instance *)(p0);

	/* block until buzzer is available */
	k_sem_take(&buzzer_initialized_sem, K_FOREVER);

	while (1) {
		const struct pwm_dt_spec *pwm = &(buzzer_instance->dt_spec);
		const note_t *replay; /* the song with ... */
		size_t notes;         /* ... number of notes in replay */

		switch (buzzer_instance->song) {
		case beep:
			LOG_DBG("beep");
			replay = song_beep;
			notes = song_beep_notes;
			break;

		case folksong:
			LOG_DBG("folksong");
			replay = song_folksong;
			notes = song_folksong_notes;
			break;

		case xmastime:
			LOG_DBG("xmastime");
			replay = song_xmastime;
			notes = song_xmastime_notes;
			break;

		case funkytown:
			LOG_DBG("funkytown");
			replay = song_funkytown;
			notes = song_funkytown_notes;
			break;

		case mario:
			LOG_DBG("mario");
			replay = song_mario;
			notes = song_mario_notes;
			break;

		case golioth:
			LOG_DBG("golioth");
			replay = song_golioth;
			notes = song_golioth_notes;
			break;

		case tiacsys:
			LOG_DBG("tiacsys");
			replay = song_tiacsys;
			notes = song_tiacsys_notes;
			break;

		default:
			LOG_WRN("Warning: invalid song selection");
			replay = NULL;
			notes = 0;
			break;
		}

		/* if song, then ... */
		if (replay && notes) {

			/* ... replay the song */
			for (int i = 0; i < notes; i++) {

				note_pitch_t pitch = replay[i].pitch;
				note_duration_t duration = replay[i].duration;

				if (pitch < BUZZER_MIN_FREQ) {
					/* 'pause' on frequency notes */
					pwm_set_pulse_dt(pwm, 0);
					k_msleep(duration);
				} else {
					pwm_set_dt(pwm, PWM_HZ(pitch), PWM_HZ(pitch) / 2);
					k_msleep(duration);
				}
			}
		}

		/* turn buzzer off (pulse duty to 0) */
		pwm_set_pulse_dt(pwm, 0);

		/* sleep thread again until awoken externally */
		k_sleep(K_FOREVER);
	}
}

int app_buzzer_init(struct buzzer_instance *buzzer)
{
	if (!device_is_ready(buzzer->dt_spec.dev)) {
		return -ENODEV;
	}

	buzzer_tid = k_thread_create(&buzzer_thread, buzzer_stack,
				     K_THREAD_STACK_SIZEOF(buzzer_stack), buzzer_entry, buzzer,
				     NULL, NULL, K_LOWEST_APPLICATION_THREAD_PRIO, 0, K_SECONDS(2));
	k_sem_give(&buzzer_initialized_sem);
	return 0;
}

void app_buzzer_play_song(enum song_choice song)
{
	if (buzzer_instance) {
		buzzer_instance->song = song;
	}
	k_wakeup(buzzer_tid);
}
```

## src/buzzer.h
```c
/*
 * SPDX-FileCopyrightText: 2023-2026 TiaC Systems
 * SPDX-FileCopyrightText: 2022 Golioth, Inc.
 * SPDX-License-Identifier: Apache-2.0
 */

#ifndef __BUZZER_H__
#define __BUZZER_H__

#include "songs.h"

#include <zephyr/devicetree.h>
#include <zephyr/drivers/pwm.h>

struct buzzer_instance {
	const struct pwm_dt_spec dt_spec;
	enum song_choice song;
};

int app_buzzer_init(struct buzzer_instance *buzzer);
void app_buzzer_play_song(enum song_choice song);

#endif /* __BUZZER_H__ */
```

## src/notes.h
```c
/*
 * SPDX-FileCopyrightText: 2023-2026 TiaC Systems
 * SPDX-License-Identifier: Apache-2.0
 */

#ifndef __NOTES_H__
#define __NOTES_H__

/* pitches in Hz */
typedef enum {
	A0 = 28,  /* 27.5000 Hz (A'') */
	As0 = 29, /* 29.1352 Hz (Ais''/B'') */
	Bb0 = As0,
	B0 = 31, /* 30.8677 Hz (H'') */
	H0 = B0,

	C1 = 33,  /* 32.7032 Hz (C') */
	Cs1 = 35, /* 34.6478 Hz (Cis'/Des') */
	Db1 = Cs1,
	D1 = 37,  /* 36.7081 Hz (D') */
	Ds1 = 39, /* 38.8909 Hz (Dis'/Es') */
	Eb1 = Ds1,
	E1 = 41,  /* 41.2034 Hz (E') */
	F1 = 44,  /* 43.6535 Hz (F') */
	Fs1 = 46, /* 46.2493 Hz (Fis'/Ges') */
	Gb1 = Fs1,
	G1 = 49,  /* 48.9994 Hz (G') */
	Gs1 = 52, /* 51.9131 Hz (Gis'/As') */
	Ab1 = Gs1,
	A1 = 55,  /* 55.0000 Hz (A') */
	As1 = 58, /* 58.2705 Hz (Ais'/B') */
	Bb1 = As1,
	B1 = 62, /* 61.7354 Hz (H') */
	H1 = B1,

	C2 = 65,  /* 65.4064 Hz (C) */
	Cs2 = 69, /* 69.2957 Hz (Cis/Des) */
	Db2 = Cs2,
	D2 = 73,  /* 73.4162 Hz (D) */
	Ds2 = 78, /* 77.7817 Hz (Dis/Es) */
	Eb2 = Ds2,
	E2 = 82,  /* 82.4069 Hz (E) */
	F2 = 87,  /* 87.3071 Hz (F) */
	Fs2 = 93, /* 92.4986 Hz (Fis/Ges) */
	Gb2 = Fs2,
	G2 = 98,   /* 97.9989 Hz (G) */
	Gs2 = 104, /* 103.826 Hz (Gis/As) */
	Ab2 = Gs2,
	A2 = 110,  /* 110.000 Hz (A) */
	As2 = 117, /* 116.541 Hz (Ais/B) */
	Bb2 = As2,
	B2 = 124, /* 123.471 Hz (H) */
	H2 = B2,

	C3 = 131,  /* 130.813 Hz (c) */
	Cs3 = 139, /* 138.591 Hz (cis/des) */
	Db3 = Cs3,
	D3 = 147,  /* 146.832 Hz (d) */
	Ds3 = 156, /* 155.563 Hz (dis/es) */
	Eb3 = Ds3,
	E3 = 165,  /* 164.814 Hz (e) */
	F3 = 175,  /* 174.614 Hz (f) */
	Fs3 = 185, /* 184.997 Hz (fis/ges) */
	Gb3 = Fs3,
	G3 = 196,  /* 195.998 Hz (g) */
	Gs3 = 208, /* 207.652 Hz (gis/as) */
	Ab3 = Gs3,
	A3 = 220,  /* 220.000 Hz (a) */
	As3 = 233, /* 233.082 Hz (ais/b) */
	Bb3 = As3,
	B3 = 247, /* 246.942 Hz (h) */
	H3 = B3,

	C4 = 262,  /* 261.626 Hz (c') */
	Cs4 = 277, /* 277.183 Hz (cis'/des') */
	Db4 = Cs4,
	D4 = 294,  /* 293.665 Hz (d') */
	Ds4 = 311, /* 311.127 Hz (dis'/es') */
	Eb4 = Ds4,
	E4 = 330,  /* 329.628 Hz (e') */
	F4 = 349,  /* 349.228 Hz (f') */
	Fs4 = 370, /* 369.994 Hz (fis'/ges') */
	Gb4 = Fs4,
	G4 = 392,  /* 391.995 Hz (g') */
	Gs4 = 415, /* 415.305 Hz (gis'/as') */
	Ab4 = Gs4,
	A4 = 440,  /* 440.000 Hz (a') - concert pitch */
	As4 = 466, /* 466.164 Hz (ais'/b') */
	Bb4 = As4,
	B4 = 494, /* 493.883 Hz (h') */
	H4 = B4,

	C5 = 523,  /* 523.251 Hz (c'') */
	Cs5 = 554, /* 554.365 Hz (cis''/des'') */
	Db5 = Cs5,
	D5 = 587,  /* 587.330 Hz (d'') */
	Ds5 = 622, /* 622.254 Hz (dis''/es'') */
	Eb5 = Ds5,
	E5 = 659,  /* 659.255 Hz (e'') */
	F5 = 699,  /* 698.456 Hz (f'') */
	Fs5 = 740, /* 739.989 Hz (fis''/ges'') */
	Gb5 = Fs5,
	G5 = 784,  /* 783.991 Hz (g'') */
	Gs5 = 831, /* 830.609 Hz (gis''/as'') */
	Ab5 = Gs5,
	A5 = 880,  /* 880.000 Hz (a'') */
	As5 = 932, /* 932.328 Hz (ais''/b'') */
	Bb5 = As5,
	B5 = 988, /* 987.767 Hz (h'') */
	H5 = B5,

	C6 = 1046,  /* 1046.50 Hz (c''') */
	Cs6 = 1109, /* 1108.73 Hz (cis'''/des''') */
	Db6 = Cs6,
	D6 = 1175,  /* 1174.66 Hz (d''') */
	Ds6 = 1245, /* 1244.51 Hz (dis'''/es''') */
	Eb6 = Ds6,
	E6 = 1319,  /* 1318.51 Hz (e''') */
	F6 = 1397,  /* 1396.91 Hz (f''') */
	Fs6 = 1480, /* 1479.98 Hz (fis'''/ges''') */
	Gb6 = Fs6,
	G6 = 1568,  /* 1567.98 Hz (g''') */
	Gs6 = 1661, /* 1661.22 Hz (gis'''/as''') */
	Ab6 = Gs6,
	A6 = 1760,  /* 1760.00 Hz (a''') */
	As6 = 1865, /* 1864.66 Hz (ais'''/b''') */
	Bb6 = As6,
	B6 = 1976, /* 1975.53 Hz (h''') */
	H6 = B6,

	C7 = 2093,  /* 2093,00 Hz (c'''') */
	Cs7 = 2218, /* 2217,46 Hz (cis''''/des'''') */
	Db7 = Cs7,
	D7 = 2349,  /* 2349,32 Hz (d'''') */
	Ds7 = 2489, /* 2489,02 Hz (dis''''/es'''') */
	Eb7 = Ds7,
	E7 = 2637,  /* 2637,02 Hz (e'''') */
	F7 = 2794,  /* 2793,83 Hz (f'''') */
	Fs7 = 2960, /* 2959,96 Hz (fis''''/ges'''') */
	Gb7 = Fs7,
	G7 = 3136,  /* 3135,96 Hz (g'''') */
	Gs7 = 3322, /* 3322,44 Hz (gis''''/as'''') */
	Ab7 = Gs7,
	A7 = 3520,  /* 3520,00 Hz (a'''') */
	As7 = 3729, /* 3729,31 Hz (ais''''/b'''') */
	Bb7 = As7,
	B7 = 3951, /* 3951,07 Hz (h'''') */
	H7 = B7,

	C8 = 4186, /* 4186,01 Hz (c''''') */

	REST = 1,
} note_pitch_t;

/* duration in msec */
typedef enum {
	sixtyfourth = 9,
	thirtytwoth = 19,
	sixteenth = 38,
	ninth = 50, /* unusually */
	eighth = 75,
	sixth = 100, /* unusually */
	quarter = 150,
	third = 200, /* unusually */
	half = 300,
	whole = 600,
} note_duration_t;

typedef struct {
	note_pitch_t pitch;       /* Hz */
	note_duration_t duration; /* msec */
} note_t;

#endif /* __NOTES_H__ */
```

## src/shell.c
```c
/*
 * SPDX-FileCopyrightText: 2023-2026 TiaC Systems
 * SPDX-License-Identifier: Apache-2.0
 */

#include "buzzer.h"

#include <zephyr/shell/shell.h>

/* Logging */
#include <zephyr/logging/log.h>
LOG_MODULE_DECLARE(buzzersh, CONFIG_BUZZER_SHELL_LOG_LEVEL);

#include <stdlib.h>

static int cmd_buzzer_info(const struct shell *sh, size_t argc, char **argv, void *data)
{
	shell_print(sh, "Warning: not yet implemented.");
	return 0;
}

static int cmd_buzzer_beep(const struct shell *sh, size_t argc, char **argv, void *data)
{
	app_buzzer_play_song(beep);
	LOG_DBG("song played: beep");
	return 0;
}

static int cmd_buzzer_folksong(const struct shell *sh, size_t argc, char **argv, void *data)
{
	app_buzzer_play_song(folksong);
	LOG_DBG("song played: folksong");
	return 0;
}

static int cmd_buzzer_xmastime(const struct shell *sh, size_t argc, char **argv, void *data)
{
	app_buzzer_play_song(xmastime);
	LOG_DBG("song played: xmastime");
	return 0;
}

static int cmd_buzzer_funkytown(const struct shell *sh, size_t argc, char **argv, void *data)
{
	app_buzzer_play_song(funkytown);
	LOG_DBG("song played: funkytown");
	return 0;
}

static int cmd_buzzer_mario(const struct shell *sh, size_t argc, char **argv, void *data)
{
	app_buzzer_play_song(mario);
	LOG_DBG("song played: mario");
	return 0;
}

static int cmd_buzzer_golioth(const struct shell *sh, size_t argc, char **argv, void *data)
{
	app_buzzer_play_song(golioth);
	LOG_DBG("song played: golioth");
	return 0;
}

static int cmd_buzzer_tiacsys(const struct shell *sh, size_t argc, char **argv, void *data)
{
	app_buzzer_play_song(tiacsys);
	LOG_DBG("song played: tiacsys");
	return 0;
}

SHELL_STATIC_SUBCMD_SET_CREATE(
	buzzer_play_sub, SHELL_CMD(folksong, NULL, "Play the 'folksong' song", cmd_buzzer_folksong),
	SHELL_CMD(xmastime, NULL, "Play the 'xmastime' song", cmd_buzzer_xmastime),
	SHELL_CMD(funkytown, NULL, "Play the 'funkytown' song", cmd_buzzer_funkytown),
	SHELL_CMD(mario, NULL, "Play the 'mario' song", cmd_buzzer_mario),
	SHELL_CMD(golioth, NULL, "Play the 'golioth' song", cmd_buzzer_golioth),
	SHELL_CMD(tiacsys, NULL, "Play the 'tiacsys' song", cmd_buzzer_tiacsys),
	SHELL_SUBCMD_SET_END);

SHELL_STATIC_SUBCMD_SET_CREATE(buzzer_sub,
			       SHELL_CMD(info, NULL, "Get buzzer info", cmd_buzzer_info),
			       SHELL_CMD(beep, NULL, "Use buzzer to beep", cmd_buzzer_beep),
			       SHELL_CMD(play, &buzzer_play_sub, "Play one of predefined sounds",
					 NULL),
			       SHELL_SUBCMD_SET_END);

SHELL_CMD_REGISTER(buzzer, &buzzer_sub, "Buzzer related commands", NULL);
```

## src/song_beep.c
```c
/*
 * SPDX-FileCopyrightText: 2023-2026 TiaC Systems
 * SPDX-License-Identifier: Apache-2.0
 */

#include "songs.h"

const note_t song_beep[] = {
	{.pitch = Db6, .duration = eighth},
};
const size_t song_beep_notes = ARRAY_SIZE(song_beep);
```

## src/song_folksong.c
```c
/*
 * SPDX-FileCopyrightText: 2023-2026 TiaC Systems
 * SPDX-License-Identifier: Apache-2.0
 */

#include "songs.h"

const note_t song_folksong[] = {
	/* 2/4 */
	{.pitch = C5, .duration = quarter},
	{.pitch = D5, .duration = eighth},
	{.pitch = REST, .duration = eighth},
	{.pitch = E5, .duration = quarter},
	{.pitch = F5, .duration = eighth},
	{.pitch = REST, .duration = eighth},
	/* bar */
	{.pitch = G5, .duration = quarter},
	{.pitch = A5, .duration = eighth},
	{.pitch = REST, .duration = eighth},
	{.pitch = G5, .duration = half},
	/* bar */
	{.pitch = F5, .duration = quarter},
	{.pitch = D5, .duration = eighth},
	{.pitch = REST, .duration = eighth},
	{.pitch = H5, .duration = half},
	/* bar */
	{.pitch = G5, .duration = quarter},
	{.pitch = E5, .duration = eighth},
	{.pitch = REST, .duration = eighth},
	{.pitch = C6, .duration = half},
	/* bar */
	{.pitch = C5, .duration = quarter},
	{.pitch = D5, .duration = eighth},
	{.pitch = REST, .duration = eighth},
	{.pitch = E5, .duration = quarter},
	{.pitch = F5, .duration = eighth},
	{.pitch = REST, .duration = eighth},
	/* bar */
	{.pitch = G5, .duration = quarter},
	{.pitch = A5, .duration = eighth},
	{.pitch = REST, .duration = eighth},
	{.pitch = G5, .duration = half},
	/* bar */
	{.pitch = F5, .duration = quarter},
	{.pitch = D5, .duration = eighth},
	{.pitch = REST, .duration = eighth},
	{.pitch = H5, .duration = quarter},
	{.pitch = D6, .duration = eighth},
	{.pitch = REST, .duration = eighth},
	/* bar */
	{.pitch = C6, .duration = half},
	{.pitch = REST, .duration = half},
	/* bar */
	{.pitch = A5, .duration = quarter},
	{.pitch = F5, .duration = eighth},
	{.pitch = REST, .duration = eighth},
	{.pitch = C6, .duration = quarter},
	{.pitch = H5, .duration = eighth},
	{.pitch = A5, .duration = sixteenth},
	{.pitch = REST, .duration = sixteenth},
	/* bar */
	{.pitch = G5, .duration = quarter},
	{.pitch = E5, .duration = eighth},
	{.pitch = REST, .duration = eighth},
	{.pitch = G5, .duration = half},
	/* bar */
	{.pitch = F5, .duration = quarter},
	{.pitch = D5, .duration = eighth},
	{.pitch = REST, .duration = eighth},
	{.pitch = H5, .duration = half},
	/* bar */
	{.pitch = G5, .duration = quarter},
	{.pitch = E5, .duration = eighth},
	{.pitch = REST, .duration = eighth},
	{.pitch = C6, .duration = half},
	/* bar */
	{.pitch = A5, .duration = quarter},
	{.pitch = F5, .duration = eighth},
	{.pitch = REST, .duration = eighth},
	{.pitch = C6, .duration = quarter},
	{.pitch = H5, .duration = eighth},
	{.pitch = A5, .duration = sixteenth},
	{.pitch = REST, .duration = sixteenth},
	/* bar */
	{.pitch = G5, .duration = quarter},
	{.pitch = E5, .duration = eighth},
	{.pitch = REST, .duration = eighth},
	{.pitch = G5, .duration = half},
	/* bar */
	{.pitch = F5, .duration = quarter},
	{.pitch = D5, .duration = eighth},
	{.pitch = REST, .duration = eighth},
	{.pitch = H5, .duration = quarter},
	{.pitch = D6, .duration = eighth},
	{.pitch = REST, .duration = eighth},
	/* bar */
	{.pitch = C6, .duration = half},
};
const size_t song_folksong_notes = ARRAY_SIZE(song_folksong);
```

## src/song_funkytown.c
```c
/*
 * SPDX-FileCopyrightText: 2023-2026 TiaC Systems
 * SPDX-License-Identifier: Apache-2.0
 */

#include "songs.h"

const note_t song_funkytown[] = {
	{.pitch = C5, .duration = quarter}, {.pitch = REST, .duration = eighth},
	{.pitch = C5, .duration = quarter}, {.pitch = Bb4, .duration = quarter},
	{.pitch = C5, .duration = quarter}, {.pitch = REST, .duration = quarter},
	{.pitch = G4, .duration = quarter}, {.pitch = REST, .duration = quarter},
	{.pitch = G4, .duration = quarter}, {.pitch = C5, .duration = quarter},
	{.pitch = F5, .duration = quarter}, {.pitch = E5, .duration = quarter},
	{.pitch = C5, .duration = quarter},
};
const size_t song_funkytown_notes = ARRAY_SIZE(song_funkytown);
```

## src/song_golioth.c
```c
/*
 * SPDX-FileCopyrightText: 2023-2026 TiaC Systems
 * SPDX-License-Identifier: Apache-2.0
 */

#include "songs.h"

const note_t song_golioth[] = {
	{.pitch = C6, .duration = quarter},   {.pitch = REST, .duration = sixth},
	{.pitch = G5, .duration = sixth},     {.pitch = A5, .duration = sixth},
	{.pitch = Bb5, .duration = sixth},    {.pitch = REST, .duration = sixth},
	{.pitch = Bb5, .duration = sixth},    {.pitch = REST, .duration = quarter},
	{.pitch = C5, .duration = half},      {.pitch = REST, .duration = half},
	{.pitch = REST, .duration = quarter}, {.pitch = C6, .duration = quarter}};
const size_t song_golioth_notes = ARRAY_SIZE(song_golioth);
```

## src/song_mario.c
```c
/*
 * SPDX-FileCopyrightText: 2023-2026 TiaC Systems
 * SPDX-License-Identifier: Apache-2.0
 */

#include "songs.h"

const note_t song_mario[] = {
	{.pitch = E6, .duration = quarter},
	{.pitch = REST, .duration = eighth},
	{.pitch = E6, .duration = quarter},
	{.pitch = REST, .duration = quarter},
	{.pitch = E6, .duration = quarter},
	{.pitch = REST, .duration = quarter},
	{.pitch = C6, .duration = quarter},
	{.pitch = E6, .duration = half},
	{.pitch = G6, .duration = half},
	{.pitch = REST, .duration = quarter},
	{.pitch = G4, .duration = whole},
	{.pitch = REST, .duration = whole},
	/* break in sound */
	{.pitch = C6, .duration = half},
	{.pitch = REST, .duration = quarter},
	{.pitch = G5, .duration = half},
	{.pitch = REST, .duration = quarter},
	{.pitch = E5, .duration = half},
	{.pitch = REST, .duration = quarter},
	{.pitch = A5, .duration = quarter},
	{.pitch = REST, .duration = quarter},
	{.pitch = B5, .duration = quarter},
	{.pitch = REST, .duration = quarter},
	{.pitch = Bb5, .duration = quarter},
	{.pitch = A5, .duration = half},
	{.pitch = G5, .duration = quarter},
	{.pitch = E6, .duration = quarter},
	{.pitch = G6, .duration = quarter},
	{.pitch = A6, .duration = half},
	{.pitch = F6, .duration = quarter},
	{.pitch = G6, .duration = quarter},
	{.pitch = REST, .duration = quarter},
	{.pitch = E6, .duration = quarter},
	{.pitch = REST, .duration = quarter},
	{.pitch = C6, .duration = quarter},
	{.pitch = D6, .duration = quarter},
	{.pitch = B5, .duration = quarter},
};
const size_t song_mario_notes = ARRAY_SIZE(song_mario);
```

## src/song_tiacsys.c
```c
/*
 * SPDX-FileCopyrightText: 2023-2026 TiaC Systems
 * SPDX-License-Identifier: Apache-2.0
 */

#include "songs.h"

const note_t song_tiacsys[] = {
	/* intro */
	{.pitch = B5, .duration = eighth},
	{.pitch = REST, .duration = eighth},
	{.pitch = B5, .duration = eighth},
	{.pitch = REST, .duration = eighth},
	{.pitch = Cs6, .duration = eighth},
	{.pitch = REST, .duration = eighth},
	{.pitch = Cs6, .duration = eighth},
	{.pitch = REST, .duration = eighth},
	{.pitch = Cs6, .duration = eighth},
	{.pitch = REST, .duration = quarter},
	{.pitch = B5, .duration = eighth},
	{.pitch = REST, .duration = eighth},
	{.pitch = B5, .duration = eighth},
	{.pitch = REST, .duration = eighth},
	{.pitch = Cs6, .duration = eighth},
	{.pitch = REST, .duration = eighth},
	{.pitch = Cs6, .duration = eighth},
	{.pitch = REST, .duration = quarter},
	{.pitch = B5, .duration = eighth},
	{.pitch = REST, .duration = eighth},
	{.pitch = B5, .duration = eighth},
	{.pitch = REST, .duration = eighth},
	{.pitch = Cs6, .duration = eighth},
	{.pitch = REST, .duration = eighth},
	{.pitch = Cs6, .duration = eighth},
	{.pitch = REST, .duration = quarter},
	{.pitch = B5, .duration = eighth},
	{.pitch = REST, .duration = eighth},
	{.pitch = B5, .duration = eighth},
	{.pitch = REST, .duration = eighth},
	{.pitch = Cs6, .duration = eighth},
	{.pitch = REST, .duration = eighth},
	{.pitch = Cs6, .duration = eighth},
	{.pitch = REST, .duration = eighth},
	{.pitch = Cs6, .duration = eighth},
	{.pitch = REST, .duration = quarter},
	{.pitch = B5, .duration = eighth},
	{.pitch = REST, .duration = eighth},
	{.pitch = B5, .duration = eighth},
	{.pitch = REST, .duration = eighth},
	{.pitch = Cs6, .duration = eighth},
	{.pitch = REST, .duration = eighth},
	{.pitch = Cs6, .duration = eighth},
	{.pitch = REST, .duration = quarter},
	{.pitch = A6, .duration = quarter},
	{.pitch = REST, .duration = quarter},
	{.pitch = A6, .duration = quarter},
	{.pitch = REST, .duration = quarter},
	/* main */
	{.pitch = Fs6, .duration = eighth},
	{.pitch = REST, .duration = eighth},
	{.pitch = Fs6, .duration = eighth},
	{.pitch = REST, .duration = eighth},
	{.pitch = Fs6, .duration = eighth},
	{.pitch = REST, .duration = eighth},
	{.pitch = Fs6, .duration = eighth},
	{.pitch = REST, .duration = eighth},
	{.pitch = Fs6, .duration = eighth},
	{.pitch = REST, .duration = eighth},
	{.pitch = Fs6, .duration = eighth},
	{.pitch = REST, .duration = eighth},
	{.pitch = Fs6, .duration = quarter},
	{.pitch = REST, .duration = eighth},
	{.pitch = D6, .duration = (quarter + eighth)},
	{.pitch = REST, .duration = eighth},
	{.pitch = E6, .duration = (2 * whole + quarter + eighth)},
	{.pitch = REST, .duration = whole},
	{.pitch = Fs6, .duration = (quarter + eighth)},
	{.pitch = REST, .duration = (quarter + eighth)},
	{.pitch = E6, .duration = eighth},
	{.pitch = REST, .duration = eighth},
	{.pitch = E6, .duration = (quarter + eighth)},
	{.pitch = REST, .duration = 675},
	{.pitch = Fs6, .duration = (eighth + sixteenth)},
	{.pitch = REST, .duration = (eighth + sixteenth)},
	{.pitch = Fs6, .duration = (eighth + sixteenth)},
	{.pitch = REST, .duration = (eighth + sixteenth)},
	{.pitch = E6, .duration = eighth},
	{.pitch = REST, .duration = eighth},
	{.pitch = E6, .duration = half},
	{.pitch = REST, .duration = half},
	{.pitch = E6, .duration = (quarter + eighth)},
	{.pitch = REST, .duration = (quarter + eighth)},
	{.pitch = D6, .duration = eighth},
	{.pitch = REST, .duration = eighth},
	{.pitch = D6, .duration = quarter},
	{.pitch = REST, .duration = quarter},
	{.pitch = A5, .duration = eighth},
	{.pitch = REST, .duration = eighth},
	{.pitch = Cs6, .duration = quarter},
	{.pitch = REST, .duration = quarter},
	{.pitch = D6, .duration = eighth},
	{.pitch = REST, .duration = eighth},
	{.pitch = E6, .duration = quarter},
	{.pitch = REST, .duration = quarter},
	{.pitch = D6, .duration = half},
	{.pitch = REST, .duration = half},
	{.pitch = Fs6, .duration = (quarter + eighth)},
	{.pitch = REST, .duration = (quarter + eighth)},
	{.pitch = E6, .duration = eighth},
	{.pitch = REST, .duration = eighth},
	{.pitch = E6, .duration = (quarter + eighth)},
	{.pitch = REST, .duration = (quarter + eighth)},
	{.pitch = Fs6, .duration = quarter},
	{.pitch = REST, .duration = quarter},
	{.pitch = Fs6, .duration = quarter},
	{.pitch = REST, .duration = quarter},
	{.pitch = E6, .duration = eighth},
	{.pitch = REST, .duration = eighth},
	{.pitch = E6, .duration = quarter},
	{.pitch = REST, .duration = (quarter + eighth)},
	{.pitch = D6, .duration = eighth},
	{.pitch = REST, .duration = eighth},
	{.pitch = E6, .duration = quarter},
	{.pitch = REST, .duration = quarter},
	{.pitch = D6, .duration = eighth},
	{.pitch = REST, .duration = eighth},
	{.pitch = E6, .duration = quarter},
	{.pitch = REST, .duration = quarter},
	{.pitch = D6, .duration = eighth},
	{.pitch = REST, .duration = eighth},
	{.pitch = Fs6, .duration = (whole + quarter)},
	{.pitch = REST, .duration = (whole + quarter)},
	{.pitch = Fs6, .duration = (quarter + eighth)},
	{.pitch = REST, .duration = (quarter + eighth)},
	{.pitch = E6, .duration = eighth},
	{.pitch = REST, .duration = eighth},
	{.pitch = E6, .duration = (quarter + eighth)},
	{.pitch = REST, .duration = (quarter + eighth)},
	{.pitch = Fs6, .duration = quarter},
	{.pitch = REST, .duration = quarter},
	{.pitch = Fs6, .duration = quarter},
	{.pitch = REST, .duration = quarter},
	{.pitch = E6, .duration = eighth},
	{.pitch = REST, .duration = eighth},
	{.pitch = E6, .duration = half},
	{.pitch = REST, .duration = half},
	/* final tone */
	{.pitch = E6, .duration = (quarter + eighth)},
	{.pitch = REST, .duration = (quarter + eighth)},
	{.pitch = E6, .duration = (quarter + eighth)},
	{.pitch = REST, .duration = (quarter + eighth)},
	{.pitch = E6, .duration = whole},
	{.pitch = REST, .duration = whole},
};
const size_t song_tiacsys_notes = ARRAY_SIZE(song_tiacsys);
```

## src/song_xmastime.c
```c
/*
 * SPDX-FileCopyrightText: 2023-2026 TiaC Systems
 * SPDX-License-Identifier: Apache-2.0
 */

#include "songs.h"

const note_t song_xmastime[] = {
	{.pitch = A6, .duration = quarter},
	{.pitch = REST, .duration = quarter},
	{.pitch = H6, .duration = quarter},
	{.pitch = REST, .duration = quarter},
	/* bar */
	{.pitch = A6, .duration = (quarter + sixteenth)},
	{.pitch = REST, .duration = sixteenth},
	{.pitch = G6, .duration = sixteenth},
	{.pitch = REST, .duration = sixteenth},
	{.pitch = Fs6, .duration = quarter},
	{.pitch = G6, .duration = eighth},
	{.pitch = REST, .duration = eighth},
	/* bar */
	{.pitch = A6, .duration = quarter},
	{.pitch = REST, .duration = quarter},
	{.pitch = H6, .duration = quarter},
	{.pitch = REST, .duration = quarter},
	/* bar */
	{.pitch = A6, .duration = (quarter + sixteenth)},
	{.pitch = REST, .duration = sixteenth},
	{.pitch = G6, .duration = sixteenth},
	{.pitch = REST, .duration = sixteenth},
	{.pitch = Fs6, .duration = quarter},
	{.pitch = G6, .duration = eighth},
	{.pitch = REST, .duration = eighth},
	/* bar */
	{.pitch = A6, .duration = quarter},
	{.pitch = REST, .duration = quarter},
	{.pitch = A6, .duration = quarter},
	{.pitch = REST, .duration = quarter},
	/* bar */
	{.pitch = H6, .duration = quarter},
	{.pitch = REST, .duration = quarter},
	{.pitch = Cs7, .duration = eighth},
	{.pitch = REST, .duration = eighth},
	{.pitch = D7, .duration = eighth},
	{.pitch = REST, .duration = eighth},
	/* bar */
	{.pitch = Cs7, .duration = quarter},
	{.pitch = REST, .duration = quarter},
	{.pitch = H6, .duration = quarter},
	{.pitch = REST, .duration = quarter},
	/* bar */
	{.pitch = A6, .duration = (half + quarter)},
	{.pitch = REST, .duration = quarter},
	/* bar */
	{.pitch = E6, .duration = (quarter + eighth)},
	{.pitch = Fs6, .duration = sixteenth},
	{.pitch = REST, .duration = sixteenth},
	{.pitch = E6, .duration = eighth},
	{.pitch = REST, .duration = eighth},
	{.pitch = Fs6, .duration = eighth},
	{.pitch = REST, .duration = eighth},
	/* bar */
	{.pitch = G6, .duration = (quarter + eighth)},
	{.pitch = A6, .duration = sixteenth},
	{.pitch = REST, .duration = sixteenth},
	{.pitch = G6, .duration = quarter},
	{.pitch = REST, .duration = quarter},
	/* bar */
	{.pitch = Fs6, .duration = (quarter + eighth)},
	{.pitch = G6, .duration = sixteenth},
	{.pitch = REST, .duration = sixteenth},
	{.pitch = Fs6, .duration = eighth},
	{.pitch = REST, .duration = eighth},
	{.pitch = G6, .duration = eighth},
	{.pitch = REST, .duration = eighth},
	/* bar */
	{.pitch = A6, .duration = (quarter + eighth)},
	{.pitch = H6, .duration = sixteenth},
	{.pitch = REST, .duration = sixteenth},
	{.pitch = A6, .duration = quarter},
	{.pitch = REST, .duration = quarter},
	/* bar */
	{.pitch = D7, .duration = quarter},
	{.pitch = Cs7, .duration = eighth},
	{.pitch = REST, .duration = eighth},
	{.pitch = H6, .duration = quarter},
	{.pitch = A6, .duration = eighth},
	{.pitch = REST, .duration = eighth},
	/* bar */
	{.pitch = D7, .duration = eighth},
	{.pitch = REST, .duration = eighth},
	{.pitch = H6, .duration = eighth},
	{.pitch = REST, .duration = eighth},
	{.pitch = A6, .duration = eighth},
	{.pitch = REST, .duration = eighth},
	{.pitch = G6, .duration = eighth},
	{.pitch = REST, .duration = eighth},
	/* bar */
	{.pitch = Fs6, .duration = quarter},
	{.pitch = REST, .duration = quarter},
	{.pitch = E6, .duration = quarter},
	{.pitch = REST, .duration = quarter},
	/* bar */
	{.pitch = D6, .duration = whole},
};
const size_t song_xmastime_notes = ARRAY_SIZE(song_xmastime);
```

## src/songs.h
```c
/*
 * SPDX-FileCopyrightText: 2023-2026 TiaC Systems
 * SPDX-License-Identifier: Apache-2.0
 */

#ifndef __SONGS_H__
#define __SONGS_H__

#include "notes.h"
#include <zephyr/init.h>

enum song_choice {
	beep,
	folksong,
	xmastime,
	funkytown,
	mario,
	golioth,
	tiacsys,
};

extern const size_t song_beep_notes;
extern const note_t song_beep[];

extern const size_t song_folksong_notes;
extern const note_t song_folksong[];

extern const size_t song_xmastime_notes;
extern const note_t song_xmastime[];

extern const size_t song_funkytown_notes;
extern const note_t song_funkytown[];

extern const size_t song_mario_notes;
extern const note_t song_mario[];

extern const size_t song_golioth_notes;
extern const note_t song_golioth[];

extern const size_t song_tiacsys_notes;
extern const note_t song_tiacsys[];

#endif /* __SONGS_H__ */
```
