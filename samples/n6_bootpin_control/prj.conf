## CMakeLists.txt
```
# Copyright (c) 2026 inovex GmbH
# SPDX-License-Identifier: Apache-2.0

cmake_minimum_required(VERSION 3.20.0)

# Standard Bridle application boilerplate, includes Zephyr.
find_package(Bridle REQUIRED HINTS $ENV{BRIDLE_BASE})
project("N6 Boot Selector" VERSION 0.1)


target_sources(app PRIVATE src/main.c)
```

## sample.yaml
```
sample:
  name: N6 Boot Selector
  description: Shell-controlled GPIO used to drive the STM32N6 boot-select pin
    from a second helper board.
common:
  tags:
    - bridle
  build_only: true
  platform_allow:
    - frdm_rw612
  integration_platforms:
    - frdm_rw612
tests:
  bridle.sample.n6_boot_selector: {}
```

## prj.conf
```kconfig
# Copyright (c) 2026 inovex GmbH
# SPDX-License-Identifier: Apache-2.0

CONFIG_GPIO=y
CONFIG_SHELL=y
```

## boards/frdm_rw612.overlay
```dts
/*
 * Copyright (c) 2026 inovex GmbH
 * SPDX-License-Identifier: Apache-2.0
 */

#include <zephyr/dt-bindings/gpio/gpio.h>

/ {
	zephyr,user {
		/*
		 * Arduino header D2 == hsgpio0 pin 11 on the FRDM-RW612.
		 * "assert" drives this line high, "deassert" drives it low.
		 */
		boot-ctrl-gpios = <&hsgpio0 11 GPIO_ACTIVE_HIGH>;
	};
};

/*
 * hsgpio0 pin 11 is shared with the on-board "User SW2" button. Disable that
 * gpio-keys node so the pin is used exclusively as the boot-select output.
 */
&user_button_0 {
	status = "disabled";
};
```

## src/main.c
```c
/*
 * Copyright (c) 2026 inovex GmbH
 * SPDX-License-Identifier: Apache-2.0
 */

#include <zephyr/kernel.h>
#include <zephyr/device.h>
#include <zephyr/drivers/gpio.h>
#include <zephyr/shell/shell.h>

/*
 * The boot-select control pin is taken from the "boot-ctrl-gpios" property of
 * the devicetree "/zephyr,user" node, for example:
 *
 *   / {
 *           zephyr,user {
 *                   boot-ctrl-gpios = <&gpio0 11 GPIO_ACTIVE_HIGH>;
 *           };
 *   };
 *
 * The pin polarity (i.e. whether "assert" drives the line high or low) is
 * controlled by the GPIO flags in the devicetree, so the active level can be
 * adapted per board without touching this source file.
 */
#if !DT_NODE_HAS_PROP(DT_PATH(zephyr_user), boot_ctrl_gpios)
#error "Unsupported board: boot-ctrl-gpios is not defined in /zephyr,user"
#endif

static const struct gpio_dt_spec boot_ctrl =
	GPIO_DT_SPEC_GET(DT_PATH(zephyr_user), boot_ctrl_gpios);

static int boot_ctrl_set(const struct shell *sh, int value)
{
	int ret;

	if (!gpio_is_ready_dt(&boot_ctrl)) {
		shell_error(sh, "boot-ctrl device %s is not ready",
			    boot_ctrl.port->name);
		return -ENODEV;
	}

	ret = gpio_pin_set_dt(&boot_ctrl, value);
	if (ret != 0) {
		shell_error(sh, "failed to %s boot-ctrl (err %d)",
			    value ? "assert" : "de-assert", ret);
		return ret;
	}

	shell_print(sh, "boot-ctrl %s (%s pin %u)",
		    value ? "asserted" : "de-asserted",
		    boot_ctrl.port->name, boot_ctrl.pin);
	return 0;
}

static int cmd_assert(const struct shell *sh, size_t argc, char **argv)
{
	ARG_UNUSED(argc);
	ARG_UNUSED(argv);

	return boot_ctrl_set(sh, 1);
}

static int cmd_deassert(const struct shell *sh, size_t argc, char **argv)
{
	ARG_UNUSED(argc);
	ARG_UNUSED(argv);

	return boot_ctrl_set(sh, 0);
}

SHELL_CMD_REGISTER(assert, NULL,
		   "Assert the boot-select control pin.", cmd_assert);
SHELL_CMD_REGISTER(deassert, NULL,
		   "De-assert the boot-select control pin.", cmd_deassert);

int main(void)
{
	int ret;

	if (!gpio_is_ready_dt(&boot_ctrl)) {
		printk("Error: boot-ctrl device %s is not ready\n",
		       boot_ctrl.port->name);
		return -ENODEV;
	}

	/* Start in the de-asserted (inactive) state. */
	ret = gpio_pin_configure_dt(&boot_ctrl, GPIO_OUTPUT_INACTIVE);
	if (ret != 0) {
		printk("Error %d: failed to configure boot-ctrl %s pin %u\n",
		       ret, boot_ctrl.port->name, boot_ctrl.pin);
		return ret;
	}

	printk("N6 boot selector ready: boot-ctrl on %s pin %u\n",
	       boot_ctrl.port->name, boot_ctrl.pin);
	printk("Use the 'assert' and 'deassert' shell commands.\n");
	return 0;
}
```
