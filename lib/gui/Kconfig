## lib/gui/Kconfig
```kconfig
# SPDX-FileCopyrightText: 2024-2026 TiaC Systems
# SPDX-License-Identifier: Apache-2.0

menu "GUI Libraries"

# zephyr-keep-sorted-start
rsource "lvgl/Kconfig"
# zephyr-keep-sorted-stop

endmenu
```

## samples/helloshell/boards/rpi_pico_rp2040_w.conf
```kconfig
# Copyright (c) 2025-2026 TiaC Systems
# SPDX-License-Identifier: Apache-2.0

CONFIG_TEST_RANDOM_GENERATOR=y

# make sure there are enough resources for network and shell commands
# zephyr-keep-sorted-start
CONFIG_MAIN_STACK_SIZE=2048
CONFIG_NET_MGMT_EVENT_STACK_SIZE=1024
CONFIG_SHELL_STACK_SIZE=5200
CONFIG_SYSTEM_WORKQUEUE_STACK_SIZE=2048
CONFIG_ZVFS_OPEN_ADD_SIZE_NET=10
CONFIG_ZVFS_POLL_MAX=10
# zephyr-keep-sorted-stop

# enable Infineon AIROC SoC Wi-Fi and related shell commands
# zephyr-keep-sorted-start
CONFIG_NETWORKING=y
CONFIG_NET_CONNECTION_MANAGER=y
CONFIG_NET_L2_ETHERNET=y
CONFIG_NET_L2_WIFI_MGMT=y
CONFIG_NET_L2_WIFI_SHELL=y
CONFIG_WIFI=y
CONFIG_WIFI_LOG_LEVEL_ERR=y
# zephyr-keep-sorted-stop

# enable network stack with TCP/IP and related shell commands
# zephyr-keep-sorted-start
CONFIG_NET_ARP=y
CONFIG_NET_DHCPV4=y
CONFIG_NET_DHCPV4_LOG_LEVEL_INF=y
CONFIG_NET_DHCPV6=y
CONFIG_NET_DHCPV6_LOG_LEVEL_INF=y
CONFIG_NET_IPV4=y
CONFIG_NET_IPV6=y
CONFIG_NET_LOG=y
CONFIG_NET_MAX_CONN=10
CONFIG_NET_MAX_CONTEXTS=10
CONFIG_NET_RX_STACK_SIZE=2048
CONFIG_NET_SHELL=y
CONFIG_NET_STATISTICS=y
CONFIG_NET_STATISTICS_PERIODIC_OUTPUT=n
CONFIG_NET_STATISTICS_USER_API=y
CONFIG_NET_STATISTICS_WIFI=y
CONFIG_NET_TCP=y
CONFIG_NET_TX_STACK_SIZE=2048
CONFIG_NET_UDP=y
# zephyr-keep-sorted-stop

# enable network settings for applications
# zephyr-keep-sorted-start
CONFIG_NET_CONFIG_AUTO_INIT=y
CONFIG_NET_CONFIG_CLOCK_SNTP_INIT=y
CONFIG_NET_CONFIG_INIT_TIMEOUT=60
CONFIG_NET_CONFIG_MY_IPV4_ADDR=""
CONFIG_NET_CONFIG_MY_IPV6_ADDR=""
CONFIG_NET_CONFIG_NEED_IPV4=y
CONFIG_NET_CONFIG_NEED_IPV6=n
CONFIG_NET_CONFIG_SETTINGS=y
CONFIG_NET_CONFIG_SNTP_INIT_RESYNC=y
CONFIG_NET_CONFIG_SNTP_INIT_RESYNC_INTERVAL=600
CONFIG_NET_CONFIG_SNTP_INIT_RESYNC_ON_FAILURE_INTERVAL=60
CONFIG_NET_CONFIG_SNTP_INIT_SERVER="0.pool.ntp.org"
# zephyr-keep-sorted-stop

# enable basic network services
# zephyr-keep-sorted-start
CONFIG_DNS_RESOLVER=y
CONFIG_DNS_RESOLVER_MAX_SERVERS=4
CONFIG_SNTP=y
# zephyr-keep-sorted-stop
```

## samples/helloshell/boards/waveshare_rp2350_can_rp2350a_hazard3_0.conf
```kconfig
# SPDX-FileCopyrightText: Copyright (c) 2025-2026 TiaC Systems
# SPDX-License-Identifier: Apache-2.0

# enable specific components
# zephyr-keep-sorted-start
CONFIG_CAN=y
CONFIG_CAN_SHELL=y
CONFIG_CAN_STATS=y
CONFIG_STATS=y
CONFIG_STATS_NAMES=y
CONFIG_STATS_SHELL=y
# zephyr-keep-sorted-stop
```

## scripts/rigc/tests/fixtures/boards/shields/adafruit_winc1500/Kconfig.shield
```kconfig
# SPDX-FileCopyrightText: 2020 Kim Bøndergaard <kim.bondergaard@prevas.dk>, Prevas A/S
# SPDX-License-Identifier: Apache-2.0

config SHIELD_ADAFRUIT_WINC1500
	def_bool $(shields_list_contains,adafruit_winc1500)
```

## scripts/rigc/tests/fixtures/boards/shields/can_span_click/Kconfig.shield
```kconfig
# Copyright (c) 2026 TiaC Systems
# SPDX-License-Identifier: Apache-2.0

config SHIELD_CAN_SPAN_CLICK
	def_bool $(shields_list_contains,can_span_click)
```

## scripts/rigc/tests/fixtures/boards/shields/eth_click/Kconfig.shield
```kconfig
# Copyright (c) 2026 TiaC Systems
# SPDX-License-Identifier: Apache-2.0

config SHIELD_ETH_CLICK
	def_bool $(shields_list_contains,eth_click)
```

## scripts/rigc/tests/fixtures/boards/shields/flash_click/Kconfig.shield
```kconfig
# Copyright (c) 2026 TiaC Systems
# SPDX-License-Identifier: Apache-2.0

config SHIELD_FLASH_CLICK
	def_bool $(shields_list_contains,flash_click)
```

## scripts/rigc/tests/fixtures/boards/shields/grove_btn/Kconfig.shield
```kconfig
# Copyright (c) 2026 TiaC Systems
# SPDX-License-Identifier: Apache-2.0

config SHIELD_GROVE_BTN
	def_bool $(shields_list_contains,grove_btn)
```

## scripts/rigc/tests/fixtures/boards/shields/i2c_sensor/Kconfig.shield
```kconfig
# Copyright (c) 2026 TiaC Systems
# SPDX-License-Identifier: Apache-2.0

config SHIELD_I2C_SENSOR
	def_bool $(shields_list_contains,i2c_sensor)
```

## scripts/rigc/tests/fixtures/boards/shields/pilot_alt_button/Kconfig.shield
```kconfig
# Copyright (c) 2026 TiaC Systems
# SPDX-License-Identifier: Apache-2.0

config SHIELD_PILOT_ALT_BUTTON
	def_bool $(shields_list_contains,pilot_alt_button)
```

## scripts/rigc/tests/fixtures/dts/bindings/fixturetest-adc-ctrl.yaml
```yaml
# Copyright (c) 2026 TiaC Systems
# SPDX-License-Identifier: Apache-2.0

description: Purpose-built fixture ADC controller binding (rigc's own
  board/project.py's and board/resolve.py's unit-test data, never a copy of
  a real controller binding).

compatible: "fixturetest,adc-ctrl"

properties:
  reg:
    type: array
  "#io-channel-cells":
    type: int
    required: true

io-channel-cells:
  - input
```

## scripts/rigc/tests/fixtures/dts/bindings/fixturetest-gpio-ctrl.yaml
```yaml
# Copyright (c) 2026 TiaC Systems
# SPDX-License-Identifier: Apache-2.0

description: Purpose-built fixture GPIO controller binding (rigc's own
  board/project.py's and board/resolve.py's unit-test data, never a copy of
  a real controller binding).

compatible: "fixturetest,gpio-ctrl"

properties:
  reg:
    type: array
  gpio-controller:
    type: boolean
  "#gpio-cells":
    type: int
    required: true

gpio-cells:
  - pin
  - flags
```

## scripts/rigc/tests/fixtures/dts/bindings/fixturetest-i2c-ctrl.yaml
```yaml
# Copyright (c) 2026 TiaC Systems
# SPDX-License-Identifier: Apache-2.0

description: Purpose-built fixture I2C controller binding (rigc's own
  board/project.py's and board/resolve.py's unit-test data, never a copy of
  a real controller binding).

compatible: "fixturetest,i2c-ctrl"

properties:
  reg:
    type: array
  "#address-cells":
    type: int
  "#size-cells":
    type: int
```

## scripts/rigc/tests/fixtures/dts/bindings/fixturetest-pwm-ctrl.yaml
```yaml
# Copyright (c) 2026 TiaC Systems
# SPDX-License-Identifier: Apache-2.0

description: Purpose-built fixture PWM controller binding (rigc's own
  board/project.py's and board/resolve.py's unit-test data, never a copy of
  a real controller binding).

compatible: "fixturetest,pwm-ctrl"

properties:
  reg:
    type: array
  "#pwm-cells":
    type: int
    required: true

pwm-cells:
  - channel
  - period
```

## scripts/rigc/tests/fixtures/dts/bindings/fixturetest-spi-ctrl.yaml
```yaml
# Copyright (c) 2026 TiaC Systems
# SPDX-License-Identifier: Apache-2.0

description: Purpose-built fixture SPI controller binding (rigc's own
  board/project.py unit-test data, never a copy of a real controller
  binding). Declares cs-gpios as a real SPI controller binding would
  (zephyr's own dts/bindings/spi/spi-controller.yaml), so the fixture
  board can carry a board-authored cs-gpios array/child reg the same
  way mikroe_quail.dts/nucleo_f401re.dts do.

compatible: "fixturetest,spi-ctrl"

bus: spi

properties:
  reg:
    type: array
  "#address-cells":
    type: int
  "#size-cells":
    type: int
  cs-gpios:
    type: phandle-array
```

## scripts/rigc/tests/fixtures/dts/bindings/socket-fixture-nexus.yaml
```yaml
# Copyright (c) 2026 TiaC Systems
# SPDX-License-Identifier: Apache-2.0

description: |
  Purpose-built fixture connector-type binding for rigc's own board/
  project.py and board/resolve.py unit tests (tests/unit/
  test_board_project.py, tests/unit/test_board_resolve.py) -- never a
  copy of a real dts/bindings/connectors/*.yaml type (rigc-mission-
  brief.md Sec 7: hermetic means no Zephyr DATA). Declares exactly the
  nexus shapes board/project.py's projection reads: gpio-map (required,
  every socket has one), pwm-map/
  io-channel-map (optional, only PWM/ADC-capable sockets carry them),
  socket,i2c/socket,spi (bus proxy phandles), socket,cs-pool (the bare
  SPI bus's own CS pool default).

compatible: "socket,fixture-nexus"

properties:
  socket,i2c:
    type: phandle
    description: the I2C controller this socket exposes, if any

  socket,spi:
    type: phandle
    description: the SPI controller this socket exposes, if any

  socket,cs-pool:
    type: array
    description: ordered default CS candidate positions

  "#gpio-cells":
    type: int
    required: true

  gpio-map:
    type: compound
    required: true

  gpio-map-mask:
    type: array

  gpio-map-pass-thru:
    type: array

  "#pwm-cells":
    type: int

  pwm-map:
    type: compound

  pwm-map-mask:
    type: array

  pwm-map-pass-thru:
    type: array

  "#io-channel-cells":
    type: int

  io-channel-map:
    type: compound

  io-channel-map-mask:
    type: array

  io-channel-map-pass-thru:
    type: array
```

## scripts/rigc/tests/fixtures/extra_module/dts/bindings/connectors/fixture-extra-module.yaml
```yaml
# Copyright (c) 2026 TiaC Systems
# SPDX-License-Identifier: Apache-2.0
description: |
  Fixture-only connector type, declared by the extra_module fixture module
  alone (test_west_rigs_extra_modules.py): a shield plugging it loads only
  when `west rigs` threads that module's dts_root as a connector root.
  Nothing mates it -- no board carries this socket.

compatible: "socket,fixture-extra-module"

include: [base.yaml]

plug,bus-proxies: []
plug,positions: {}
```

## snippets/usb-console/boards/xiao_stm32c5.conf
```kconfig
# SPDX-FileCopyrightText: Copyright (c) 2026 TiaC Systems
# SPDX-License-Identifier: Apache-2.0

# Seeed Studio @ XIAO STM32C5
CONFIG_CDC_ACM_SERIAL_VID=0x2886
CONFIG_CDC_ACM_SERIAL_PID=0x00c5
CONFIG_CDC_ACM_SERIAL_MANUFACTURER_STRING="Seeed Studio"
CONFIG_CDC_ACM_SERIAL_PRODUCT_STRING="XIAO STM32C5 (CDC ACM)"
```

## soc/st/stm32/Kconfig.soc
```kconfig
# ST Microelectronics STM32 MCU line

# SPDX-FileCopyrightText: 2024-2026 TiaC Systems
# SPDX-License-Identifier: Apache-2.0

# zephyr-keep-sorted-start
rsource "*/Kconfig.soc"
# zephyr-keep-sorted-stop
```

## soc/st/stm32/stm32f7x/Kconfig.soc
```kconfig
# ST Microelectronics STM32F7 MCU line

# SPDX-FileCopyrightText: 2024-2026 TiaC Systems
# SPDX-License-Identifier: Apache-2.0

config SOC_STM32F777XX
	bool
	select SOC_SERIES_STM32F7X

config SOC
	default "stm32f777xx" if SOC_STM32F777XX
```

## subsys/Kconfig
```kconfig
# SPDX-FileCopyrightText: 2021-2026 TiaC Systems
# SPDX-FileCopyrightText: 2019-2021 Li-Pro.Net
# SPDX-License-Identifier: Apache-2.0

menu "Sub Systems and OS Services"

# zephyr-keep-sorted-start
rsource "shell/Kconfig"
# zephyr-keep-sorted-stop

endmenu
```
